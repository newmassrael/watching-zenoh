## CMakeLists.txt
```
# SPDX-License-Identifier: LicenseRef-watching-zenoh-NonCommercial-1.0 OR LicenseRef-watching-zenoh-Commercial
# SPDX-FileCopyrightText: Copyright (c) 2026 newmassrael
#
# zephyr-app -- Path-B Zephyr application: Zephyr compiles the kernel, cargo
# emits the wz Rust staticlib, and Zephyr's final image link pulls them together
# (the analogue of zephyr-lang-rust's modules/lang/rust/CMakeLists.txt link step,
# but bindgen-free and reusing wz's CoopRuntime SSOT). `west build -b <board>
# deploy/zephyr-app` is the single entry point; the lane's reference board is
# mps2/an385.
#
# R2916 -- the reference board is mps2/an385 (Cortex-M3, 4 MB), where it was
# qemu_cortex_m3 (64 KB of SRAM): the image carries Zephyr's own net stack and
# sockets, which the smaller board has no room for. lwIP is not in this build:
# the profile's network seam is Zephyr's sockets (`wz_runtime_zephyr::net`).
#
# The board is an ARGUMENT. What used to be QEMU constants -- the Rust target
# triple, the tick rate, the random source -- is read from the board's own
# Kconfig by deploy/zephyr-common/wz_zephyr_board.cmake. What only the QEMU
# board needs lives in boards/mps2_an385.conf.

cmake_minimum_required(VERSION 3.20.0)
find_package(Zephyr REQUIRED HINTS $ENV{ZEPHYR_BASE})
project(wz_zephyr_app C)

include(${CMAKE_CURRENT_SOURCE_DIR}/../zephyr-common/wz_zephyr_board.cmake)

target_sources(app PRIVATE src/main.c)

# The UNDEFINED list is the POSIX socket layer the profile's network seam calls
# (`zephyr_sys::socket`) and the board's socket hooks a datagram socket reads. The image reads no
# board address (its two ends are the loopback), so no address hook of either family.
wz_zephyr_rust_app(
  RUST_DIR ${CMAKE_CURRENT_SOURCE_DIR}/rust
  LIB      wz_zephyr_app
  UNDEFINED
    socket bind getsockname sendto recvfrom poll close
    ${WZ_SOCKET_HOOKS}
)
```

## Kconfig
```
# SPDX-License-Identifier: LicenseRef-watching-zenoh-NonCommercial-1.0 OR LicenseRef-watching-zenoh-Commercial
# SPDX-FileCopyrightText: Copyright (c) 2026 newmassrael

mainmenu "wz Zephyr acceptor-session e2e"

rsource "../zephyr-common/Kconfig.wz"

source "Kconfig.zephyr"
```

## prj.conf
```kconfig
# SPDX-License-Identifier: LicenseRef-watching-zenoh-NonCommercial-1.0 OR LicenseRef-watching-zenoh-Commercial
# SPDX-FileCopyrightText: Copyright (c) 2026 newmassrael
#
# zephyr-app Kconfig — the cooperative single-task profile, for every board.
# What only one board needs is in boards/<board>.conf (the QEMU board's tick rate
# and its test entropy generator); nothing here is a QEMU constant.

# printk for the boot log + the ZEPHYR-WZ PASS/FAIL sentinel the CI greps.
CONFIG_PRINTK=y

# The Zephyr kernel heap that ZephyrAllocator (k_malloc/k_free) bridges Rust's
# #[global_allocator] onto. MUST be > 0 or k_malloc is not compiled in (the
# Rust references would dangle at link). Backs the executor task pool and the
# socket link's receive buffer (one UDP datagram's worth, 64 KiB). Small heap =
# 4-byte base alignment, which ZephyrAllocator's HEAP_ALIGN already accounts for.
CONFIG_HEAP_MEM_POOL_SIZE=262144

# The main thread runs the wz executor + its futures, so give it headroom (the
# FreeRTOS sibling's wz task uses a 16 KB stack).
CONFIG_MAIN_STACK_SIZE=16384

# R2916 — the profile's network seam: IPv4 UDP over Zephyr's own stack, reached
# through the POSIX socket layer (the route zenoh-pico's Zephyr port takes), on
# the loopback interface. POSIX_NETWORKING gives socket / bind / sendto /
# recvfrom / getsockname; POSIX_DEVICE_IO gives poll / close; both depend on
# POSIX_SYSTEM_INTERFACES. The board's SLIP-over-tap interface to the host is
# off: this image's traffic is loopback only.
CONFIG_NETWORKING=y
CONFIG_NET_IPV4=y
CONFIG_NET_UDP=y
CONFIG_NET_TCP=n
CONFIG_NET_LOOPBACK=y
CONFIG_NET_SLIP_TAP=n
CONFIG_POSIX_SYSTEM_INTERFACES=y
CONFIG_POSIX_NETWORKING=y

# R2918 — clock_gettime / clock_settime(CLOCK_REALTIME), the board's wall clock
# for the profile's epoch seam (deploy/zephyr-common/wz_board_hooks.c).
CONFIG_POSIX_TIMERS=y
CONFIG_POSIX_DEVICE_IO=y
```

## boards/mps2_an385.conf
```kconfig
# SPDX-License-Identifier: LicenseRef-watching-zenoh-NonCommercial-1.0 OR LicenseRef-watching-zenoh-Commercial
# SPDX-FileCopyrightText: Copyright (c) 2026 newmassrael
#
# What only the QEMU mps2/an385 board needs. A real board gets none of it.

# 100 Hz: the reference deploy's tick rate, 10 ms resolution. The Rust side reads
# whatever the board has (`wz_runtime_zephyr::tick_hz_from_build!`); this line
# only keeps the QEMU lane's timing where it has always been measured.
CONFIG_SYS_CLOCK_TICKS_PER_SEC=100

# Zephyr's net stack draws from `sys_rand_get` (ephemeral ports, IDs), and QEMU
# mps2/an385 has NO entropy hardware. ⚠ The test generator is a FIXTURE: its
# numbers are predictable, it exercises the call and does not satisfy the
# entropy contract. Zephyr allows it only for a board whose sole purpose is
# testing, and deploy/zephyr-common/wz_board_hooks.c admits it on a QEMU board
# alone: a real board selects its TRNG driver instead, or does not build.
CONFIG_TEST_RANDOM_GENERATOR=y
```

## src/main.c
```c
/* SPDX-License-Identifier: LicenseRef-watching-zenoh-NonCommercial-1.0 OR LicenseRef-watching-zenoh-Commercial
 * SPDX-FileCopyrightText: Copyright (c) 2026 newmassrael
 *
 * zephyr-app C entry — the Zephyr half of the Path-B integration. Zephyr boots,
 * owns the vector table + the systick, and runs `main()` on the main thread;
 * `main()` hands that thread to the wz Rust staticlib (`wz_app_main`), which
 * hosts CoopRuntime<ZephyrClock> (the cooperative single-task profile).
 *
 * The seams the Rust side calls through (printk, k_msleep, irq_lock, the
 * board's random source and wall clock) are shared by every wz Zephyr image and
 * live in deploy/zephyr-common/wz_board_hooks.c, not here.
 *
 * The CI verdict is the `ZEPHYR-WZ PASS` console sentinel under a QEMU timeout
 * (Zephyr-idiomatic console-regex pass, like twister) — there is no semihosting
 * exit on this board's qemu launch.
 */

#include <zephyr/kernel.h>
#include <zephyr/sys/printk.h>

/* Implemented in the wz Rust staticlib (libwz_zephyr_app.a). Returns 0 = PASS. */
extern int wz_app_main(void);

/* wz_board_hooks.c: set the realtime clock to this build's instant. */
extern int wz_board_set_boot_clock(void);

int main(void)
{
	printk("zephyr-app: boot ok; entering wz_app_main\n");

	/* The board's clock, set once at boot as an SNTP sync would set it. */
	if (wz_board_set_boot_clock() != 0) {
		printk("ZEPHYR-WZ FAIL rc=-1 (the board could not set its clock)\n");
		return 0;
	}

	int rc = wz_app_main();
	if (rc == 0) {
		printk("ZEPHYR-WZ PASS\n");
	} else {
		printk("ZEPHYR-WZ FAIL rc=%d\n", rc);
	}
	return 0;
}
```
