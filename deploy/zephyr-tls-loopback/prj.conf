## CMakeLists.txt
```
# SPDX-License-Identifier: LicenseRef-watching-zenoh-NonCommercial-1.0 OR LicenseRef-watching-zenoh-Commercial
# SPDX-FileCopyrightText: Copyright (c) 2026 newmassrael
#
# zephyr-tls-loopback -- the witness that a node on Zephyr's own sockets accepts a secure channel
# (decision D12 of docs/session-lifecycle-intent.md). Built as zephyr-app is: Zephyr compiles the
# kernel, cargo emits the wz Rust staticlib, and Zephyr's final image link pulls them together.
# `west build -b mps2/an385 deploy/zephyr-tls-loopback` is the single entry point; the image runs
# alone under QEMU on the board's loopback interface, with no router and no network.
#
# The channel's C side (`csrc/wz_tls.c`) is compiled here, against Zephyr's own Mbed TLS (the
# crate is built without its `vendored`), exactly as the admin node's `CONFIG_WZ_TLS` does; the
# stream calls and the channel's calls are the Rust side's to find at the image link.

cmake_minimum_required(VERSION 3.20.0)
find_package(Zephyr REQUIRED HINTS $ENV{ZEPHYR_BASE})
project(wz_zephyr_tls_loopback C)

include(${CMAKE_CURRENT_SOURCE_DIR}/../zephyr-common/wz_zephyr_board.cmake)

target_sources(app PRIVATE src/main.c)

set(tls_src ${CMAKE_CURRENT_SOURCE_DIR}/../../crates/wz-tls-mbedtls)
target_sources(app PRIVATE ${tls_src}/csrc/wz_tls.c)
target_include_directories(app PRIVATE ${tls_src}/csrc)
target_include_directories(mbedtls_iface INTERFACE ${tls_src}/config/zephyr)

wz_zephyr_rust_app(
  RUST_DIR ${CMAKE_CURRENT_SOURCE_DIR}/rust
  LIB      wz_zephyr_tls_loopback
  UNDEFINED
    socket bind getsockname sendto recvfrom poll close
    connect send recv getpeername shutdown setsockopt listen accept
    # Its streams read the family refusal of a socket (the only socket hook a stream reads); it
    # reads no board address.
    wz_net_socket_family_refused
    wz_tls_start wz_tls_arena_peak wz_tls_arena_peak_reset
    wz_tls_identity_generate wz_tls_identity_zid wz_tls_identity_cert wz_tls_identity_free
    wz_tls_session_open wz_tls_session_set_io_ctx wz_tls_session_handshake
    wz_tls_session_peer_zid wz_tls_session_suite wz_tls_session_write wz_tls_session_read
    wz_tls_session_pending wz_tls_session_close_notify wz_tls_session_free
)
```

## Kconfig
```
# SPDX-License-Identifier: LicenseRef-watching-zenoh-NonCommercial-1.0 OR LicenseRef-watching-zenoh-Commercial
# SPDX-FileCopyrightText: Copyright (c) 2026 newmassrael

mainmenu "wz Zephyr secure-listener witness"

rsource "../zephyr-common/Kconfig.wz"

source "Kconfig.zephyr"
```

## prj.conf
```kconfig
# SPDX-License-Identifier: LicenseRef-watching-zenoh-NonCommercial-1.0 OR LicenseRef-watching-zenoh-Commercial
# SPDX-FileCopyrightText: Copyright (c) 2026 newmassrael
#
# zephyr-tls-loopback Kconfig: the secure-listener witness, on Zephyr's own TCP over the loopback
# interface. What only the QEMU board needs is in boards/<board>.conf.

CONFIG_PRINTK=y

# The kernel heap the Rust side's allocator (k_malloc/k_free) bridges onto: the witness boxes its
# listener and builds its log lines. Mbed TLS has an arena of its own, below.
CONFIG_HEAP_MEM_POOL_SIZE=65536

# One thread plays both ends of the handshake. The fit image (deploy/zephyr-tls-fit) measured the
# deepest handshake frames of one role at 2.3 KB over a thread's own; two roles take their turns
# on the same stack, never nested, so the fit image's stack is the generous bound.
CONFIG_MAIN_STACK_SIZE=24576
CONFIG_INIT_STACKS=y
CONFIG_THREAD_STACK_INFO=y

# Zephyr's own stack over the loopback interface, reached through the POSIX socket layer (the
# route zenoh-pico's Zephyr port takes). TCP is the stream under the channel.
CONFIG_NETWORKING=y
CONFIG_NET_IPV4=y
CONFIG_NET_UDP=y
CONFIG_NET_TCP=y
CONFIG_NET_LOOPBACK=y
CONFIG_NET_SLIP_TAP=n
CONFIG_POSIX_SYSTEM_INTERFACES=y
CONFIG_POSIX_NETWORKING=y
CONFIG_POSIX_TIMERS=y
CONFIG_POSIX_DEVICE_IO=y

# A TLS server's first flight is five records (the hello, the change-cipher-spec and the
# handshake messages), and Zephyr's TCP holds every segment it sent as a packet until the peer
# acknowledges it. At the default of 4 TX packets the fifth `send` failed (-1, measured on this
# image: the server was dropped before its Finished and its peer read the end of the stream), so
# the pools below hold a flight and the peer's reply with room to spare.
# Each connection of a run is a context, and a closed one lingers in TIME_WAIT: the listener, a
# dropped plain connection and the real pair (both ends) are five at once.
CONFIG_NET_MAX_CONTEXTS=16
# The TCP half of a context is a connection of its own, from a pool of CONFIG_NET_MAX_CONN (4 on an
# IPv4-only build), and a closed one keeps its slot in TIME_WAIT: the listener of a restart check
# found its `listen` refused (-1, `net_tcp_listen` with no connection object) after the three
# connections the steps before it leave behind.
CONFIG_NET_MAX_CONN=16
CONFIG_NET_PKT_RX_COUNT=16
CONFIG_NET_PKT_TX_COUNT=16
CONFIG_NET_BUF_RX_COUNT=64
CONFIG_NET_BUF_TX_COUNT=64

# Mbed TLS on its PSA Crypto line, as the fit image and the admin node state it: TLS 1.3 only, the
# ephemeral key exchange, ECDSA over P-256, AES-128-GCM with SHA-256, the certificate each end
# writes over its own key and the peer's it reads.
CONFIG_PSA_CRYPTO=y
CONFIG_PSA_CRYPTO_PROVIDER_MBEDTLS=y
CONFIG_MBEDTLS=y
CONFIG_MBEDTLS_BUILTIN=y
CONFIG_MBEDTLS_PSA_CRYPTO_C=y
CONFIG_MBEDTLS_SSL_PROTO_TLS1_2=n
CONFIG_MBEDTLS_SSL_PROTO_TLS1_3=y
CONFIG_MBEDTLS_SSL_TLS1_3_KEY_EXCHANGE_MODE_EPHEMERAL_ENABLED=y
CONFIG_MBEDTLS_SSL_TLS1_3_KEY_EXCHANGE_MODE_PSK_ENABLED=n
CONFIG_MBEDTLS_SSL_TLS1_3_KEY_EXCHANGE_MODE_PSK_EPHEMERAL_ENABLED=n
CONFIG_MBEDTLS_SSL_SESSION_TICKETS=n
CONFIG_MBEDTLS_X509_CRT_PARSE_C=y
CONFIG_MBEDTLS_X509_CRT_WRITE_C=y
CONFIG_MBEDTLS_PK_WRITE_C=y
CONFIG_MBEDTLS_USER_CONFIG_FILE="wz_tls_zephyr_user_config.h"
CONFIG_PSA_WANT_ECC_SECP_R1_256=y
CONFIG_PSA_WANT_KEY_TYPE_ECC_KEY_PAIR_GENERATE=y
CONFIG_PSA_WANT_KEY_TYPE_ECC_KEY_PAIR_IMPORT=y
CONFIG_PSA_WANT_KEY_TYPE_ECC_KEY_PAIR_EXPORT=y
CONFIG_PSA_WANT_KEY_TYPE_ECC_PUBLIC_KEY=y
CONFIG_PSA_WANT_ALG_ECDSA=y
CONFIG_PSA_WANT_ALG_ECDH=y
CONFIG_PSA_WANT_ALG_SHA_256=y
CONFIG_PSA_WANT_ALG_HMAC=y
CONFIG_PSA_WANT_ALG_HKDF_EXTRACT=y
CONFIG_PSA_WANT_ALG_HKDF_EXPAND=y
CONFIG_PSA_WANT_KEY_TYPE_AES=y
CONFIG_PSA_WANT_ALG_GCM=y
CONFIG_MBEDTLS_PSA_CRYPTO_LEGACY_RNG=y

# The record buffers decided in Round 3495: receive the protocol's maximum, send 1,500 bytes.
CONFIG_MBEDTLS_SSL_IN_CONTENT_LEN=16384
CONFIG_MBEDTLS_SSL_OUT_CONTENT_LEN=1500

# Every allocation Mbed TLS makes comes from one static arena. Both ends live at once in this
# image (two sessions at about 22 KB each, Round 3495, and two identities), so the arena is the fit
# image's 96 KB, which holds one session of each role with room to spare.
CONFIG_MBEDTLS_ENABLE_HEAP=y
CONFIG_MBEDTLS_HEAP_SIZE=98304
CONFIG_MBEDTLS_MEMORY_DEBUG=y
```

## boards/mps2_an385.conf
```kconfig
# SPDX-License-Identifier: LicenseRef-watching-zenoh-NonCommercial-1.0 OR LicenseRef-watching-zenoh-Commercial
# SPDX-FileCopyrightText: Copyright (c) 2026 newmassrael
#
# What only the QEMU mps2/an385 board needs. A real board gets none of it.

# 100 Hz, the tick rate the Zephyr lanes have always been measured at.
CONFIG_SYS_CLOCK_TICKS_PER_SEC=100

# Zephyr's net stack and Mbed TLS draw from `sys_rand_get`, and QEMU mps2/an385 has NO entropy
# hardware. The test generator is a FIXTURE: its numbers are predictable, it exercises the call
# and does not satisfy the entropy contract. Zephyr allows it only for a board whose sole purpose
# is testing, and deploy/zephyr-common/wz_board_hooks.c admits it on a QEMU board alone.
CONFIG_TEST_RANDOM_GENERATOR=y
```

## src/main.c
```c
/* SPDX-License-Identifier: LicenseRef-watching-zenoh-NonCommercial-1.0 OR LicenseRef-watching-zenoh-Commercial
 * SPDX-FileCopyrightText: Copyright (c) 2026 newmassrael
 *
 * zephyr-tls-loopback C entry: Zephyr boots and runs `main()` on the main thread, and `main()`
 * hands that thread to the wz Rust staticlib (`wz_app_main`), which plays a secure listener and
 * a dial on the board's loopback interface. The seams the Rust side calls through are shared by
 * every wz Zephyr image and live in deploy/zephyr-common/wz_board_hooks.c.
 *
 * The verdict is the `ZEPHYR-WZ-TLS PASS` console sentinel under a QEMU timeout.
 */

#include <zephyr/kernel.h>
#include <zephyr/sys/printk.h>

/* Implemented in the wz Rust staticlib (libwz_zephyr_tls_loopback.a). Returns 0 = PASS. */
extern int wz_app_main(void);

/* wz_board_hooks.c: set the realtime clock to this build's instant. */
extern int wz_board_set_boot_clock(void);

int main(void)
{
	printk("zephyr-tls-loopback: boot ok; entering wz_app_main\n");

	if (wz_board_set_boot_clock() != 0) {
		printk("ZEPHYR-WZ-TLS FAIL rc=-1 (the board could not set its clock)\n");
		return 0;
	}

	int rc = wz_app_main();
	if (rc == 0) {
		printk("ZEPHYR-WZ-TLS PASS\n");
	} else {
		printk("ZEPHYR-WZ-TLS FAIL rc=%d\n", rc);
	}
	return 0;
}
```
