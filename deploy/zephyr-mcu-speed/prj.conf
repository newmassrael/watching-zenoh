## CMakeLists.txt
```
# SPDX-License-Identifier: LicenseRef-watching-zenoh-NonCommercial-1.0 OR LicenseRef-watching-zenoh-Commercial
# SPDX-FileCopyrightText: Copyright (c) 2026 newmassrael
#
# zephyr-mcu-speed -- the image of the MCU speed matrix (docs/mcu-speed-matrix.md): one program of the
# pico API (src/main.c) that runs one workload per boot, built in two arms on the same board, the same
# kernel and the same network stack, so that what differs between the two images is the library:
#
#   WZ_MCU_SPEED_ARM=P   zenoh-pico, built as the Zephyr module its tree is (vendor/zenoh-pico/zephyr)
#   WZ_MCU_SPEED_ARM=W   the pico C ABI of wz without std on the cooperative engine, the staticlib of
#                        deploy/zephyr-capi-pico/rust, compiled against zenoh-pico's own headers
#
# and in pico's two threading arms (WZ_MCU_SPEED_THREADS=st, the program steps the session; mt, the
# session's own read task does). Both arms take their feature switches from the one list below, so the
# program compiles to the same header in both.
#
#   west build -b mps2/an385 deploy/zephyr-mcu-speed -- -DWZ_MCU_SPEED_ARM=W -DWZ_MCU_SPEED_THREADS=st
#
# scripts/mcu-speed.sh builds the four images and runs them under QEMU.

cmake_minimum_required(VERSION 3.20.0)

set(WZ_MCU_SPEED_ARM "" CACHE STRING "The library under the program: P (zenoh-pico) or W (wz)")
set(WZ_MCU_SPEED_THREADS "st" CACHE STRING "pico's threading arm: st or mt")
if(NOT WZ_MCU_SPEED_ARM MATCHES "^(P|W)$")
  message(FATAL_ERROR "wz: WZ_MCU_SPEED_ARM is P or W, not '${WZ_MCU_SPEED_ARM}'.")
endif()
if(NOT WZ_MCU_SPEED_THREADS MATCHES "^(st|mt)$")
  message(FATAL_ERROR "wz: WZ_MCU_SPEED_THREADS is st or mt, not '${WZ_MCU_SPEED_THREADS}'.")
endif()

set(pico_src ${CMAKE_CURRENT_SOURCE_DIR}/../../vendor/zenoh-pico)
if(NOT EXISTS ${pico_src}/include/zenoh-pico/config.h.in)
  message(FATAL_ERROR "wz: vendor/zenoh-pico is empty; both arms compile against its headers "
                      "(git submodule update --init vendor/zenoh-pico).")
endif()

# The planes of the pico C ABI image (deploy/zephyr-capi-pico), with publication and subscription on,
# which the workloads put and receive through. The wz staticlib carries the queryable, the liveliness
# token and scouting whatever the header says, so they are on here too and the two arms differ in no
# switch. Matching is on because a publisher waits for its subscriber before the first counted put:
# a zenoh-pico publisher that knows of no subscriber returns success for a put it does not send.
set(mcu_speed_on
  Z_FEATURE_PUBLICATION Z_FEATURE_SUBSCRIPTION Z_FEATURE_MATCHING
  Z_FEATURE_QUERYABLE Z_FEATURE_LINK_UDP_UNICAST Z_FEATURE_LIVELINESS Z_FEATURE_INTEREST
  Z_FEATURE_FRAGMENTATION Z_FEATURE_ENCODING_VALUES Z_FEATURE_MULTICAST_TRANSPORT
  Z_FEATURE_UNICAST_TRANSPORT Z_FEATURE_TCP_NODELAY Z_FEATURE_SESSION_CHECK Z_FEATURE_BATCHING
  Z_FEATURE_UNICAST_PEER Z_FEATURE_AUTO_RECONNECT Z_FEATURE_SCOUTING)
set(mcu_speed_off
  Z_FEATURE_QUERY Z_FEATURE_LINK_TCP Z_FEATURE_LINK_UDP_MULTICAST Z_FEATURE_UNSTABLE_API
  Z_FEATURE_CONNECTIVITY Z_FEATURE_ADVANCED_PUBLICATION Z_FEATURE_ADVANCED_SUBSCRIPTION
  Z_FEATURE_LOCAL_SUBSCRIBER Z_FEATURE_LOCAL_QUERYABLE Z_FEATURE_ADMIN_SPACE
  Z_FEATURE_RAWETH_TRANSPORT Z_FEATURE_MULTICAST_DECLARATIONS Z_FEATURE_LINK_TLS Z_FEATURE_LINK_WS
  Z_FEATURE_LINK_SERIAL Z_FEATURE_LINK_SERIAL_USB Z_FEATURE_LINK_BLUETOOTH Z_FEATURE_RX_CACHE
  Z_FEATURE_BATCH_TX_MUTEX Z_FEATURE_BATCH_PEER_MUTEX)
if(WZ_MCU_SPEED_THREADS STREQUAL "mt")
  list(APPEND mcu_speed_on Z_FEATURE_MULTI_THREAD)
else()
  list(APPEND mcu_speed_off Z_FEATURE_MULTI_THREAD)
endif()

# Arm P states the switches as the module's Kconfig symbols (the module maps CONFIG_ZENOH_PICO_<X> to
# Z_FEATURE_<X>), written from the list above into a fragment of this build, so the list is the one
# place they are said. Arm W states the kernel's answers to the engine's operating system.
if(WZ_MCU_SPEED_ARM STREQUAL "P")
  list(APPEND ZEPHYR_EXTRA_MODULES ${pico_src})
  set(switches "CONFIG_ZENOH_PICO=y\n")
  foreach(feature ${mcu_speed_on})
    string(REPLACE Z_FEATURE CONFIG_ZENOH_PICO symbol ${feature})
    string(APPEND switches "${symbol}=y\n")
  endforeach()
  foreach(feature ${mcu_speed_off})
    string(REPLACE Z_FEATURE CONFIG_ZENOH_PICO symbol ${feature})
    string(APPEND switches "${symbol}=n\n")
  endforeach()
  set(switches_conf ${CMAKE_CURRENT_BINARY_DIR}/pico_switches.conf)
  file(WRITE ${switches_conf} "${switches}")
  list(APPEND EXTRA_CONF_FILE ${switches_conf})
else()
  list(APPEND EXTRA_CONF_FILE ${CMAKE_CURRENT_SOURCE_DIR}/arm_w.conf)
  # The read task's stack where zenoh-pico's mt arm keeps its tasks' stacks: not in the heap.
  if(WZ_MCU_SPEED_THREADS STREQUAL "mt")
    list(APPEND EXTRA_CONF_FILE ${CMAKE_CURRENT_SOURCE_DIR}/arm_w_mt.conf)
  endif()
endif()

find_package(Zephyr REQUIRED HINTS $ENV{ZEPHYR_BASE})
project(wz_zephyr_mcu_speed C)

include(${CMAKE_CURRENT_SOURCE_DIR}/../zephyr-common/wz_zephyr_board.cmake)

target_sources(app PRIVATE src/main.c)

if(WZ_MCU_SPEED_ARM STREQUAL "P")
  if(NOT CONFIG_ZENOH_PICO)
    message(FATAL_ERROR "wz: arm P has no zenoh-pico (CONFIG_ZENOH_PICO is off).")
  endif()
  target_compile_definitions(app PRIVATE MCU_SPEED_ARM_W=0)
else()
  if(NOT CONFIG_WZ_OS OR NOT CONFIG_WZ_PICO_OS)
    message(FATAL_ERROR "wz: the pico C ABI without std needs the kernel's answers to its host "
                        "layers (CONFIG_WZ_OS, CONFIG_WZ_PICO_OS).")
  endif()
  foreach(feature ${mcu_speed_on})
    set(${feature} 1 CACHE STRING "" FORCE)
  endforeach()
  foreach(feature ${mcu_speed_off})
    set(${feature} 0 CACHE STRING "" FORCE)
  endforeach()
  set(rust_features "")
  if(WZ_MCU_SPEED_THREADS STREQUAL "mt")
    list(APPEND rust_features multi-thread)
  endif()
  set(ZENOH_PICO_INCLUDEDIR ${pico_src}/include)
  include(${pico_src}/cmake/feature_config.cmake)
  zephyr_include_directories(${pico_src}/include ${CMAKE_CURRENT_BINARY_DIR}/include)
  zephyr_compile_definitions(ZENOH_ZEPHYR)
  target_compile_definitions(app PRIVATE MCU_SPEED_ARM_W=1)
  # The pins that hold the Rust layer to the header the program compiles against.
  target_sources(app PRIVATE
    ${CMAKE_CURRENT_SOURCE_DIR}/../../crates/wz-capi-pico/csrc/pico_layout_pins.c)
  # The staticlib without its board's MAC (its default feature): this board's Ethernet is Zephyr's
  # own driver. What only the Rust half calls is the sockets of the engine's links and the board's
  # socket hooks, kept through the image link as the pico C ABI image keeps them.
  wz_zephyr_rust_app(
    RUST_DIR ${CMAKE_CURRENT_SOURCE_DIR}/../zephyr-capi-pico/rust
    LIB      wz_zephyr_capi_pico
    NO_DEFAULT_FEATURES
    FEATURES ${rust_features}
    UNDEFINED
      socket bind getsockname sendto recvfrom poll close
      connect send recv getpeername shutdown setsockopt
      ${WZ_SOCKET_HOOKS}
  )
endif()
```

## Kconfig
```
# SPDX-License-Identifier: LicenseRef-watching-zenoh-NonCommercial-1.0 OR LicenseRef-watching-zenoh-Commercial
# SPDX-FileCopyrightText: Copyright (c) 2026 newmassrael

mainmenu "The MCU speed matrix: one pico API program over zenoh-pico or over wz"

rsource "../zephyr-common/Kconfig.wz"
# The limits arm W states for its session (arm_w.conf); arm P has no use for them.
rsource "../Kconfig.limits"

source "Kconfig.zephyr"
```

## prj.conf
```kconfig
# SPDX-License-Identifier: LicenseRef-watching-zenoh-NonCommercial-1.0 OR LicenseRef-watching-zenoh-Commercial
# SPDX-FileCopyrightText: Copyright (c) 2026 newmassrael
#
# The kernel, network and measurement settings both arms share (CMakeLists.txt chooses the library).
# Nothing here is a board's: the address and the random source are in boards/<board>.conf.

CONFIG_PRINTK=y
# The result lines carry 64-bit counts of cycles.
CONFIG_CBPRINTF_FULL_INTEGRAL=y

# The program reads its workload from the emulator's command line (SYS_GET_CMDLINE), so one image
# runs every cell of its arm.
CONFIG_SEMIHOST=y

# What the result lines are read from: the kernel's count of the cycles every thread but the idle
# thread ran, the high-water mark of every thread's stack, and the kernel heap's peak.
CONFIG_THREAD_RUNTIME_STATS=y
CONFIG_INIT_STACKS=y
CONFIG_THREAD_STACK_INFO=y
CONFIG_THREAD_MONITOR=y
CONFIG_THREAD_NAME=y
CONFIG_SYS_HEAP_RUNTIME_STATS=y

# Both libraries allocate from the kernel heap (zenoh-pico's z_malloc and the wz staticlib's
# allocator are k_malloc), and the stacks are reservations the report reads the use of.
CONFIG_MAIN_STACK_SIZE=16384
CONFIG_HEAP_MEM_POOL_SIZE=262144

CONFIG_POSIX_API=y
CONFIG_POSIX_THREADS_EXT=y
CONFIG_MAX_PTHREAD_MUTEX_COUNT=48
CONFIG_MAX_PTHREAD_COND_COUNT=24
CONFIG_POSIX_SYSTEM_INTERFACES=y
CONFIG_POSIX_TIMERS=y

CONFIG_NETWORKING=y
CONFIG_NET_L2_ETHERNET=y
CONFIG_NET_IPV4=y
CONFIG_NET_UDP=y
CONFIG_NET_TCP=n
CONFIG_NET_SOCKETS=y
CONFIG_NET_MAX_CONTEXTS=8
CONFIG_NET_CONTEXT_RCVTIMEO=y
CONFIG_NET_CONFIG_SETTINGS=y
CONFIG_NET_CONFIG_NEED_IPV4=y
CONFIG_NET_DHCPV4=n
# A throughput cell of 1,024-byte samples holds more datagrams in flight than the stack's default
# pools; the same pools in both arms, so a pool that runs dry costs both alike.
CONFIG_NET_PKT_RX_COUNT=32
CONFIG_NET_PKT_TX_COUNT=32
CONFIG_NET_BUF_RX_COUNT=128
CONFIG_NET_BUF_TX_COUNT=128
# The fragmenting cells (frag-rel, frag-be) receive samples past the batch, which the router sends in
# datagrams of up to the batch both libraries advertise (2,048 bytes), past the Ethernet MTU: the
# emulator's user network hands each in IPv4 fragments, and without reassembly the stack drops them for
# both arms alike. Two fragments make one such datagram, the option's default.
CONFIG_NET_IPV4_FRAGMENT=y
# The stack's counters of what it took in and dropped, which the image prints after its workload
# (MCU-SPEED NET): a cell that received nothing says whether its datagrams reached the UDP layer.
CONFIG_NET_STATISTICS=y
CONFIG_NET_STATISTICS_USER_API=y
CONFIG_NET_STATISTICS_IPV4=y
CONFIG_NET_STATISTICS_UDP=y

# Built for speed, and in arm W with the C library's memcpy family ahead of the staticlib's weak
# generic one, as the kit's comparison images are built (deploy/zephyr-capi-pico/prj.conf): without it
# the kernel and the network stack of arm W alone would run the staticlib's copies. Arm P links no
# staticlib, so its image has the C library's either way.
CONFIG_SPEED_OPTIMIZATIONS=y
CONFIG_WZ_LIBC_MEMCPY_FIRST=y
```

## arm_w.conf
```kconfig
# SPDX-License-Identifier: LicenseRef-watching-zenoh-NonCommercial-1.0 OR LicenseRef-watching-zenoh-Commercial
# SPDX-FileCopyrightText: Copyright (c) 2026 newmassrael
#
# Arm W: the pico C ABI of wz without std. The engine's mutex, condition variable, threads and sleep
# are the kernel's (wz_os_zephyr.c), and the platform exports' host layer is Zephyr's POSIX layer and
# the kernel heap (wz_pico_os_zephyr.c), as in the pico C ABI image (deploy/zephyr-capi-pico).
CONFIG_WZ_OS=y
CONFIG_WZ_OS_THREAD_STACK_SIZE=16384
# The single-threaded cells start no thread of the engine's, so they hold no stack for one; the
# multi-threaded arm states its read task (arm_w_mt.conf).
CONFIG_WZ_OS_THREADS=0
CONFIG_WZ_PICO_OS=y

# The image is a node of the pico preset: a limit zenoh-pico bounds by no constant of its own and
# this file leaves unstated takes the value zenoh-pico's own examples and API tests hold
# (deploy/Kconfig.limits, `[limit.pico_preset]` of deploy/wz-config.toml), not the one that sizes
# a host's session.
CONFIG_WZ_LIMITS_ZENOH_PICO=y

# The limits of this program's session (deploy/Kconfig.limits), each the number of rows or bytes of
# a table the session reserves when it opens and holds until it closes (docs/c-abi-no-heap-pools.md,
# section 5): one session, a client of one router, at most one subscriber and two publishers (the
# rtt cell's pong subscriber and its ping and stop publishers), keys of at most nine bytes, samples
# of at most 1,024 bytes, and no queryable, liveliness token or get. Left at the pico preset above,
# the entity tables hold what pico's API tests hold, while keys of 256 bytes and the tables of what
# the peer writes are still a host's (docs/c-abi-no-heap-pools.md, section 9). These are the numbers
# of this one program: a node with more to do states more. A table the program does not use keeps one
# row, and a peer that writes past a table is refused and counted, as each limit's own
# documentation says.
#
# zenoh-pico's own constants where it has one: the batch its module builds with
# (`vendor/zenoh-pico/zephyr/Kconfig.zenoh` @ `config ZENOH_PICO_BATCH_UNICAST_SIZE`, 2048) and the
# largest message it rejoins (`vendor/zenoh-pico/zephyr/Kconfig.zenoh` @
# `config ZENOH_PICO_FRAG_MAX_SIZE`, 4096). Stated, so that a change of the build's defaults does not
# change what is compared.
CONFIG_WZ_LIMIT_PICO_UNICAST_BATCH_BYTES=2048
CONFIG_WZ_LIMIT_PICO_FRAG_MAX_BYTES=4096
# The keys the program names, and the router's declarations that match them, are short.
CONFIG_WZ_LIMIT_MAX_KEYEXPR_BYTES=64
# The program's config holds two keys, its mode and the router's locator: "client" and a locator of
# at most MAX_LOCATOR_LEN (64), each with its terminator, 72 bytes of text.
CONFIG_WZ_LIMIT_CONFIG_ENTRIES=2
CONFIG_WZ_LIMIT_CONFIG_TEXT_BYTES=72
# The key arena every keyed row of the session keeps its key in. The 17 keyed rows at these limits
# (the one table set's 8: four declared keys, a subscriber, a queryable, a token and a liveliness
# subscriber; the engine record's 8: three write filters, a matching listener and four Interests;
# one pending get), with a key of the program's nine bytes, take a block of 20 each, 340 bytes; the
# rest holds 34 keys of that length the router declares (its subscriber on the key a publisher
# waits to match, the key ids it names it by, its interests). A key the router sends past that is
# dropped and counted.
CONFIG_WZ_LIMIT_KEY_ARENA_BYTES=1024
# The program's own entities. Each publisher declares its key and the subscriber its key's prefix.
CONFIG_WZ_LIMIT_MAX_SUBSCRIPTIONS=1
CONFIG_WZ_LIMIT_MAX_PUBLISHERS=2
CONFIG_WZ_LIMIT_MAX_DECLARED_KEYEXPRS=4
CONFIG_WZ_LIMIT_MAX_QUERIERS=1
CONFIG_WZ_LIMIT_MAX_MATCHING_LISTENERS=1
CONFIG_WZ_LIMIT_MAX_QUERYABLES=1
CONFIG_WZ_LIMIT_MAX_LOCAL_TOKENS=1
CONFIG_WZ_LIMIT_MAX_LIVELINESS_SUBSCRIPTIONS=1
CONFIG_WZ_LIMIT_MAX_PENDING_QUERIES=1
CONFIG_WZ_LIMIT_MAX_PENDING_LIVELINESS_GETS=1
# What the router writes to this client and is owed by it: its subscriber on the key a publisher
# waits to match, the key ids it names it by, and the answers to its interests.
CONFIG_WZ_LIMIT_MAX_REMOTE_DECLS=4
CONFIG_WZ_LIMIT_MAX_PEER_KEYEXPR_ALIASES=4
CONFIG_WZ_LIMIT_MAX_INBOUND_SUB_INTERESTS=2
CONFIG_WZ_LIMIT_MAX_PENDING_DECLARES=4
# No queryable answers anything.
CONFIG_WZ_LIMIT_MAX_PENDING_REPLIES=1
CONFIG_WZ_LIMIT_MAX_PENDING_FINALS=1
CONFIG_WZ_LIMIT_MAX_REPLY_PAYLOAD_BYTES=64
# An admin reply is staged as a reply, so the build holds its bound under the one above.
CONFIG_WZ_LIMIT_MAX_ADMIN_REPLY_BYTES=64
# The delivery lane the samples wait in between the read and the callback, held to one record of
# the largest message, the least the build accepts: 4,096 bytes rejoined, a key of 64, a clock id
# of 16 and one subscriber's id of 4, 4,180 bytes (crates/wz-capi-coop/src/lane.rs, `holds_a_read`).
# Each call that reads hands what it read to the callbacks before it returns, in either threading
# arm (`CoopEngine::read`: a step, then the delivery after the session's lock), and a link is read
# only while the lane has a record's room, so a pass takes one datagram, whose samples are one
# record of entries where they lie, as zenoh-pico's read takes one batch. zenoh-pico keeps no lane:
# it hands each sample to its callback from its receive buffer, with no lock to leave first.
CONFIG_WZ_LIMIT_DELIVERY_LANE_BYTES=4180
# The event slots of that lane (DELIVERY_LANE_EVENTS), one for each record that waits for its
# callbacks. The build sizes their storage, outside the arena on the heap: for each slot an entry
# of the lane's bookkeeping and of its rehearsal's copy, a place in the list handed on and the
# record of what a sample is besides its bytes, about 150 bytes, so the build's 64 are about 9,600
# bytes this program never fills. The samples of one datagram are one record however many it holds
# (crates/wz-capi-coop/src/tests/lane.rs,
# `a_lent_batch_takes_one_event_slot_however_many_samples_it_holds`), the link is read only while
# the lane has a free slot as well as a record's room, and the program's callbacks run before its
# next read, so a pass hands on a few records and a read that finds no slot waits in its link.
CONFIG_WZ_LIMIT_DELIVERY_LANE_EVENTS=8
```

## arm_w_mt.conf
```kconfig
# SPDX-License-Identifier: LicenseRef-watching-zenoh-NonCommercial-1.0 OR LicenseRef-watching-zenoh-Commercial
# SPDX-FileCopyrightText: Copyright (c) 2026 newmassrael
#
# Arm W, multi-threaded (WZ_MCU_SPEED_THREADS=mt), after arm_w.conf: the session's read task.
#
# The engine starts the read task through wz_os_thread_spawn (deploy/zephyr-common/wz_os_zephyr.c),
# whose thread record and stack of CONFIG_WZ_OS_THREAD_STACK_SIZE bytes are a static array of
# CONFIG_WZ_OS_THREADS, none of it kernel heap, as zenoh-pico's mt arm places its tasks' stacks
# (`vendor/zenoh-pico/src/system/zephyr/system.c` @
# `K_THREAD_STACK_ARRAY_DEFINE(thread_stack_area, Z_THREADS_NUM, Z_PTHREAD_STACK_SIZE_DEFAULT);`).
# The one thread this library starts.
CONFIG_WZ_OS_THREADS=1
```

## boards/mps2_an385.conf
```kconfig
# SPDX-License-Identifier: LicenseRef-watching-zenoh-NonCommercial-1.0 OR LicenseRef-watching-zenoh-Commercial
# SPDX-FileCopyrightText: Copyright (c) 2026 newmassrael
#
# What only the QEMU mps2/an385 board needs.
#
# QEMU's user-mode networking (`-nic user,model=lan9118`) hands the guest 10.0.2.15 and answers for
# the host at 10.0.2.2, where the lane's router listens. Pinned, not leased.
CONFIG_NET_CONFIG_MY_IPV4_ADDR="10.0.2.15"
CONFIG_NET_CONFIG_MY_IPV4_NETMASK="255.255.255.0"
CONFIG_NET_CONFIG_MY_IPV4_GW="10.0.2.2"

# QEMU mps2/an385 has no entropy hardware. The test generator is a fixture: its numbers are
# predictable, which a speed measurement does not mind and a deployment would.
CONFIG_TEST_RANDOM_GENERATOR=y
```

## src/main.c
```c
/* SPDX-License-Identifier: LicenseRef-watching-zenoh-NonCommercial-1.0 OR LicenseRef-watching-zenoh-Commercial
 * SPDX-FileCopyrightText: Copyright (c) 2026 newmassrael
 *
 * The program of the MCU speed matrix (docs/mcu-speed-matrix.md). It uses only the zenoh-pico C API, so
 * the same source is compiled against zenoh-pico (arm P) and linked to wz's pico C ABI (arm W), and it
 * speaks the protocol of the host matrix's probe (scripts/host-bench/perf_probe.c), which plays the
 * other side on the host: perf/ping and perf/pong carry a sequence number in their first eight bytes,
 * perf/stop ends a pong, and perf/thr carries the throughput samples.
 *
 * One boot runs one cell. The emulator's command line (semihosting SYS_GET_CMDLINE) names it:
 *
 *   mcu-speed <locator> put <size> <puts> 0 0
 *   mcu-speed <locator> sub <size> <window ms> <warm-up ms> 0     (size up to MAX_SUB_PAYLOAD)
 *   mcu-speed <locator> rtt <size> <round trips> <warm-up round trips> <timeout ms>
 *
 * The figures are the kernel's: cycles of its cycle counter, the cycles every thread but the idle
 * thread ran (the network stack's threads and the library's tasks with the program's), and after the
 * workload every thread's stack high-water mark and the kernel heap's peak. The host turns cycles into
 * instructions and time with the emulator's settings, which this program does not know. Nothing is
 * printed while a cell is measured.
 */

#include <stdatomic.h>
#include <stdint.h>
#include <stdlib.h>
#include <string.h>

#include <zephyr/arch/common/semihost.h>
#include <zephyr/kernel.h>
#include <zephyr/net/net_mgmt.h>
#include <zephyr/net/net_stats.h>
#include <zephyr/sys/printk.h>
#include <zephyr/sys/sys_heap.h>

#include <zenoh-pico.h>

#if Z_FEATURE_PUBLICATION != 1 || Z_FEATURE_SUBSCRIPTION != 1 || Z_FEATURE_MATCHING != 1
#error "the speed program puts, subscribes and waits for a match: its image turns those switches on"
#endif

#define KEY_PING "perf/ping"
#define KEY_PONG "perf/pong"
#define KEY_STOP "perf/stop"
#define KEY_THR "perf/thr"
#define SEQ_BYTES 8
#define MAX_PAYLOAD 1024
/* A received sample is only counted and never copied into `buf`, so the sub workload takes sizes past
 * the batch (2,048 bytes), which the router sends in fragments and the library rejoins, up to what both
 * libraries rejoin (a message of 4,096 bytes with its key and headers).
 */
#define MAX_SUB_PAYLOAD 3072
#define MAX_ROUND_TRIPS 2000
#define OPEN_ATTEMPTS 30
#define MATCH_WAIT_MS 20000
#define FIRST_SAMPLE_WAIT_MS 30000
/* What the network stack's threads still have to send when a put loop ends is the loop's cost too. */
#define SETTLE_MS 200
#define CMDLINE_BYTES 192
#define ARGS 7

/* The kernel heap k_malloc serves, which both libraries allocate from. */
extern struct k_heap _system_heap;

static z_owned_session_t session;

static int fail(const char *why)
{
	printk("MCU-SPEED FAIL why=%s\n", why);
	return -1;
}

/* The arguments of the emulator's command line, split at spaces, in place. */
static char cmdline[CMDLINE_BYTES];

static int read_args(char **argv, int max)
{
	struct {
		char *buf;
		long len;
	} block = {cmdline, (long)sizeof(cmdline) - 1};

	if (semihost_exec(SEMIHOST_GET_CMDLINE, &block) != 0 || block.len < 0 ||
	    block.len >= (long)sizeof(cmdline)) {
		return -1;
	}
	cmdline[block.len] = '\0';
	int argc = 0;
	char *at = cmdline;

	while (*at != '\0') {
		while (*at == ' ') {
			*at++ = '\0';
		}
		if (*at == '\0') {
			break;
		}
		if (argc == max) {
			return -1;
		}
		argv[argc++] = at;
		while (*at != '\0' && *at != ' ') {
			at++;
		}
	}
	return argc;
}

/* The cycles every thread but the idle thread has run since boot. */
static uint64_t busy_cycles(void)
{
	k_thread_runtime_stats_t stats;

	if (k_thread_runtime_stats_all_get(&stats) != 0) {
		return 0;
	}
	return stats.total_cycles;
}

/* One step of a wait: the program steps the session in the single-threaded arm, and the session's
 * own tasks run while the program sleeps in the multi-threaded one.
 */
static void step(void)
{
#if Z_FEATURE_MULTI_THREAD == 1
	k_msleep(1);
#else
	(void)zp_spin_once(z_session_loan(&session));
#endif
}

static void wait_ms(uint32_t ms)
{
	const int64_t until = k_uptime_get() + ms;

	while (k_uptime_get() < until) {
		step();
	}
}

static int open_session(const char *locator)
{
	for (int attempt = 0; attempt < OPEN_ATTEMPTS; attempt++) {
		z_owned_config_t config;

		z_config_default(&config);
		zp_config_insert(z_config_loan_mut(&config), Z_CONFIG_MODE_KEY, "client");
		zp_config_insert(z_config_loan_mut(&config), Z_CONFIG_CONNECT_KEY, locator);
		if (z_open(&session, z_config_move(&config), NULL) == Z_OK) {
			return 0;
		}
		k_sleep(K_SECONDS(1));
	}
	return -1;
}

static int declare_publisher(z_owned_publisher_t *pub, const char *key)
{
	z_view_keyexpr_t ke;
	z_publisher_options_t options;

	if (z_view_keyexpr_from_str(&ke, key) != Z_OK) {
		return -1;
	}
	z_publisher_options_default(&options);
	options.congestion_control = Z_CONGESTION_CONTROL_BLOCK;
	return z_declare_publisher(z_session_loan(&session), pub, z_view_keyexpr_loan(&ke), &options) ==
			       Z_OK
		       ? 0
		       : -1;
}

static void drop_nothing(void *context)
{
	(void)context;
}

static int declare_subscriber(const char *key, void (*callback)(z_loaned_sample_t *, void *))
{
	z_view_keyexpr_t ke;
	z_owned_closure_sample_t closure;

	if (z_view_keyexpr_from_str(&ke, key) != Z_OK) {
		return -1;
	}
	z_closure_sample(&closure, callback, drop_nothing, NULL);
	return z_declare_background_subscriber(z_session_loan(&session), z_view_keyexpr_loan(&ke),
					       z_closure_sample_move(&closure), NULL) == Z_OK
		       ? 0
		       : -1;
}

/* A zenoh-pico publisher that knows of no subscriber returns success for a put it does not send, so
 * no put is counted before the host's subscriber is matched.
 */
static int wait_for_match(const z_loaned_publisher_t *pub)
{
	const int64_t until = k_uptime_get() + MATCH_WAIT_MS;

	while (k_uptime_get() < until) {
		z_matching_status_t status;

		if (z_publisher_get_matching_status(pub, &status) == Z_OK && status.matching) {
			return 0;
		}
		step();
	}
	return -1;
}

static uint8_t buf[MAX_PAYLOAD];

/* ---- put: the program puts, the host's subscriber counts ---------------------------------------- */

static int run_put(uint32_t size, uint32_t count)
{
	z_owned_publisher_t pub;
	z_owned_bytes_t payload;

	if (declare_publisher(&pub, KEY_THR) != 0) {
		return fail("publisher");
	}
	const z_loaned_publisher_t *loaned = z_publisher_loan(&pub);

	if (wait_for_match(loaned) != 0) {
		return fail("no_subscriber_matched");
	}
	memset(buf, 1, size);
	if (z_bytes_copy_from_buf(&payload, buf, size) != Z_OK) {
		return fail("payload");
	}
	printk("MCU-SPEED READY workload=put size=%u\n", size);

	uint32_t sent = 0;
	uint32_t failed = 0;
	const uint64_t busy0 = busy_cycles();
	const uint32_t t0 = k_cycle_get_32();

	for (uint32_t i = 0; i < count; i++) {
		z_owned_bytes_t copy;

		z_bytes_clone(&copy, z_bytes_loan(&payload));
		if (z_publisher_put(loaned, z_bytes_move(&copy), NULL) == Z_OK) {
			sent++;
		} else {
			failed++;
		}
	}
	const uint32_t loop = k_cycle_get_32() - t0;

	k_msleep(SETTLE_MS);
	const uint64_t busy = busy_cycles() - busy0;

	printk("MCU-SPEED RESULT workload=put size=%u sent=%u failed=%u loop_cycles=%u busy_cycles=%llu "
	       "hz=%u\n",
	       size, sent, failed, loop, (unsigned long long)busy, (uint32_t)sys_clock_hw_cycles_per_sec());
	z_bytes_drop(z_bytes_move(&payload));
	return 0;
}

/* ---- sub: the host's publisher puts, the program counts ----------------------------------------- */

static atomic_uint thr_count;
static atomic_uint thr_bytes;

static void on_thr(z_loaned_sample_t *sample, void *context)
{
	(void)context;
	atomic_fetch_add_explicit(&thr_bytes, (unsigned int)z_bytes_len(z_sample_payload(sample)),
				  memory_order_relaxed);
	atomic_fetch_add_explicit(&thr_count, 1U, memory_order_relaxed);
}

static int run_sub(uint32_t size, uint32_t window_ms, uint32_t warm_ms)
{
	if (declare_subscriber(KEY_THR, on_thr) != 0) {
		return fail("subscriber");
	}
	printk("MCU-SPEED READY workload=sub size=%u\n", size);

	const int64_t until = k_uptime_get() + FIRST_SAMPLE_WAIT_MS;

	while (atomic_load(&thr_count) == 0U) {
		if (k_uptime_get() >= until) {
			return fail("no_sample_arrived");
		}
		step();
	}
	wait_ms(warm_ms);

	const unsigned int n0 = atomic_load(&thr_count);
	const unsigned int b0 = atomic_load(&thr_bytes);
	const uint64_t busy0 = busy_cycles();
	const uint32_t t0 = k_cycle_get_32();

	wait_ms(window_ms);

	const uint32_t window = k_cycle_get_32() - t0;
	const uint64_t busy = busy_cycles() - busy0;
	const unsigned int n1 = atomic_load(&thr_count);
	const unsigned int b1 = atomic_load(&thr_bytes);

	/* total says whether a window that took nothing followed a warm-up that did. */
	printk("MCU-SPEED RESULT workload=sub size=%u received=%u bytes=%u window_cycles=%u "
	       "busy_cycles=%llu hz=%u total=%u\n",
	       size, n1 - n0, b1 - b0, window, (unsigned long long)busy,
	       (uint32_t)sys_clock_hw_cycles_per_sec(), n1);
	return 0;
}

/* ---- rtt: the program pings, the host's pong answers -------------------------------------------- */

static atomic_uint last_answer;
static K_SEM_DEFINE(answered, 0, 1);
static uint32_t rtt_cycles[MAX_ROUND_TRIPS];

static void on_pong(z_loaned_sample_t *sample, void *context)
{
	uint8_t head[SEQ_BYTES] = {0};
	uint32_t seq;

	(void)context;
	z_bytes_reader_t reader = z_bytes_get_reader(z_sample_payload(sample));

	(void)z_bytes_reader_read(&reader, head, sizeof(head));
	/* The low word of the probe's little-endian sequence number: a run has far fewer round trips. */
	memcpy(&seq, head, sizeof(seq));
	atomic_store(&last_answer, seq);
	k_sem_give(&answered);
}

/* One round trip of the sequence number, in cycles, or 0 when no answer came within the timeout. */
static uint32_t round_trip(const z_loaned_publisher_t *pub, uint32_t size, uint32_t seq,
			   uint32_t timeout_ms)
{
	const uint64_t wide = seq;
	z_owned_bytes_t payload;

	memcpy(buf, &wide, sizeof(wide));
	if (z_bytes_copy_from_buf(&payload, buf, size) != Z_OK) {
		return 0;
	}
	k_sem_reset(&answered);
	const uint32_t t0 = k_cycle_get_32();

	if (z_publisher_put(pub, z_bytes_move(&payload), NULL) != Z_OK) {
		return 0;
	}
	const int64_t until = k_uptime_get() + timeout_ms;

	while (atomic_load(&last_answer) != seq) {
		if (k_uptime_get() >= until) {
			return 0;
		}
#if Z_FEATURE_MULTI_THREAD == 1
		(void)k_sem_take(&answered, K_MSEC(timeout_ms));
#else
		(void)zp_spin_once(z_session_loan(&session));
#endif
	}
	const uint32_t cycles = k_cycle_get_32() - t0;

	return cycles == 0U ? 1U : cycles;
}

static int compare_u32(const void *a, const void *b)
{
	const uint32_t x = *(const uint32_t *)a;
	const uint32_t y = *(const uint32_t *)b;

	return (x > y) - (x < y);
}

/* The nearest-rank percentile of n sorted values, as the host probe computes it. */
static uint32_t nearest_rank(const uint32_t *sorted, uint32_t n, uint32_t p)
{
	uint32_t rank = (uint32_t)(((uint64_t)p * n + 99U) / 100U);

	if (rank < 1U) {
		rank = 1U;
	}
	return sorted[rank - 1U];
}

static int run_rtt(uint32_t size, uint32_t count, uint32_t warm, uint32_t timeout_ms)
{
	z_owned_publisher_t ping;
	z_owned_publisher_t stop;

	if (count == 0U || count > MAX_ROUND_TRIPS) {
		return fail("round_trips_out_of_range");
	}
	/* The answers' subscriber first, so its declaration is on its way while the publisher is made. */
	if (declare_subscriber(KEY_PONG, on_pong) != 0) {
		return fail("subscriber");
	}
	if (declare_publisher(&ping, KEY_PING) != 0 || declare_publisher(&stop, KEY_STOP) != 0) {
		return fail("publisher");
	}
	const z_loaned_publisher_t *loaned = z_publisher_loan(&ping);

	if (wait_for_match(loaned) != 0) {
		return fail("no_subscriber_matched");
	}
	memset(buf, 1, size);
	printk("MCU-SPEED READY workload=rtt size=%u\n", size);

	uint32_t seq = 0;

	for (uint32_t i = 0; i < warm; i++) {
		(void)round_trip(loaned, size, ++seq, timeout_ms);
	}
	uint32_t counted = 0;
	uint32_t lost = 0;
	uint32_t attempts = 0;
	const uint64_t busy0 = busy_cycles();

	for (uint32_t i = 0; i < count; i++) {
		const uint32_t cycles = round_trip(loaned, size, ++seq, timeout_ms);

		attempts++;
		if (cycles > 0U) {
			rtt_cycles[counted++] = cycles;
		} else if (++lost > count / 10U) {
			break;
		}
	}
	const uint64_t busy = busy_cycles() - busy0;
	uint64_t sum = 0;

	if (counted == 0U) {
		return fail("no_round_trip_answered");
	}
	qsort(rtt_cycles, counted, sizeof(rtt_cycles[0]), compare_u32);
	for (uint32_t i = 0; i < counted; i++) {
		sum += rtt_cycles[i];
	}
	printk("MCU-SPEED RESULT workload=rtt size=%u round_trips=%u lost=%u attempts=%u p50_cycles=%u "
	       "p90_cycles=%u p99_cycles=%u min_cycles=%u max_cycles=%u mean_cycles=%u busy_cycles=%llu "
	       "hz=%u\n",
	       size, counted, lost, attempts, nearest_rank(rtt_cycles, counted, 50U),
	       nearest_rank(rtt_cycles, counted, 90U), nearest_rank(rtt_cycles, counted, 99U),
	       rtt_cycles[0], rtt_cycles[counted - 1U], (uint32_t)(sum / counted),
	       (unsigned long long)busy, (uint32_t)sys_clock_hw_cycles_per_sec());
	/* Three stops, apart: a datagram may be lost. */
	for (int i = 0; i < 3; i++) {
		z_owned_bytes_t payload;

		if (z_bytes_copy_from_buf(&payload, buf, SEQ_BYTES) == Z_OK) {
			(void)z_publisher_put(z_publisher_loan(&stop), z_bytes_move(&payload), NULL);
		}
		wait_ms(20);
	}
	return 0;
}

/* ---- memory ------------------------------------------------------------------------------------- */

static size_t stack_used_sum;

static void stack_of(const struct k_thread *thread, void *unused)
{
	size_t unused_bytes = 0;

	ARG_UNUSED(unused);
	if (k_thread_stack_space_get(thread, &unused_bytes) != 0) {
		return;
	}
	const size_t used = thread->stack_info.size - unused_bytes;
	const char *name = k_thread_name_get((k_tid_t)thread);

	stack_used_sum += used;
	printk("MCU-SPEED STACK thread=%s used=%u size=%u\n",
	       (name != NULL && name[0] != '\0') ? name : "unnamed", (unsigned int)used,
	       (unsigned int)thread->stack_info.size);
}

/* What the network stack took in and dropped over the boot: whether a workload's datagrams reached
 * the UDP layer, so a cell that received nothing tells a link that delivered nothing from a socket
 * that was not read.
 */
static void report_network(void)
{
	struct net_stats stats;

	if (net_mgmt(NET_REQUEST_STATS_GET_ALL, NULL, &stats, sizeof(stats)) != 0) {
		printk("MCU-SPEED NET unavailable=1\n");
		return;
	}
	printk("MCU-SPEED NET bytes_received=%u ipv4_recv=%u ipv4_drop=%u udp_recv=%u udp_drop=%u "
	       "processing_error=%u\n",
	       (unsigned int)stats.bytes.received, (unsigned int)stats.ipv4.recv,
	       (unsigned int)stats.ipv4.drop, (unsigned int)stats.udp.recv,
	       (unsigned int)stats.udp.drop, (unsigned int)stats.processing_error);
}

static void report_memory(void)
{
	struct sys_memory_stats stats = {0};

	stack_used_sum = 0;
	k_thread_foreach_unlocked(stack_of, NULL);
	(void)sys_heap_runtime_stats_get(&_system_heap.heap, &stats);
	printk("MCU-SPEED MEMORY stack_used=%u heap_peak=%u heap_size=%u\n", (unsigned int)stack_used_sum,
	       (unsigned int)stats.max_allocated_bytes,
	       (unsigned int)(stats.allocated_bytes + stats.free_bytes));
}

static int number(const char *text, uint32_t *out)
{
	char *end = NULL;
	const unsigned long value = strtoul(text, &end, 10);

	if (end == text || *end != '\0' || value > UINT32_MAX) {
		return -1;
	}
	*out = (uint32_t)value;
	return 0;
}

int main(void)
{
	char *argv[ARGS];
	uint32_t size;
	uint32_t count;
	uint32_t warm;
	uint32_t timeout_ms;

	printk("MCU-SPEED BOOT arm=%s threads=%s\n", MCU_SPEED_ARM_W ? "W" : "P",
	       Z_FEATURE_MULTI_THREAD == 1 ? "mt" : "st");
	if (read_args(argv, ARGS) != ARGS || number(argv[3], &size) != 0 ||
	    number(argv[4], &count) != 0 || number(argv[5], &warm) != 0 ||
	    number(argv[6], &timeout_ms) != 0) {
		return fail("usage");
	}
	const uint32_t most = strcmp(argv[2], "sub") == 0 ? MAX_SUB_PAYLOAD : MAX_PAYLOAD;

	if (size < SEQ_BYTES || size > most) {
		return fail("size_out_of_range");
	}
	if (open_session(argv[1]) != 0) {
		return fail("open");
	}

	int rc;

	if (strcmp(argv[2], "put") == 0) {
		rc = run_put(size, count);
	} else if (strcmp(argv[2], "sub") == 0) {
		rc = run_sub(size, count, warm);
	} else if (strcmp(argv[2], "rtt") == 0) {
		rc = run_rtt(size, count, warm, timeout_ms);
	} else {
		rc = fail("workload");
	}
	report_network();
	if (rc == 0) {
		report_memory();
		printk("MCU-SPEED DONE\n");
	}
	return 0;
}
```
