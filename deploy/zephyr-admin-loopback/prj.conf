## CMakeLists.txt
```
# SPDX-License-Identifier: LicenseRef-watching-zenoh-NonCommercial-1.0 OR LicenseRef-watching-zenoh-Commercial
# SPDX-FileCopyrightText: Copyright (c) 2026 newmassrael
#
# zephyr-admin-loopback -- the witness that an admin node on Zephyr's own sockets takes a secure
# channel and decides its lifecycle verbs by the zid the peer's key proved (decision D12 of
# docs/session-lifecycle-intent.md). Built as zephyr-tls-loopback is: Zephyr compiles the kernel,
# cargo emits the wz Rust staticlib, and Zephyr's final image link pulls them together.
# `west build -b mps2/an385 deploy/zephyr-admin-loopback` is the single entry point; the image runs
# alone under QEMU on the board's loopback interface.

cmake_minimum_required(VERSION 3.20.0)
find_package(Zephyr REQUIRED HINTS $ENV{ZEPHYR_BASE})
project(wz_zephyr_admin_loopback C)

include(${CMAKE_CURRENT_SOURCE_DIR}/../zephyr-common/wz_zephyr_board.cmake)

target_sources(app PRIVATE src/main.c)

# The channel's C side is compiled here, against Zephyr's own Mbed TLS (the crate is built without
# its `vendored`), exactly as the admin node's `CONFIG_WZ_TLS` and zephyr-tls-loopback do.
set(tls_src ${CMAKE_CURRENT_SOURCE_DIR}/../../crates/wz-tls-mbedtls)
target_sources(app PRIVATE ${tls_src}/csrc/wz_tls.c)
target_include_directories(app PRIVATE ${tls_src}/csrc)
target_include_directories(mbedtls_iface INTERFACE ${tls_src}/config/zephyr)

# Besides the sockets and the channel, the board's socket hooks and the hook of the node's own
# address, of the family the image chose for it: the node waits for that address before it starts.
wz_node_address_hooks(node_address_hooks)
wz_zephyr_rust_app(
  RUST_DIR ${CMAKE_CURRENT_SOURCE_DIR}/rust
  LIB      wz_zephyr_admin_loopback
  UNDEFINED
    socket bind getsockname sendto recvfrom poll close
    connect send recv getpeername shutdown setsockopt listen accept
    ${WZ_SOCKET_HOOKS} ${node_address_hooks}
    wz_tls_start wz_tls_arena_peak wz_tls_arena_peak_reset
    wz_tls_identity_generate wz_tls_identity_zid wz_tls_identity_cert wz_tls_identity_free
    wz_tls_session_open wz_tls_session_set_io_ctx wz_tls_session_handshake
    wz_tls_session_peer_zid wz_tls_session_suite wz_tls_session_write wz_tls_session_read
    wz_tls_session_pending wz_tls_session_close_notify wz_tls_session_free
)
```

## Kconfig
```
# SPDX-License-Identifier: LicenseRef-watching-zenoh-NonCommercial-1.0 OR LicenseRef-watching-zenoh-Commercial
# SPDX-FileCopyrightText: Copyright (c) 2026 newmassrael

mainmenu "wz Zephyr admin-node witness"

rsource "../zephyr-common/Kconfig.wz"

source "Kconfig.zephyr"
```

## prj.conf
```kconfig
# SPDX-License-Identifier: LicenseRef-watching-zenoh-NonCommercial-1.0 OR LicenseRef-watching-zenoh-Commercial
# SPDX-FileCopyrightText: Copyright (c) 2026 newmassrael
#
# zephyr-admin-loopback Kconfig: an admin node and its dialling client on Zephyr's own TCP over the
# loopback interface, the secure channel between them. What only the QEMU board needs is in
# boards/<board>.conf.

CONFIG_PRINTK=y

# The kernel heap is the network stack's and the POSIX layer's: the Rust image has no allocator.
CONFIG_HEAP_MEM_POOL_SIZE=65536

# One thread runs both nodes and both roles of the handshake, one at a time and never nested but by
# the dial that steps the admin node. The fixed-memory admin node asks 32 KB of its main thread
# (overlays/t2g_fixed.conf), and the channel's handshake frames sit on top of that.
CONFIG_MAIN_STACK_SIZE=32768
CONFIG_INIT_STACKS=y
CONFIG_THREAD_STACK_INFO=y

# Zephyr's own stack over the loopback interface, reached through the POSIX socket layer (the
# route zenoh-pico's Zephyr port takes). TCP is the stream under the channel.
CONFIG_NETWORKING=y
CONFIG_NET_IPV4=y
CONFIG_NET_UDP=y
CONFIG_NET_TCP=y
CONFIG_NET_LOOPBACK=y
CONFIG_NET_SLIP_TAP=n
CONFIG_POSIX_SYSTEM_INTERFACES=y
CONFIG_POSIX_NETWORKING=y
CONFIG_POSIX_TIMERS=y
CONFIG_POSIX_DEVICE_IO=y

# A TLS server's first flight is five records (the hello, the change-cipher-spec and the handshake
# messages), and Zephyr's TCP holds every segment it sent as a packet until the peer acknowledges
# it. At the default of 4 TX packets the fifth `send` failed (measured on deploy/zephyr-tls-loopback:
# the server was dropped before its Finished and its peer read an end of stream), so the pools below
# hold a flight and the peer's reply with room to spare. Each connection of a run is a context, and
# a closed one lingers in TIME_WAIT.
CONFIG_NET_MAX_CONTEXTS=16
CONFIG_NET_PKT_RX_COUNT=16
CONFIG_NET_PKT_TX_COUNT=16
CONFIG_NET_BUF_RX_COUNT=64
CONFIG_NET_BUF_TX_COUNT=64

# Mbed TLS on its PSA Crypto line, as the fit image and the admin node state it: TLS 1.3 only, the
# ephemeral key exchange, ECDSA over P-256, AES-128-GCM with SHA-256, the certificate each end
# writes over its own key and the peer's it reads.
CONFIG_PSA_CRYPTO=y
CONFIG_PSA_CRYPTO_PROVIDER_MBEDTLS=y
CONFIG_MBEDTLS=y
CONFIG_MBEDTLS_BUILTIN=y
CONFIG_MBEDTLS_PSA_CRYPTO_C=y
CONFIG_MBEDTLS_SSL_PROTO_TLS1_2=n
CONFIG_MBEDTLS_SSL_PROTO_TLS1_3=y
CONFIG_MBEDTLS_SSL_TLS1_3_KEY_EXCHANGE_MODE_EPHEMERAL_ENABLED=y
CONFIG_MBEDTLS_SSL_TLS1_3_KEY_EXCHANGE_MODE_PSK_ENABLED=n
CONFIG_MBEDTLS_SSL_TLS1_3_KEY_EXCHANGE_MODE_PSK_EPHEMERAL_ENABLED=n
CONFIG_MBEDTLS_SSL_SESSION_TICKETS=n
CONFIG_MBEDTLS_X509_CRT_PARSE_C=y
CONFIG_MBEDTLS_X509_CRT_WRITE_C=y
CONFIG_MBEDTLS_PK_WRITE_C=y
CONFIG_MBEDTLS_USER_CONFIG_FILE="wz_tls_zephyr_user_config.h"
CONFIG_PSA_WANT_ECC_SECP_R1_256=y
CONFIG_PSA_WANT_KEY_TYPE_ECC_KEY_PAIR_GENERATE=y
CONFIG_PSA_WANT_KEY_TYPE_ECC_KEY_PAIR_IMPORT=y
CONFIG_PSA_WANT_KEY_TYPE_ECC_KEY_PAIR_EXPORT=y
CONFIG_PSA_WANT_KEY_TYPE_ECC_PUBLIC_KEY=y
CONFIG_PSA_WANT_ALG_ECDSA=y
CONFIG_PSA_WANT_ALG_ECDH=y
CONFIG_PSA_WANT_ALG_SHA_256=y
CONFIG_PSA_WANT_ALG_HMAC=y
CONFIG_PSA_WANT_ALG_HKDF_EXTRACT=y
CONFIG_PSA_WANT_ALG_HKDF_EXPAND=y
CONFIG_PSA_WANT_KEY_TYPE_AES=y
CONFIG_PSA_WANT_ALG_GCM=y
CONFIG_MBEDTLS_PSA_CRYPTO_LEGACY_RNG=y

# The record buffers decided in Round 3495: receive the protocol's maximum, send 1,500 bytes.
CONFIG_MBEDTLS_SSL_IN_CONTENT_LEN=16384
CONFIG_MBEDTLS_SSL_OUT_CONTENT_LEN=1500

# Every allocation Mbed TLS makes comes from one static arena. Both ends live at once (two sessions
# at about 22 KB each, Round 3495, and two identities), so the arena is the fit image's 96 KB.
CONFIG_MBEDTLS_ENABLE_HEAP=y
CONFIG_MBEDTLS_HEAP_SIZE=98304
CONFIG_MBEDTLS_MEMORY_DEBUG=y
```

## src/main.c
```c
/* SPDX-License-Identifier: LicenseRef-watching-zenoh-NonCommercial-1.0 OR LicenseRef-watching-zenoh-Commercial
 * SPDX-FileCopyrightText: Copyright (c) 2026 newmassrael
 *
 * zephyr-admin-loopback C entry: Zephyr boots and runs `main()` on the main thread, and `main()`
 * hands that thread to the wz Rust staticlib (`wz_app_main`), which runs an admin node and the
 * client that dials it over the board's loopback interface. The seams the Rust side calls through
 * are shared by every wz Zephyr image and live in deploy/zephyr-common/wz_board_hooks.c.
 *
 * The verdict is the `ZEPHYR-WZ-ADMIN-TLS PASS` console sentinel under a QEMU timeout.
 */

#include <zephyr/kernel.h>
#include <zephyr/sys/printk.h>

/* Implemented in the wz Rust staticlib (libwz_zephyr_admin_loopback.a). Returns 0 = PASS. */
extern int wz_app_main(void);

/* wz_board_hooks.c: set the realtime clock to this build's instant. */
extern int wz_board_set_boot_clock(void);

int main(void)
{
	printk("zephyr-admin-loopback: boot ok; entering wz_app_main\n");

	if (wz_board_set_boot_clock() != 0) {
		printk("ZEPHYR-WZ-ADMIN-TLS FAIL rc=-1 (the board could not set its clock)\n");
		return 0;
	}

	int rc = wz_app_main();
	if (rc == 0) {
		printk("ZEPHYR-WZ-ADMIN-TLS PASS\n");
	} else {
		printk("ZEPHYR-WZ-ADMIN-TLS FAIL rc=%d\n", rc);
	}
	return 0;
}
```
