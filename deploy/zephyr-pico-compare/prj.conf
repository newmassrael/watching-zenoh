## CMakeLists.txt
```
# SPDX-License-Identifier: LicenseRef-watching-zenoh-NonCommercial-1.0 OR LicenseRef-watching-zenoh-Commercial
# SPDX-FileCopyrightText: Copyright (c) 2026 newmassrael
#
# zephyr-pico-compare -- zenoh-pico on the T2G kit, over Zephyr's own network stack and the same
# Ethernet driver (deploy/zephyr-eth-wzmac) the wz admin node's Zephyr-sockets image runs on, so
# that the two can be measured on one controller, one driver and one stack. zenoh-pico is built as
# the Zephyr module its tree is (vendor/zenoh-pico/zephyr); the only wz in the image is the MAC
# crate behind the driver.
# `west build -b kit_t2g_b_h_lite/cyt4bf8cds/m7_0 deploy/zephyr-pico-compare` is the entry point.

cmake_minimum_required(VERSION 3.20.0)
include(${CMAKE_CURRENT_SOURCE_DIR}/../zephyr-eth-wzmac/zeth.cmake)
list(APPEND ZEPHYR_EXTRA_MODULES ${CMAKE_CURRENT_SOURCE_DIR}/../../vendor/zenoh-pico)
find_package(Zephyr REQUIRED HINTS $ENV{ZEPHYR_BASE})
project(wz_zephyr_pico_compare C)

include(${CMAKE_CURRENT_SOURCE_DIR}/../zephyr-common/wz_zephyr_board.cmake)

# Since 1.10.2 zenoh-pico's Zephyr module takes every feature switch and every value (batch and
# fragment sizes, the lease, the socket timeout, the task limit) from Kconfig and makes its own
# `zenoh-pico/config.h` from them (cmake/feature_config.cmake), so the image states them in
# prj.conf and nothing here makes a header. Up to 1.10.1 the module listed twelve switches and
# the rest came from a configure-only run of the library's CMake on the host, which this file
# carried; the module's Kconfig has no default for a switch, so prj.conf now states the ones the
# library's own default build has on, to keep the image the configuration it was measured as.
zephyr_compile_definitions_ifdef(CONFIG_PICO_COMPARE_DEBUG ZENOH_DEBUG=3)

target_sources(app PRIVATE src/main.c)

if(NOT CONFIG_WZ_ZETH)
  message(FATAL_ERROR "wz: the comparison image has no network without the Ethernet driver "
                      "(the devicetree overlay states its node).")
endif()
wz_zeth_driver()

# The board's pieces the driver calls: the chip's TRNG (the entropy device's source), the clock
# register read, and the pin routing. They are the admin node's, which also compiles them.
set(admin_src ${CMAKE_CURRENT_SOURCE_DIR}/../zephyr-admin-node)
set(pdl_src ${ZEPHYR_HAL_INFINEON_MODULE_DIR}/mtb-pdl-cat1/drivers/source)
target_sources(app PRIVATE
  ${admin_src}/src/trng_cat1c.c
  ${pdl_src}/cy_crypto_core_trng.c
  ${pdl_src}/cy_crypto_core_hw.c
  ${admin_src}/src/clock_cat1c.c)
if(CONFIG_WZ_CYT4BF_PINS_T2G_LITE)
  target_sources(app PRIVATE ${admin_src}/boards/kit_t2g_b_h_lite/eth0_rmii_pins.c)
else()
  message(FATAL_ERROR "wz: CONFIG_WZ_ZETH needs a pin routing (CONFIG_WZ_CYT4BF_PINS_*).")
endif()

wz_zephyr_rust_app(
  RUST_DIR ${CMAKE_CURRENT_SOURCE_DIR}/rust
  LIB      wz_zephyr_pico_compare
  UNDEFINED
    wz_board_eth_pins_init wz_board_entropy_fill
    wz_zeth_open wz_zeth_transmit wz_zeth_receive wz_zeth_poll_link wz_zeth_link_up
)
```

## Kconfig
```
# SPDX-License-Identifier: LicenseRef-watching-zenoh-NonCommercial-1.0 OR LicenseRef-watching-zenoh-Commercial
# SPDX-FileCopyrightText: Copyright (c) 2026 newmassrael

mainmenu "zenoh-pico comparison node on the T2G kit"

rsource "../zephyr-common/Kconfig.wz"
rsource "../zephyr-eth-wzmac/Kconfig.zeth"

config PICO_COMPARE_LOCATOR
	string "The router the node connects to"
	default "udp/192.168.100.1:7447"
	help
	  zenoh-pico runs as a client of a router on the bench host, over UDP unicast: the
	  link the wz admin node's session runs over. The router listens on this locator.

config PICO_COMPARE_DEBUG
	bool "zenoh-pico's own debug log on the console"
	help
	  Builds the library with ZENOH_DEBUG=3. For finding out why a session does not come up;
	  never for a measurement, since every line is a write to a 115200 baud UART.

source "Kconfig.zephyr"
```

## prj.conf
```kconfig
# SPDX-License-Identifier: LicenseRef-watching-zenoh-NonCommercial-1.0 OR LicenseRef-watching-zenoh-Commercial
# SPDX-FileCopyrightText: Copyright (c) 2026 newmassrael
#
# zenoh-pico on the T2G kit over Zephyr's own stack. The network settings are Zephyr's defaults
# wherever the wz admin node's Zephyr-sockets image (deploy/zephyr-admin-node, overlays/
# t2g_zeth.conf) takes Zephyr's defaults too, so that the two stacks sit on the same buffers.

CONFIG_PRINTK=y

# zenoh-pico's tasks are POSIX threads, each on a stack the size of the main thread's.
CONFIG_MAIN_STACK_SIZE=8192
# The kernel heap pool, by the rule the wz heap client's pool follows: a quarter of it free, the floor
# HW.7 asks of a main stack (`peak * 4 <= pool * 3`). The compare run reads a heap peak of 9,280 bytes
# in the single-threaded arm and 9,384 in the multi-threaded one: 9,384 * 4 / 3 = 12,512, and 13,312 is
# that in units of 1,024. The single-threaded arm answered with a pool of 9,728 bytes and never
# answered with 9,216, so the pool is a margin over the least it runs in and not that least. It was
# 131,072 (the figure the wz heap client started from, so that the first comparison was of two images
# configured alike).
CONFIG_HEAP_MEM_POOL_SIZE=13312
CONFIG_POSIX_API=y
# zenoh-pico makes recursive mutexes (pthread_mutexattr_settype) and a mutex or condition variable for
# every part of a session; Zephyr's pools of them hold five each by default, which a session overruns
# with ENOMEM before it is open.
CONFIG_POSIX_THREADS_EXT=y
CONFIG_MAX_PTHREAD_MUTEX_COUNT=48
CONFIG_MAX_PTHREAD_COND_COUNT=24
CONFIG_POSIX_SYSTEM_INTERFACES=y
CONFIG_POSIX_TIMERS=y

CONFIG_NETWORKING=y
CONFIG_NET_L2_ETHERNET=y
CONFIG_NET_IPV4=y
CONFIG_NET_UDP=y
CONFIG_NET_TCP=n
CONFIG_NET_SOCKETS=y
CONFIG_NET_MAX_CONTEXTS=8
# zenoh-pico bounds every read with SO_RCVTIMEO (its UDP link sets it at open). Without this option
# Zephyr refuses it, the read has no bound, and a handshake whose first datagram is lost waits for
# ever.
CONFIG_NET_CONTEXT_RCVTIMEO=y
CONFIG_NET_CONFIG_SETTINGS=y
CONFIG_NET_CONFIG_NEED_IPV4=y

# The segment the admin node answers on, pinned and not leased.
CONFIG_NET_DHCPV4=n
CONFIG_NET_CONFIG_MY_IPV4_ADDR="192.168.100.10"
CONFIG_NET_CONFIG_MY_IPV4_NETMASK="255.255.255.0"

# The MAC's DMA rings are in the non-cacheable section (the M7 has a data cache the controller does
# not see), and the image turns the core's caches on at boot as the admin node's does.
CONFIG_NOCACHE_MEMORY=y
CONFIG_WZ_ENABLE_CORE_CACHES=y
CONFIG_WZ_CYT4BF_PINS_T2G_LITE=y

# The driver polls the MAC without sleeping, as the admin node's Zephyr-sockets image is built to
# in the measurements this image is for.
CONFIG_WZ_ZETH_RX_POLL_INTERVAL_US=0

# The same ITCM placement of the polling path as the admin node's overlay has, so that the two are
# compared in one configuration (CONFIG_WZ_POLL_PATH_IN_ITCM).
CONFIG_WZ_POLL_PATH_IN_ITCM=y

# Built for speed, and with the C library's memcpy ahead of the Rust staticlib (the staticlib here
# is only the MAC), exactly as the admin node's overlay (deploy/zephyr-admin-node/overlays/
# t2g_zeth.conf) is, so that the two are compared in one configuration. Measured on the kit: a GET
# answered by this image takes 0.406 ms with speed alone and 0.380 with the memcpy as well; size
# optimization gives 0.37 to 0.41, within what the bench varies between sessions.
CONFIG_SPEED_OPTIMIZATIONS=y
CONFIG_WZ_LIBC_MEMCPY_FIRST=y

# zenoh-pico with the planes the wz client it is compared with has, and no others
# (docs/upstream-parity.md step M2): that client answers queries over UDP unicast and neither
# publishes, subscribes nor asks, so pico's queryable half is on and its publication, subscription
# and query halves are off; TCP and multicast are off, as the wz image has no TCP. Scouting is on
# (below), as in pico's default build and in the pico C ABI image over wz; the wz client node does
# not scout, which a cell against it reads as a plane pico carries and it does not. Until 2026-10-26 this image also had publication, subscription and query on,
# which made its text larger than the comparison's, in wz's favour. The other switches are pico's
# own defaults, stated here one by one because the module's Kconfig has no default for a switch
# (since 1.10.2; before it, a switch the module did not list took the library's default from the
# header the host configure made). Whether pico runs its read and lease tasks is the image's
# choice of arm: overlays/multi_thread.conf turns them on, and without it the program steps the
# session (`zp_spin_once`); a compare run measures both, and the stronger arm is the reference.
CONFIG_ZENOH_PICO=y
CONFIG_ZENOH_PICO_QUERYABLE=y
CONFIG_ZENOH_PICO_LINK_UDP_UNICAST=y
CONFIG_ZENOH_PICO_LIVELINESS=y
CONFIG_ZENOH_PICO_INTEREST=y
CONFIG_ZENOH_PICO_FRAGMENTATION=y
CONFIG_ZENOH_PICO_ENCODING_VALUES=y
CONFIG_ZENOH_PICO_MULTICAST_TRANSPORT=y
CONFIG_ZENOH_PICO_UNICAST_TRANSPORT=y
CONFIG_ZENOH_PICO_TCP_NODELAY=y
CONFIG_ZENOH_PICO_SESSION_CHECK=y
CONFIG_ZENOH_PICO_BATCHING=y
CONFIG_ZENOH_PICO_MATCHING=y
CONFIG_ZENOH_PICO_UNICAST_PEER=y
CONFIG_ZENOH_PICO_AUTO_RECONNECT=y
# Scouting, on as in pico's default build: the pico C ABI image over wz (deploy/zephyr-capi-pico)
# scouts when its locator is empty, and the two images are compared on the same planes, which
# `scripts/kit-lane.sh --selftest` holds switch by switch.
CONFIG_ZENOH_PICO_SCOUTING=y
```

## boards/kit_t2g_b_h_lite_cyt4bf8cds_m7_0.overlay
```dts
/* SPDX-License-Identifier: LicenseRef-watching-zenoh-NonCommercial-1.0 OR LicenseRef-watching-zenoh-Commercial
 * SPDX-FileCopyrightText: Copyright (c) 2026 newmassrael
 *
 * The T2G kit's Ethernet and entropy source as Zephyr devices: what turns the drivers of
 * deploy/zephyr-eth-wzmac on. The same two nodes as the admin node's
 * overlays/t2g_zeth.overlay.
 */

/ {
	chosen {
		zephyr,entropy = &wz_trng;
	};

	wz_trng: wz-trng {
		compatible = "wz,cyt4bf-trng";
	};

	/* The PHY of this kit drives the RMII reference clock (`ref-clock-divider` stays 0). The
	 * station address is drawn at every boot.
	 */
	wz_eth: wz-eth {
		compatible = "wz,cyt4bf-eth";
		zephyr,random-mac-address;
	};
};
```

## src/main.c
```c
/* SPDX-License-Identifier: LicenseRef-watching-zenoh-NonCommercial-1.0 OR LicenseRef-watching-zenoh-Commercial
 * SPDX-FileCopyrightText: Copyright (c) 2026 newmassrael
 *
 * zenoh-pico on the T2G kit: a client of the bench host's router that answers the two GETs the
 * wz admin node answers, with the same keys' shape, the same JSON bodies and the same encoding,
 * so that a GET through the router costs the same bytes whichever of the two sits behind it.
 *
 * The queryables print nothing: a console line on a 115200 baud UART is a hundred times the
 * time of the answer, and the answer is what is measured. The count of GETs answered is
 * printed from the main thread, every ten seconds, and only when it has moved.
 */

#include <stdatomic.h>
#include <stdint.h>
#include <string.h>

#include <zephyr/kernel.h>
#include <zephyr/sys/printk.h>

#include <zenoh-pico.h>

/* The identifier the admin node's keys carry, a fixed twelve hex digits, as the node's own are:
 * the keys are as long, and so is every message that names one.
 */
#define NODE_ID "5a1c0ffee001"
#define STATUS_KEY "@/" NODE_ID "/peer/status/connect"
#define CONFIG_KEY "@/" NODE_ID "/peer/config"

/* The bodies the admin node replies with on the same two paths, verbatim. */
static const char STATUS_BODY[] = "{\"endpoints\":[],\"last_write\":null,\"permissions\":{\"write\":true}}";
static const char CONFIG_BODY[] = "{\"adminspace\":{\"permissions\":{\"write\":true}},\"connect\":{\"endpoints\":[]}}";

static atomic_uint answered;

static void query_handler(z_loaned_query_t *query, void *ctx)
{
	const char *body = ctx;
	z_owned_bytes_t payload;
	z_owned_encoding_t encoding;
	z_query_reply_options_t options;

	z_bytes_from_static_str(&payload, body);
	z_query_reply_options_default(&options);
	z_encoding_clone(&encoding, z_encoding_application_json());
	options.encoding = z_move(encoding);
	z_query_reply(query, z_query_keyexpr(query), z_move(payload), &options);
	atomic_fetch_add(&answered, 1);
}

static int declare(const z_loaned_session_t *session, z_owned_queryable_t *queryable,
		   const char *key, const char *body)
{
	z_owned_closure_query_t callback;
	z_view_keyexpr_t keyexpr;

	z_closure(&callback, query_handler, NULL, (void *)body);
	if (z_view_keyexpr_from_str(&keyexpr, key) < 0) {
		return -1;
	}
	return z_declare_queryable(session, queryable, z_loan(keyexpr), z_move(callback), NULL);
}

int main(void)
{
	z_owned_session_t session;

	printk("zephyr-pico-compare: boot ok\n");

	/* The interface has no carrier until the MAC is up and the PHY says so, and no address
	 * until the stack is: try until the router answers.
	 */
	for (unsigned int attempt = 1;; attempt++) {
		z_owned_config_t config;

		z_config_default(&config);
		zp_config_insert(z_loan_mut(config), Z_CONFIG_MODE_KEY, "client");
		/* As upstream's examples/zephyr/z_queryable.c: a locator given is dialled, and an
		 * empty one leaves the open to scout for a router (Z_FEATURE_SCOUTING).
		 */
		if (strlen(CONFIG_PICO_COMPARE_LOCATOR) > 0) {
			zp_config_insert(z_loan_mut(config), Z_CONFIG_CONNECT_KEY,
					 CONFIG_PICO_COMPARE_LOCATOR);
		}
		z_result_t rc = z_open(&session, z_move(config), NULL);

		if (rc >= 0) {
			break;
		}
		/* Before the first query, so the line costs nothing that is measured. */
		printk("zephyr-pico-compare: z_open to %s failed (%d), attempt %u\n",
		       CONFIG_PICO_COMPARE_LOCATOR, (int)rc, attempt);
		k_sleep(K_SECONDS(1));
	}

	z_owned_queryable_t status_queryable;
	z_owned_queryable_t config_queryable;

	if (declare(z_loan(session), &status_queryable, STATUS_KEY, STATUS_BODY) < 0 ||
	    declare(z_loan(session), &config_queryable, CONFIG_KEY, CONFIG_BODY) < 0) {
		printk("ZEPHYR-PICO FAIL the queryables were not declared\n");
		return 0;
	}
	printk("ZEPHYR-PICO READY %s %s\n", NODE_ID, CONFIG_PICO_COMPARE_LOCATOR);

	unsigned int reported = 0;

#if Z_FEATURE_MULTI_THREAD == 1
	/* The multi-threaded arm: the session's own read and lease tasks answer; `main` only reports. */
	for (;;) {
		k_sleep(K_SECONDS(10));
		unsigned int now = atomic_load(&answered);

		if (now != reported) {
			reported = now;
			printk("zephyr-pico-compare: %u GET(s) answered\n", now);
		}
	}
#else
	/* The single-threaded arm: `main` steps the session, and every read, keep-alive and lease
	 * check runs in `zp_spin_once`, which pico's own single-threaded examples call in a loop. A
	 * read waits on its socket for at most the link's timeout, so the loop does not spin while the
	 * session is quiet, and a query is answered by the call that reads it.
	 */
	int64_t next_report = k_uptime_get() + 10 * MSEC_PER_SEC;

	while (zp_spin_once(z_loan(session))) {
		if (k_uptime_get() >= next_report) {
			next_report += 10 * MSEC_PER_SEC;
			unsigned int now = atomic_load(&answered);

			if (now != reported) {
				reported = now;
				printk("zephyr-pico-compare: %u GET(s) answered\n", now);
			}
		}
	}
	printk("ZEPHYR-PICO FAIL the session closed\n");
#endif
	return 0;
}
```
