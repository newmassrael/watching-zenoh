## CMakeLists.txt
```
# SPDX-License-Identifier: LicenseRef-watching-zenoh-NonCommercial-1.0 OR LicenseRef-watching-zenoh-Commercial
# SPDX-FileCopyrightText: Copyright (c) 2026 newmassrael
#
# zephyr-admin-node -- a wz node a zenoh host reconfigures at runtime, as a Zephyr
# application. Path B, like deploy/zephyr-app: Zephyr compiles the kernel, cargo
# emits the wz Rust staticlib, Zephyr's final image link joins them.
# `west build -b <board> deploy/zephyr-admin-node` is the entry point.
#
# The board is an ARGUMENT. The Rust target triple, the tick rate and the random
# source come from the board's Kconfig (deploy/zephyr-common/wz_zephyr_board.cmake),
# the node's address and identity from the board's network interface at run time
# (Zephyr's stack) or from the board's Kconfig (the lwIP backend, which has no
# Zephyr interface to ask), and the network stack from CONFIG_WZ_NET_BACKEND_*. What
# only one board needs is in boards/<board>.conf.

cmake_minimum_required(VERSION 3.20.0)
# The CYT4BF's Zephyr drivers over the wz crates: their devicetree bindings must be on the
# search path before Zephyr reads the devicetree.
include(${CMAKE_CURRENT_SOURCE_DIR}/../zephyr-eth-wzmac/zeth.cmake)
find_package(Zephyr REQUIRED HINTS $ENV{ZEPHYR_BASE})
project(wz_zephyr_admin_node C)

include(${CMAKE_CURRENT_SOURCE_DIR}/../zephyr-common/wz_zephyr_board.cmake)

target_sources(app PRIVATE src/main.c)

# What the node's axes (the network stack, the role, the memory profile) build the crate with:
# generated from deploy/wz-config.toml with the axes' Kconfig (Kconfig.axes). What the board and
# its drivers add is stated below.
include(${CMAKE_CURRENT_SOURCE_DIR}/wz_axes.cmake)
set(backend_feature ${wz_axes_features})
set(no_default_features ${wz_axes_no_default_features})
# The batch the node's sessions negotiate (CONFIG_WZ_BATCH_BYTES), which sizes its receive and frame
# buffers: the Rust side reads it when it compiles.
set(backend_env WZ_BATCH_BYTES=${CONFIG_WZ_BATCH_BYTES})

# The secure channel (decision D9 of docs/session-lifecycle-intent.md): the channel's C side is
# compiled here, against Zephyr's own Mbed TLS (the crate is built without its `vendored`), and the
# stream calls and the channel's calls are the Rust side's to find at the image link. A macro, so
# that it adds to the caller's `backend_undefined`: the client that dials with it and the admin node
# that accepts with it both name them.
macro(wz_secure_channel)
  # The arena Mbed TLS allocates from, which the node reports the peak of as a share of.
  list(APPEND backend_env WZ_TLS_ARENA_BYTES=${CONFIG_MBEDTLS_HEAP_SIZE})
  set(tls_src ${CMAKE_CURRENT_SOURCE_DIR}/../../crates/wz-tls-mbedtls)
  target_sources(app PRIVATE ${tls_src}/csrc/wz_tls.c)
  target_include_directories(app PRIVATE ${tls_src}/csrc)
  target_include_directories(mbedtls_iface INTERFACE ${tls_src}/config/zephyr)
  list(APPEND backend_undefined
    connect send recv getpeername shutdown setsockopt
    wz_tls_start wz_tls_arena_peak wz_tls_arena_peak_reset
    wz_tls_identity_generate wz_tls_identity_zid wz_tls_identity_cert wz_tls_identity_free
    wz_tls_session_open wz_tls_session_set_io_ctx wz_tls_session_handshake
    wz_tls_session_peer_zid wz_tls_session_suite wz_tls_session_write wz_tls_session_read
    wz_tls_session_pending wz_tls_session_close_notify wz_tls_session_free)
endmacro()

if(CONFIG_WZ_NET_BACKEND_ZEPHYR_SOCKETS)
  # The POSIX socket layer the sockets seam calls (`zephyr_sys::socket`) and the
  # two board hooks that read the interface (wz_board_hooks.c).
  set(backend_undefined
    socket bind getsockname sendto recvfrom poll close
    wz_net_set_rcvtimeo_ms wz_net_recv_timed_out
    wzApplicationGetIpv4Address wzApplicationGetZid)

  # The session reads each datagram where the link holds it (CONFIG_WZ_RX_IN_PLACE).
  if(CONFIG_WZ_RX_IN_PLACE)
    list(APPEND backend_feature rx-in-place)
  endif()

  # The runtime takes no interrupt lock (CONFIG_WZ_SINGLE_CONTEXT): only the node's thread calls into it.
  if(CONFIG_WZ_SINGLE_CONTEXT)
    list(APPEND backend_feature single-context)
  endif()

  # A Request may carry a Put or a Del, as zenoh-pico's decoder takes it (CONFIG_WZ_REQUEST_PUT_DEL).
  if(CONFIG_WZ_REQUEST_PUT_DEL)
    list(APPEND backend_feature request-put-del)
  endif()

  # The Open body's initial sequence number as a compact function of the two zids
  # (CONFIG_WZ_INITIAL_SN_COMPACT), without the Keccak permutation of zenoh's own derivation.
  if(CONFIG_WZ_INITIAL_SN_COMPACT)
    list(APPEND backend_feature initial-sn-compact)
  endif()

  # The admin node on the fixed-memory profile (its features come with the axes): it takes a
  # session only through the secure channel, and the zids that may command each lifecycle verb are
  # stated here, once, as texts the Rust side reads when it compiles (a text that is no list of
  # lowercase hex zids does not build).
  if(CONFIG_WZ_FIXED_MEMORY AND NOT CONFIG_WZ_ROLE_CLIENT)
    if(NOT CONFIG_WZ_TLS)
      message(FATAL_ERROR "wz: the admin node over Zephyr's sockets takes a session only through "
                          "the secure channel: it needs CONFIG_WZ_TLS (overlays/qemu_admin_fixed_tls.conf).")
    endif()
    wz_secure_channel()
    # The listening half of the stream calls (`bind` is named above).
    list(APPEND backend_undefined listen accept)
    list(APPEND backend_env
      WZ_COMMANDERS_OPEN=${CONFIG_WZ_COMMANDERS_OPEN}
      WZ_COMMANDERS_CLOSE=${CONFIG_WZ_COMMANDERS_CLOSE}
      WZ_COMMANDERS_RESET=${CONFIG_WZ_COMMANDERS_RESET}
      WZ_COMMANDERS_STATUS=${CONFIG_WZ_COMMANDERS_STATUS}
      WZ_PEER_NODE_ZID=${CONFIG_WZ_PEER_NODE_ZID}
      WZ_PEER_NODE_LOCATOR=${CONFIG_WZ_PEER_NODE_LOCATOR})
  endif()

  # The client node (its features come with the axes): the router it dials is stated here, once,
  # as a constant the Rust side checks when it compiles.
  if(CONFIG_WZ_ROLE_CLIENT)
    list(APPEND backend_env WZ_CLIENT_ENDPOINT=${CONFIG_WZ_CLIENT_ENDPOINT})
    # How long the link may sleep when nothing is due (0: the tick), and whether one send window is
    # one datagram. The client is the slot profile's whichever way its storage is given (a static
    # of the image, or a block of the kernel heap: CONFIG_WZ_STORAGE_HEAP), and the slot stack's
    # link is the one it has.
    if(CONFIG_WZ_FIXED_MEMORY OR CONFIG_WZ_STORAGE_HEAP)
      list(APPEND backend_env WZ_IDLE_WAIT_MS=${CONFIG_WZ_IDLE_WAIT_MS})
      # The client subscribes (CONFIG_WZ_SUBSCRIBE): the declaration of a subscriber and the
      # registry that keeps the latest sample of each.
      if(CONFIG_WZ_SUBSCRIBE)
        list(APPEND backend_feature subscribe)
      endif()
      if(CONFIG_WZ_TX_BATCHING)
        list(APPEND backend_feature batching)
      endif()
      # The client asks (the getter every slot-profile node shares): the query, how many times and
      # how, stated here once as constants the Rust side checks when it compiles.
      # The client dials over the secure channel (decision D9): the channel's C side is compiled
      # here, against Zephyr's own Mbed TLS (the crate is built without its `vendored`), and the
      # stream calls and the channel's calls are the Rust side's to find at the image link.
      if(CONFIG_WZ_TLS)
        list(APPEND backend_feature tls)
        wz_secure_channel()
      endif()
      if(CONFIG_WZ_GET)
        list(APPEND backend_feature get)
        list(APPEND backend_env
          WZ_GET_KEY=${CONFIG_WZ_GET_KEY}
          WZ_GET_COUNT=${CONFIG_WZ_GET_COUNT}
          WZ_GET_WARMUP=${CONFIG_WZ_GET_WARMUP}
          WZ_GET_INFLIGHT=${CONFIG_WZ_GET_INFLIGHT}
          WZ_GET_TIMEOUT_MS=${CONFIG_WZ_GET_TIMEOUT_MS})
      endif()
    endif()
  endif()

  # The CYT4BF's ETH0 under Zephyr's own stack: the Ethernet driver over the wz MAC crate
  # and the TRNG as the entropy device (overlays/t2g_zeth.overlay states both). The
  # board's pieces they call are the ones the lwIP backend compiles below.
  if(CONFIG_WZ_ZETH)
    wz_zeth_driver()
    list(APPEND backend_feature mac-cyt4bf zeth-driver)
    set(pdl_src ${ZEPHYR_HAL_INFINEON_MODULE_DIR}/mtb-pdl-cat1/drivers/source)
    target_sources(app PRIVATE
      src/trng_cat1c.c
      ${pdl_src}/cy_crypto_core_trng.c
      ${pdl_src}/cy_crypto_core_hw.c
      src/clock_cat1c.c)
    if(CONFIG_WZ_CYT4BF_PINS_T2G_LITE)
      target_sources(app PRIVATE boards/kit_t2g_b_h_lite/eth0_rmii_pins.c)
    else()
      message(FATAL_ERROR "wz: CONFIG_WZ_ZETH needs a pin routing (CONFIG_WZ_CYT4BF_PINS_*).")
    endif()
    list(APPEND backend_undefined
      wz_board_eth_pins_init wz_board_entropy_fill
      wz_zeth_open wz_zeth_transmit wz_zeth_receive wz_zeth_poll_link wz_zeth_link_up)
  endif()

elseif(CONFIG_WZ_NET_BACKEND_LWIP_MAC)
  set(backend_undefined "")

  if(CONFIG_WZ_MAC_CYT4BF)
    list(APPEND backend_feature mac-cyt4bf)
    # The chip's TRNG is the session's random source (CONFIG_WZ_ENTROPY_BOARD_HOOK,
    # selected by CONFIG_WZ_MAC_CYT4BF): Zephyr has no entropy driver for it, so the
    # PDL's TRNG driver is compiled here, from the module Zephyr already carries.
    set(pdl_src ${ZEPHYR_HAL_INFINEON_MODULE_DIR}/mtb-pdl-cat1/drivers/source)
    target_sources(app PRIVATE
      src/trng_cat1c.c
      ${pdl_src}/cy_crypto_core_trng.c
      ${pdl_src}/cy_crypto_core_hw.c)
    # The core clock the image checks at boot is read from the clock registers
    # (CONFIG_WZ_CORE_CLOCK_BOARD_HOOK, selected by CONFIG_WZ_MAC_CYT4BF) through the
    # PDL's sysclk driver, which Zephyr's HAL module already compiles for this family.
    target_sources(app PRIVATE src/clock_cat1c.c)
    if(CONFIG_WZ_CYT4BF_PINS_T2G_LITE)
      target_sources(app PRIVATE boards/kit_t2g_b_h_lite/eth0_rmii_pins.c)
    else()
      message(FATAL_ERROR "wz: CONFIG_WZ_MAC_CYT4BF needs a pin routing (CONFIG_WZ_CYT4BF_PINS_*).")
    endif()
    list(APPEND backend_undefined wz_board_eth_pins_init wz_board_entropy_fill)
    # The transmit pool the MAC reads in place. Its slots are in the non-cacheable
    # section, which only exists with CONFIG_NOCACHE_MEMORY (the board's conf turns
    # it on for the rings), so the build refuses the pool without it rather than
    # place the slots in cached memory.
    if(CONFIG_WZ_CYT4BF_TX_POOL)
      if(NOT CONFIG_NOCACHE_MEMORY)
        message(FATAL_ERROR "wz: CONFIG_WZ_CYT4BF_TX_POOL places its slots in the non-cacheable "
                            "section, which needs CONFIG_NOCACHE_MEMORY=y.")
      endif()
      list(APPEND backend_feature tx-pool)
    endif()
    # The receive pool the MAC's receive ring draws its buffers from, in the same
    # section for the same reason: the controller writes its slots and the board
    # invalidates no cache.
    if(CONFIG_WZ_CYT4BF_RX_POOL)
      if(NOT CONFIG_NOCACHE_MEMORY)
        message(FATAL_ERROR "wz: CONFIG_WZ_CYT4BF_RX_POOL places its slots in the non-cacheable "
                            "section, which needs CONFIG_NOCACHE_MEMORY=y.")
      endif()
      list(APPEND backend_feature rx-pool)
    endif()
    # The SPI master on the MikroBUS socket, which the SPI probe and the 10BASE-T1S
    # interface both use, and not together: both open SCB3. The refusal is made here and
    # not as a Kconfig dependency because an unmet dependency only turns the symbol off
    # with a warning, and the build would go on without the interface. The PDL's SCB
    # SPI and clock drivers are compiled by Zephyr's own HAL module once
    # CONFIG_USE_INFINEON_SPI is on (both select it), so only this image's thin driver
    # and the board's pin routing are added here.
    if(CONFIG_WZ_T2G_SPI_PROBE AND CONFIG_WZ_T1S)
      message(FATAL_ERROR "wz: CONFIG_WZ_T2G_SPI_PROBE and CONFIG_WZ_T1S both open SCB3; "
                          "a build has one of them (the 10BASE-T1S bring-up reads the chip's "
                          "identity itself and logs it).")
    endif()
    if(CONFIG_WZ_T2G_SPI_PROBE OR CONFIG_WZ_T1S)
      target_sources(app PRIVATE src/scb_spi.c)
      if(CONFIG_WZ_CYT4BF_PINS_T2G_LITE)
        target_sources(app PRIVATE boards/kit_t2g_b_h_lite/mikrobus_spi_pins.c)
      else()
        message(FATAL_ERROR "wz: the MikroBUS SPI master needs a pin routing (CONFIG_WZ_CYT4BF_PINS_*).")
      endif()
      list(APPEND backend_undefined
        wz_board_spi_pins_init wz_scb_spi_clock_claim wz_scb_spi_start wz_scb_spi_exchange)
    endif()
    if(CONFIG_WZ_T2G_SPI_PROBE)
      list(APPEND backend_feature spi-probe)
      set(spi_probe_env WZ_SPI_PROBE_HZ=${CONFIG_WZ_SPI_PROBE_HZ})
    else()
      set(spi_probe_env "")
    endif()
    # The 10BASE-T1S interface: the chip's two control lines as the board routes them,
    # beside the SPI master above. What it states (addresses, PLCA, rates) is handed to
    # the Rust side below, after the station address is known.
    if(CONFIG_WZ_T1S)
      list(APPEND backend_feature t1s-lan865x)
      if(CONFIG_WZ_CYT4BF_PINS_T2G_LITE)
        target_sources(app PRIVATE boards/kit_t2g_b_h_lite/mikrobus_t1s_lines.c)
      else()
        message(FATAL_ERROR "wz: CONFIG_WZ_T1S needs a pin routing (CONFIG_WZ_CYT4BF_PINS_*).")
      endif()
      list(APPEND backend_undefined
        wz_board_t1s_lines_init wz_board_t1s_reset_set wz_board_t1s_irq_asserted)
    endif()
  else()
    message(FATAL_ERROR "wz: the lwIP backend needs a MAC (CONFIG_WZ_MAC_*).")
  endif()

  # lwIP's C is built by the CARGO build (lwip-sys), against this image's port: its
  # options and its compiler shim (lwip-port/). Everything the board states reaches
  # the Rust side through the environment, as compile-time constants, and a build
  # that leaves one unset does not compile.
  if(CONFIG_WZ_CYT4BF_REF_CLOCK_INTERNAL)
    set(ref_clock_divider ${CONFIG_WZ_CYT4BF_REF_CLOCK_DIVIDER})
  else()
    set(ref_clock_divider 0)
  endif()
  # The station address is either given (the build then hands it over, and the
  # Rust side reads it as a constant) or drawn at boot (the build hands over
  # nothing, and the Rust side draws). There is no value a build falls back to: one
  # every build shares is one two boards on a network would both answer to.
  if(CONFIG_WZ_MAC_SOURCE_EXPLICIT)
    if("${CONFIG_WZ_MAC_ADDRESS}" STREQUAL "")
      message(FATAL_ERROR "wz: CONFIG_WZ_MAC_SOURCE_EXPLICIT needs CONFIG_WZ_MAC_ADDRESS, "
                          "an address of its own for this board.")
    endif()
    set(mac_env WZ_MAC_ADDRESS=${CONFIG_WZ_MAC_ADDRESS})
  else()
    set(mac_env "")
  endif()

  # The 10BASE-T1S interface's values, each one the lab's to state: the build refuses an
  # empty or impossible one by name instead of handing the Rust side a number nobody
  # chose. (A Kconfig `int` with no default and no range is empty until it is set; a
  # range would give it the range's lowest value, which is a default by another name.)
  set(t1s_env "")
  if(CONFIG_WZ_T1S)
    if("${CONFIG_WZ_T1S_IPV4}" STREQUAL "")
      message(FATAL_ERROR "wz: CONFIG_WZ_T1S needs CONFIG_WZ_T1S_IPV4, an address of its own "
                          "on the segment (it has no default).")
    endif()
    if(CONFIG_WZ_T1S_PLCA)
      foreach(plca_value IN ITEMS ID COUNT)
        if(NOT "${CONFIG_WZ_T1S_PLCA_NODE_${plca_value}}" MATCHES "^[0-9]+$")
          message(FATAL_ERROR "wz: CONFIG_WZ_T1S_PLCA needs CONFIG_WZ_T1S_PLCA_NODE_${plca_value}, "
                              "a decimal number (it has no default); found "
                              "'${CONFIG_WZ_T1S_PLCA_NODE_${plca_value}}'.")
        endif()
      endforeach()
      if(CONFIG_WZ_T1S_PLCA_NODE_ID GREATER 254)
        message(FATAL_ERROR "wz: CONFIG_WZ_T1S_PLCA_NODE_ID is ${CONFIG_WZ_T1S_PLCA_NODE_ID}; "
                            "0 is the coordinator, 1 to 254 a follower, and 255 means PLCA off "
                            "(CONFIG_WZ_T1S_PLCA=n asks for that).")
      endif()
      if(CONFIG_WZ_T1S_PLCA_NODE_COUNT LESS 1 OR CONFIG_WZ_T1S_PLCA_NODE_COUNT GREATER 255)
        message(FATAL_ERROR "wz: CONFIG_WZ_T1S_PLCA_NODE_COUNT is ${CONFIG_WZ_T1S_PLCA_NODE_COUNT}; "
                            "it is 1 to 255.")
      endif()
      if(NOT CONFIG_WZ_T1S_PLCA_NODE_ID LESS CONFIG_WZ_T1S_PLCA_NODE_COUNT)
        message(FATAL_ERROR "wz: CONFIG_WZ_T1S_PLCA_NODE_COUNT (${CONFIG_WZ_T1S_PLCA_NODE_COUNT}) "
                            "must exceed CONFIG_WZ_T1S_PLCA_NODE_ID (${CONFIG_WZ_T1S_PLCA_NODE_ID}): "
                            "the node count is the highest id on the segment plus one.")
      endif()
      set(t1s_plca_on 1)
      set(t1s_plca_id ${CONFIG_WZ_T1S_PLCA_NODE_ID})
      set(t1s_plca_count ${CONFIG_WZ_T1S_PLCA_NODE_COUNT})
    else()
      set(t1s_plca_on 0)
      set(t1s_plca_id 0)
      set(t1s_plca_count 0)
    endif()
    if(CONFIG_WZ_MAC_SOURCE_EXPLICIT)
      if("${CONFIG_WZ_T1S_MAC_ADDRESS}" STREQUAL "")
        message(FATAL_ERROR "wz: CONFIG_WZ_MAC_SOURCE_EXPLICIT with CONFIG_WZ_T1S needs "
                            "CONFIG_WZ_T1S_MAC_ADDRESS, an address of its own for this interface.")
      endif()
      string(TOLOWER "${CONFIG_WZ_T1S_MAC_ADDRESS}" t1s_mac_lower)
      string(TOLOWER "${CONFIG_WZ_MAC_ADDRESS}" rmii_mac_lower)
      if(t1s_mac_lower STREQUAL rmii_mac_lower)
        message(FATAL_ERROR "wz: CONFIG_WZ_T1S_MAC_ADDRESS is the onboard port's address "
                            "(${CONFIG_WZ_MAC_ADDRESS}); two interfaces of one node need two.")
      endif()
      list(APPEND t1s_env WZ_T1S_MAC_ADDRESS=${CONFIG_WZ_T1S_MAC_ADDRESS})
    endif()
    if(CONFIG_WZ_T1S_RESET_LINE)
      set(t1s_reset_wait_ms ${CONFIG_WZ_T1S_RESET_WAIT_MS})
    else()
      set(t1s_reset_wait_ms 0)
    endif()
    if(CONFIG_WZ_T1S_ACCEPT_ALL_MULTICAST)
      set(t1s_multicast 1)
    else()
      set(t1s_multicast 0)
    endif()
    if(CONFIG_WZ_T1S_BUILD_VALUES_ONLY)
      set(t1s_build_values 1)
    else()
      set(t1s_build_values 0)
    endif()
    list(APPEND t1s_env
      WZ_T1S_BUILD_VALUES=${t1s_build_values}
      WZ_T1S_SPI_HZ=${CONFIG_WZ_T1S_SPI_HZ}
      WZ_T1S_SERVICE_MS=${CONFIG_WZ_T1S_SERVICE_MS}
      WZ_T1S_RESET_WAIT_MS=${t1s_reset_wait_ms}
      WZ_T1S_PLCA_ON=${t1s_plca_on}
      WZ_T1S_PLCA_ID=${t1s_plca_id}
      WZ_T1S_PLCA_COUNT=${t1s_plca_count}
      WZ_T1S_MULTICAST=${t1s_multicast}
      WZ_T1S_IPV4=${CONFIG_WZ_T1S_IPV4}
      WZ_T1S_NETMASK=${CONFIG_WZ_T1S_NETMASK}
      WZ_T1S_GATEWAY=${CONFIG_WZ_T1S_GATEWAY})
  endif()

  list(APPEND backend_env
    WZ_LWIP_PORT=${CMAKE_CURRENT_SOURCE_DIR}/lwip-port
    ${mac_env}
    ${spi_probe_env}
    ${t1s_env}
    WZ_STATIC_IPV4=${CONFIG_WZ_STATIC_IPV4}
    WZ_STATIC_NETMASK=${CONFIG_WZ_STATIC_NETMASK}
    WZ_STATIC_GATEWAY=${CONFIG_WZ_STATIC_GATEWAY}
    WZ_LINK_WAIT_MS=${CONFIG_WZ_LINK_WAIT_MS}
    WZ_REF_CLOCK_DIVIDER=${ref_clock_divider})

else()
  message(FATAL_ERROR "wz: no network backend is selected (CONFIG_WZ_NET_BACKEND_*).")
endif()

wz_zephyr_rust_app(
  RUST_DIR ${CMAKE_CURRENT_SOURCE_DIR}/rust
  LIB      wz_zephyr_admin_node
  FEATURES ${backend_feature}
  ${no_default_features}
  CARGO_ENV ${backend_env} ${wz_axes_policy_env}
  UNDEFINED ${backend_undefined}
)
```

## Kconfig.axes
```
# SPDX-License-Identifier: LicenseRef-watching-zenoh-NonCommercial-1.0 OR LicenseRef-watching-zenoh-Commercial
# SPDX-FileCopyrightText: Copyright (c) 2026 newmassrael
#
# GENERATED from deploy/wz-config.toml by scripts/lib/wz_config.py --emit image-kconfig:zephyr-admin-node.
# Do not edit: `wz_config.py --check` fails when this file is stale.

choice WZ_NET_BACKEND
	prompt "Network stack the admin node runs over"
	default WZ_NET_BACKEND_ZEPHYR_SOCKETS
	help
	  The node is the same on every board; what differs is the stack under it,
	  which the board's Ethernet driver decides.

config WZ_NET_BACKEND_ZEPHYR_SOCKETS
	bool "Zephyr's own network stack and BSD sockets"
	help
	  For a board whose Ethernet, Wi-Fi or modem Zephyr drives. The interface, its
	  address (DHCP or Kconfig) and its link-layer identity are Zephyr's.

config WZ_NET_BACKEND_LWIP_MAC
	bool "lwIP over an Ethernet MAC the wz crates drive"
	depends on !WZ_ROLE_CLIENT
	help
	  For a board whose Ethernet controller Zephyr has no driver for. Zephyr is the
	  kernel only (threads, clock, heap, console): the network is lwIP, polled from
	  the node's loop, over a wz `EthernetMac` crate for the chip. The interface
	  address and the MAC address are the board's Kconfig, since no Zephyr
	  interface exists to ask.

endchoice

choice WZ_NODE_STORAGE
	prompt "Where the node's tables live"
	default WZ_STORAGE_HEAP
	help
	  The memory profile is the node's and not a network backend's: whether the Rust image has an
	  allocator is a setting made beside the role and the stack, and what it is available to is
	  what has the slot profile's pieces (the stack's driver and how it opens a socket).

config WZ_STORAGE_HEAP
	bool "The heap profile: the growable node, over an allocator in the Rust image"

config WZ_FIXED_MEMORY
	bool "Build the node on the fixed-memory profile (no allocator in the Rust image)"
	depends on (WZ_NET_BACKEND_LWIP_MAC && WZ_MAC_CYT4BF) || (WZ_NET_BACKEND_ZEPHYR_SOCKETS && (WZ_ROLE_CLIENT || WZ_ROLE_PEER))
	help
	  Every table the node holds (sessions, sockets, the observer, the interfaces) is a
	  static the image declares, the session tier is the slot profile's, and the Rust
	  staticlib is built with its default features off, so it links no allocator. The
	  session host and the dialler are the ones every stack shares
	  (wz_session_mcu::slot_host); a stack supplies its driver and how it opens a socket.
	
	  Three nodes have the profile. The admin node over lwIP is fixed_node.rs: its listener
	  reads only the datagrams of the peer each session was accepted from and drops and
	  counts the rest, where the growable node's one accepting session takes the source of
	  every datagram it reads as its peer. The client node over Zephyr's sockets is
	  fixed_client.rs. The admin node over Zephyr's sockets (a peer role) is fixed_admin.rs:
	  it takes a session only through the secure channel (CONFIG_WZ_TLS), because the
	  socket stack's listener of the slot profile is a stream listener and a zid is proven
	  only by a secure channel, and it binds the lifecycle verbs for the zids the build
	  lists (CONFIG_WZ_COMMANDERS_*).
	
	  This kernel's own heap is a separate matter: what the Rust image does not allocate,
	  Zephyr's network stack and POSIX layer still may, and CONFIG_HEAP_MEM_POOL_SIZE is what
	  the kernel is given for it.

endchoice

choice WZ_LIFECYCLE_TRANSPORT
	prompt "How a session lifecycle verb reaches the node"
	default WZ_LIFECYCLE_IN_BAND
	help
	  The node holds the peers it was told to hold by their zid beside the locators it is told to
	  connect to, and which peers it is asked to hold at run time is a transport of its own: a Push or
	  a query on the admin space, an agent that drives the node over a channel of its own, or none.

config WZ_LIFECYCLE_IN_BAND
	bool "A query on the admin space opens a peer (session/open/<zid>)"
	help
	  The node answers `GET @/<zid>/<whatami>/session/open/<peer-zid>` by holding the peer and lists
	  the verb in `session/verbs`. Only the fixed-memory admin node binds the verb this way; the other
	  nodes of the image have their own lifecycle or none, and this value changes nothing of them.

config WZ_LIFECYCLE_DECLARED
	bool "No verb: the peers are the ones the build declares"
	depends on WZ_FIXED_MEMORY && WZ_NET_BACKEND_LWIP_MAC
	help
	  The node binds no lifecycle verb: its admin answer lists none and serves no `session/open` key, and
	  the code that serves it is not in the image. The peers it holds are the ones declared when it was
	  built, and its connection machines only reconnect them.

endchoice

choice WZ_LINK_PROTOCOL
	prompt "The protocol the lwIP node's links run on"
	default WZ_LINK_UDP
	help
	  The node over lwIP on the fixed-memory profile opens and accepts its sessions over one protocol
	  and reports its locators in it. `udp` is the node that has been on the T2G kit. `tcp` is the same
	  node over lwIP's TCP (lwIP is built with its TCP sources, and the node's polls pump the MACs
	  while a connect or a write waits); it has been built and not run on a board.

config WZ_LINK_UDP
	bool "udp/: a datagram for each batch"
	help
	  The node's links are UDP sockets of lwIP, one datagram for each batch, as zenoh's udp/ link.

config WZ_LINK_TCP
	bool "tcp/: a byte stream with each batch behind its length"
	depends on WZ_NET_BACKEND_LWIP_MAC && WZ_FIXED_MEMORY
	help
	  The node's links are TCP connections of lwIP, a batch written behind a two-byte length as zenoh's
	  tcp/ link. The connection pool, the receive rings and the byte tables the links take their buffers
	  from are the image's statics (`fixed_tcp.rs`), and lwIP's TCP options are the port's
	  (`lwip-port/lwipopts.h`). Only the fixed-memory node over lwIP has it.

endchoice
```

## Kconfig.policies
```
# SPDX-License-Identifier: LicenseRef-watching-zenoh-NonCommercial-1.0 OR LicenseRef-watching-zenoh-Commercial
# SPDX-FileCopyrightText: Copyright (c) 2026 newmassrael
#
# GENERATED from deploy/wz-config.toml by scripts/lib/wz_config.py --emit image-policies:zephyr-admin-node.
# Do not edit: `wz_config.py --check` fails when this file is stale.

menu "wz policies"

comment "Each policy is behaviour beyond upstream; the default of every one is upstream's."
comment "Only the policies this image's code reads are here."

config WZ_POLICY_TX_NO_PROGRESS_DEADLINE
	bool "tx-no-progress-deadline"
	default n
	help
	  Whether a blocking message gets a second bound beside its total wait: the
	  wait with no progress. Off, only the total wait bounds it. On, it is also
	  given up when TX_NO_PROGRESS_WINDOW_US passes with no fragment out, and the
	  total wait still ends it, whichever comes first. A fragment out is progress
	  and starts the window again, and the total wait is never made longer.
	  Upstream: Gives a blocking message one wait_before_close for the whole of it,
	  however many fragments go out: its deadline has no cap to extend by, so a
	  fragment out leaves the deadline where it is.

config WZ_POLICY_TX_EXPIRY_KEEPS_SESSION
	bool "tx-expiry-keeps-session"
	default n
	help
	  What happens when a blocking message finds no room within its deadline. Off,
	  the session is closed as unresponsive and the send reports success. On, the
	  message is dropped, the send reports that the transport was not available,
	  and the session stays open: a slow link costs the message and not the
	  session. A link that stays blocked is closed after TX_EXPIRY_CLOSE_AFTER such
	  messages in a row, when that limit is not 0. A multicast group never closes
	  either way.
	  Upstream: Closes the session as unresponsive when a blocking message found no
	  room in its deadline, and tells the sender nothing.

config WZ_POLICY_DECLARATION_SYNC_PACING
	bool "declaration-sync-pacing"
	default n
	depends on WZ_ROLE_CLIENT && WZ_FIXED_MEMORY
	help
	  How a node tells a peer its declarations again after a reconnect. Off, all of
	  them are sent at once. On, they are sent in turns of
	  DECLARATION_SYNC_BURST_MESSAGES with DECLARATION_SYNC_INTERVAL_MS between
	  turns, and the session is served during the waits, so a node with many
	  declarations does not hand its peer a burst or stop answering while it sends
	  them. A declaration made while the replay runs is sent in its turn, after
	  everything it depends on; the retraction of one the peer was never told of
	  sends nothing.
	  Upstream: Replays every declaration it holds to a new peer in one call, as
	  soon as the session is open again.

endmenu
```

## prj.conf
```kconfig
# SPDX-License-Identifier: LicenseRef-watching-zenoh-NonCommercial-1.0 OR LicenseRef-watching-zenoh-Commercial
# SPDX-FileCopyrightText: Copyright (c) 2026 newmassrael
#
# zephyr-admin-node Kconfig — what every board needs of Zephyr, whichever network
# stack its Ethernet runs under. What the stack needs is in this directory's
# Kconfig (as defaults of the symbols the Zephyr-sockets backend turns on), and what
# only one board needs (its address, its tick rate, its test entropy generator, its
# MAC) is in boards/<board>.conf. Nothing here is a QEMU constant.

# printk for the boot log and the READY / FAIL lines.
CONFIG_PRINTK=y

# The Zephyr kernel heap that ZephyrAllocator (k_malloc/k_free) bridges Rust's
# #[global_allocator] onto. MUST be > 0 or k_malloc is not compiled in. Backs the
# executor task pool, the sessions' action bundles and the links' receive
# buffers (one batch each).
CONFIG_HEAP_MEM_POOL_SIZE=262144

# The main thread runs the whole node: the wz executor, every session's future
# polled inline, and the codec buffers they nest. Its stack is the node's budget for
# all of that, and it was a guess (the FreeRTOS sibling's 16 KB) until the node on
# QEMU needed 20,012 bytes of it: the stack ran into the idle thread's below it, and
# the machine died later with a register file that named neither. The size is now
# one the node's own measurement (`stack: peak N of M bytes`, below) leaves a
# quarter of free, and Layer Qza refuses it when it does not.
CONFIG_MAIN_STACK_SIZE=32768

# What makes that measurement possible, and what makes an overflow loud. The kernel
# paints a stack when its thread is created and the node reads how much of the paint
# is left (`k_thread_stack_space_get`), which needs the stack's bounds kept too. The
# sentinel is checked at every context switch and turns a stack that has run out
# into a fatal error that says so, where the machine here has no MPU to fault at the
# stack's end.
CONFIG_INIT_STACKS=y
CONFIG_THREAD_STACK_INFO=y
CONFIG_STACK_SENTINEL=y

# R2918 — clock_gettime / clock_settime(CLOCK_REALTIME), the board's wall clock
# for the profile's epoch seam (deploy/zephyr-common/wz_board_hooks.c). They are
# POSIX timers, which sit under the POSIX system interfaces.
CONFIG_POSIX_SYSTEM_INTERFACES=y
CONFIG_POSIX_TIMERS=y
```

## boards/kit_t2g_b_h_lite_cyt4bf8cds_m7_0.conf
```kconfig
# SPDX-License-Identifier: LicenseRef-watching-zenoh-NonCommercial-1.0 OR LicenseRef-watching-zenoh-Commercial
# SPDX-FileCopyrightText: Copyright (c) 2026 newmassrael
#
# KIT_T2G-B-H_LITE (CYT4BF8CDS), Cortex-M7 core 0: the admin node over the chip's
# own Ethernet. Zephyr has no Ethernet driver for this controller (the board has
# no Ethernet node), so Zephyr is the kernel and the network is lwIP over the wz MAC
# crate. This is a BUILT row: nothing here has run on silicon.

# lwIP over wz-eth-mac-cyt4bf, the RMII pins of this kit, the PHY driving REF_CLK.
CONFIG_WZ_NET_BACKEND_LWIP_MAC=y
CONFIG_WZ_MAC_CYT4BF=y
CONFIG_WZ_CYT4BF_PINS_T2G_LITE=y

# The MAC's DMA rings live in the non-cacheable section (the M7 has a data cache the
# controller does not see).
CONFIG_NOCACHE_MEMORY=y

# Zephyr's port of this chip never turns the M7's caches on (SCB->CCR read from the
# running node had both cache bits clear). The image does, at boot, and keeps the data
# cache off unless the MPU says the section above is non-cacheable.
CONFIG_WZ_ENABLE_CORE_CACHES=y

# This chip has no entropy driver in Zephyr: the session's secrets come from the
# CRYPTO block's TRNG through the board hook (selected by CONFIG_WZ_MAC_CYT4BF).
# Never CONFIG_TEST_RANDOM_GENERATOR here: the table gate refuses it on a BUILT row.
```

## boards/mps2_an385.conf
```kconfig
# SPDX-License-Identifier: LicenseRef-watching-zenoh-NonCommercial-1.0 OR LicenseRef-watching-zenoh-Commercial
# SPDX-FileCopyrightText: Copyright (c) 2026 newmassrael
#
# What only the QEMU mps2/an385 board needs. A real board gets none of it.

# 100 Hz: the reference deploy's tick rate. The Rust side reads whatever the board
# has (`wz_runtime_zephyr::tick_hz_from_build!`); this line only keeps the QEMU
# lane's timing where it has been measured.
CONFIG_SYS_CLOCK_TICKS_PER_SEC=100

# QEMU's user-mode networking (`-nic user,model=lan9118`) hands the guest
# 10.0.2.15 with the host's side at 10.0.2.2, which is what the lane forwards a
# host UDP port to and where it points the node's dials. Pinned, not leased: the
# lane's expectation of the node's address must not depend on a DHCP exchange.
# (The SMSC911x driver is on by default for this board's devicetree node.)
CONFIG_NET_DHCPV4=n
CONFIG_NET_CONFIG_MY_IPV4_ADDR="10.0.2.15"
CONFIG_NET_CONFIG_MY_IPV4_NETMASK="255.255.255.0"
CONFIG_NET_CONFIG_MY_IPV4_GW="10.0.2.2"

# QEMU mps2/an385 has NO entropy hardware. ⚠ The test generator is a FIXTURE: its
# numbers are predictable, it exercises the call and does not satisfy the entropy
# contract. Zephyr allows it only for a board whose sole purpose is testing, and
# deploy/zephyr-common/wz_board_hooks.c admits it on a QEMU board alone: a real
# board selects its TRNG driver instead, or does not build.
CONFIG_TEST_RANDOM_GENERATOR=y
```

## src/main.c
```c
/* SPDX-License-Identifier: LicenseRef-watching-zenoh-NonCommercial-1.0 OR LicenseRef-watching-zenoh-Commercial
 * SPDX-FileCopyrightText: Copyright (c) 2026 newmassrael
 *
 * zephyr-admin-node C entry. Zephyr boots and runs `main()` on the main thread,
 * which `main()` hands to the wz Rust staticlib (`wz_app_main`). That call
 * returns only when the node could not start; a running node never returns.
 *
 * The firmware has no verdict of its own. What it is FOR is decided by the host
 * that talks to it, so it prints where it is and who it claims to be
 * (`ZEPHYR-WZ-ADMIN READY <zid> <locator>`, from the Rust side) and runs. The
 * only line this file prints after boot is the failure one.
 *
 * The seams the Rust side calls through (printk, k_msleep, irq_lock, the board's
 * random source and wall clock, its address and identity) are shared by every wz
 * Zephyr image and live in deploy/zephyr-common/wz_board_hooks.c.
 */

#include <zephyr/kernel.h>
#include <zephyr/sys/printk.h>

/* Implemented in the wz Rust staticlib (libwz_zephyr_admin_node.a). */
extern int wz_app_main(void);

/* wz_board_hooks.c: set the realtime clock to this build's instant. */
extern int wz_board_set_boot_clock(void);

int main(void)
{
	printk("zephyr-admin-node: boot ok; entering wz_app_main\n");

	if (wz_board_set_boot_clock() != 0) {
		printk("ZEPHYR-WZ-ADMIN FAIL rc=-1 (the board could not set its clock)\n");
		return 0;
	}

	int rc = wz_app_main();

	printk("ZEPHYR-WZ-ADMIN FAIL rc=%d\n", rc);
	return 0;
}
```

## src/clock_cat1c.c
```c
/* SPDX-License-Identifier: LicenseRef-watching-zenoh-NonCommercial-1.0 OR LicenseRef-watching-zenoh-Commercial
 * SPDX-FileCopyrightText: Copyright (c) 2026 newmassrael
 *
 * The core clock of a CAT1C (T2G) Cortex-M7, read from the chip's registers.
 *
 * This is `wz_board_core_clock_hz`, the board's answer to `wz_core_clock_hz`
 * (deploy/zephyr-common/wz_board_hooks.c selects it with CONFIG_WZ_CORE_CLOCK_BOARD_HOOK).
 * The image is built for the clock in the devicetree (CONFIG_SYS_CLOCK_HW_CYCLES_PER_SEC)
 * and Zephyr's clock driver on an M7 returns without bringing the clock tree up: the
 * CM0+ core has to. A tree that was not brought up leaves the M7 at the 8 MHz
 * oscillator, and nothing else says so; the image compares this reading with what it
 * assumes (wz_runtime_zephyr::core_clock) before anything that waits.
 *
 * WHICH clock feeds the core, and the function that computes it, are Infineon's own:
 * the PDL's system file for this core (mtb-template-cat1, cat1c/COMPONENT_CM7/
 * system_cm7.c, SystemCoreClockUpdate) sets SystemCoreClock to
 * Cy_SysClk_ClkFastSrcGetFrequency(0) for CM7_0 and (1) for CM7_1. That function
 * (mtb-pdl-cat1 drivers/source/cy_sysclk_v2.c) divides the frequency of clk_hf[1] by
 * the CPUSS.FAST_<n>_CLOCK_CTL divider, and clk_hf[1] is the root-mux selection, the
 * root divider and, for a PLL path, the PLL's enable bit and its multiplier and
 * dividers: all registers.
 *
 * ONE input is not a register: a PLL path's input is the external crystal, and its
 * frequency is a number the PDL holds, handed out by Cy_SysClk_EcoGetFrequency only
 * while the ECO status register says the crystal is stable. Zephyr's clock driver
 * sets that number on the M7 from the board's configuration (16 MHz, the kit's
 * crystal; clock_control_infineon.c, Cy_SysClk_EcoSetFrequency) before main() runs. A
 * board whose crystal differs from that number reads wrong by the same factor.
 *
 * A path the PDL cannot evaluate yields 0, its own "unknown frequency" (the comment
 * in Cy_SysClk_ClkPathMuxGetFrequency), and 0 is what this returns: the contract of
 * the hook is "0 means the board cannot tell".
 *
 * BUILT and unrun: no register read here has been compared with a bench.
 */

#include <stdint.h>

#include <zephyr/kernel.h>

#include <cy_sysclk.h>

uint32_t wz_board_core_clock_hz(void)
{
#if defined(CONFIG_SOC_XMC7200_CORE_NAME_M7_0)
	return Cy_SysClk_ClkFastSrcGetFrequency(0);
#elif defined(CONFIG_SOC_XMC7200_CORE_NAME_M7_1)
	return Cy_SysClk_ClkFastSrcGetFrequency(1);
#else
	/* Not an M7 core of this family: nothing here knows which clock feeds it. */
	return 0;
#endif
}
```

## src/scb_spi.c
```c
/* SPDX-License-Identifier: LicenseRef-watching-zenoh-NonCommercial-1.0 OR LicenseRef-watching-zenoh-Commercial
 * SPDX-FileCopyrightText: Copyright (c) 2026 newmassrael
 *
 * An SPI master on one SCB block of the CYT4BF, polled, through the PDL.
 *
 * Zephyr's own SPI driver is not an option on this chip in the tree this builds
 * against: its devicetree binding wants an `interrupts` property that the SoC's SCB
 * nodes do not carry (they carry `system-interrupts`). So this is the PDL driver,
 * called directly, and thin: every RULE (how a clock rate becomes a divider and an
 * oversample factor, what an exchange may be) lives in the Rust crate `wz-spi-scb`
 * where it is host-tested, and this file does only what needs the registers.
 *
 * Which SCB, and which of its slave select lines carries chip select, are the
 * BOARD's (the board's own `..._spi_pins.c` routes the pins and names the line); the
 * SCB itself is fixed here as SCB3, the one the kit's MikroBUS socket uses.
 *
 * What it does, in the order a caller uses it:
 *   1. `wz_scb_spi_clock_claim`: find an 8-bit peripheral clock divider nobody has
 *      enabled, connect it to the SCB, enable it dividing by one, and report the
 *      clock that gives, in hertz. The divider is FOUND, not chosen by number: a
 *      number written down here would be right only while no other driver claimed
 *      it, and Zephyr's own drivers claim them at boot.
 *   2. `wz_scb_spi_start`: set the divider to the one the caller computed from that
 *      frequency, configure the SCB as a Motorola SPI master in the mode asked for,
 *      and enable it.
 *   3. `wz_scb_spi_exchange`: one chip-select assertion, `len` bytes out and `len`
 *      bytes in. The whole of `tx` is loaded into the transmit FIFO BEFORE the
 *      clocks run, because the block releases chip select when that FIFO runs dry,
 *      and an exchange that did not fit would be cut in two by a release in the
 *      middle of a frame. The caller has already refused anything longer than the
 *      FIFO; this refuses it again, since it is the one place that knows.
 *
 * BUILT, not run: nothing in this file has been on an SCB. The configuration
 * follows the defaults Zephyr's own PDL SPI driver uses for a master (MISO sampled
 * late, no separation between data elements, chip select active low, MSB first,
 * eight-bit elements), which that driver runs on other chips.
 */

#include <errno.h>
#include <stdbool.h>
#include <stdint.h>

#include <zephyr/kernel.h>

#include <cy_scb_spi.h>
#include <cy_sysclk.h>

#define WZ_SCB_BLOCK SCB3
#define WZ_SCB_CLOCK PCLK_SCB3_CLOCK
#define WZ_DIVIDER_TYPE CY_SYSCLK_DIV_8_BIT
/* The most an 8-bit divider divides by. */
#define WZ_DIVIDER_MAX 256U

static bool divider_claimed;
static uint32_t divider_number;

static uint32_t peri_instance(void)
{
	return ((uint32_t)WZ_SCB_CLOCK & PERI_PCLK_INST_NUM_Msk) >> PERI_PCLK_INST_NUM_Pos;
}

static uint32_t peri_group(void)
{
	return ((uint32_t)WZ_SCB_CLOCK & PERI_PCLK_GR_NUM_Msk) >> PERI_PCLK_GR_NUM_Pos;
}

uint32_t wz_scb_spi_clock_claim(void)
{
	if (divider_claimed) {
		return 0;
	}
	const uint32_t count = PERI_PCLK_GR_DIV_8_NR(peri_instance(), peri_group());

	for (uint32_t n = 0; n < count; n++) {
		if (Cy_SysClk_PeriPclkGetDividerEnabled(WZ_SCB_CLOCK, WZ_DIVIDER_TYPE, n)) {
			continue;
		}
		if (Cy_SysClk_PeriPclkAssignDivider(WZ_SCB_CLOCK, WZ_DIVIDER_TYPE, n) !=
		    CY_SYSCLK_SUCCESS) {
			return 0;
		}
		if (Cy_SysClk_PeriPclkSetDivider(WZ_SCB_CLOCK, WZ_DIVIDER_TYPE, n, 0) !=
		    CY_SYSCLK_SUCCESS) {
			return 0;
		}
		if (Cy_SysClk_PeriPclkEnableDivider(WZ_SCB_CLOCK, WZ_DIVIDER_TYPE, n) !=
		    CY_SYSCLK_SUCCESS) {
			return 0;
		}
		divider_number = n;
		divider_claimed = true;
		return Cy_SysClk_PeriPclkGetFrequency(WZ_SCB_CLOCK, WZ_DIVIDER_TYPE, n);
	}
	/* Every divider of the group is in use: nothing to give the SCB. */
	return 0;
}

static cy_en_scb_spi_sclk_mode_t sclk_mode(uint8_t mode)
{
	switch (mode) {
	case 1:
		return CY_SCB_SPI_CPHA1_CPOL0;
	case 2:
		return CY_SCB_SPI_CPHA0_CPOL1;
	case 3:
		return CY_SCB_SPI_CPHA1_CPOL1;
	default:
		return CY_SCB_SPI_CPHA0_CPOL0;
	}
}

int wz_scb_spi_start(uint8_t mode, uint8_t select, uint32_t divider, uint32_t oversample)
{
	if (!divider_claimed || mode > 3 || select > 3 || divider == 0 ||
	    divider > WZ_DIVIDER_MAX) {
		return -EINVAL;
	}

	/* The divider was enabled dividing by one; it is disabled to be changed and
	 * enabled again, as the PDL requires of a divider that is already running. */
	if (Cy_SysClk_PeriPclkDisableDivider(WZ_SCB_CLOCK, WZ_DIVIDER_TYPE, divider_number) !=
		    CY_SYSCLK_SUCCESS ||
	    Cy_SysClk_PeriPclkSetDivider(WZ_SCB_CLOCK, WZ_DIVIDER_TYPE, divider_number,
					 divider - 1U) != CY_SYSCLK_SUCCESS ||
	    Cy_SysClk_PeriPclkEnableDivider(WZ_SCB_CLOCK, WZ_DIVIDER_TYPE, divider_number) !=
		    CY_SYSCLK_SUCCESS) {
		return -EIO;
	}

	const cy_stc_scb_spi_config_t config = {
		.spiMode = CY_SCB_SPI_MASTER,
		.subMode = CY_SCB_SPI_MOTOROLA,
		.sclkMode = sclk_mode(mode),
		.parity = CY_SCB_SPI_PARITY_NONE,
		.dropOnParityError = false,
		.oversample = oversample,
		.rxDataWidth = 8,
		.txDataWidth = 8,
		.enableMsbFirst = true,
		.enableFreeRunSclk = false,
		.enableInputFilter = false,
		.enableMisoLateSample = true,
		/* Chip select stays asserted from the first element to the last, which is
		 * the whole of an exchange. */
		.enableTransferSeperation = false,
		/* Active low on every line. */
		.ssPolarity = 0,
		.ssSetupDelay = false,
		.ssHoldDelay = false,
		.ssInterFrameDelay = false,
		.enableWakeFromSleep = false,
		.rxFifoTriggerLevel = 0,
		.rxFifoIntEnableMask = 0,
		.txFifoTriggerLevel = 0,
		.txFifoIntEnableMask = 0,
		.masterSlaveIntEnableMask = 0,
	};

	/* No context: nothing here uses the PDL's interrupt-driven transfer, only its
	 * FIFO functions, for which it documents a NULL context. */
	if (Cy_SCB_SPI_Init(WZ_SCB_BLOCK, &config, NULL) != CY_SCB_SPI_SUCCESS) {
		return -EIO;
	}
	Cy_SCB_SPI_SetActiveSlaveSelect(WZ_SCB_BLOCK, (cy_en_scb_spi_slave_select_t)select);
	Cy_SCB_SPI_Enable(WZ_SCB_BLOCK);
	return 0;
}

int wz_scb_spi_exchange(const uint8_t *tx, uint8_t *rx, uint32_t len)
{
	if (tx == NULL || rx == NULL || len == 0 || len > Cy_SCB_GetFifoSize(WZ_SCB_BLOCK)) {
		return -EINVAL;
	}

	/* Nothing left from an earlier exchange may answer this one. */
	Cy_SCB_SPI_ClearRxFifo(WZ_SCB_BLOCK);
	Cy_SCB_SPI_ClearTxFifo(WZ_SCB_BLOCK);

	/* Everything in before anything runs; the block starts clocking when the first
	 * element is queued, so a short write is an exchange already cut in two. */
	if (Cy_SCB_SPI_WriteArray(WZ_SCB_BLOCK, (void *)tx, len) != len) {
		Cy_SCB_SPI_ClearTxFifo(WZ_SCB_BLOCK);
		return -ENOSPC;
	}

	uint32_t got = 0;
	const uint32_t started = k_uptime_get_32();

	while (got < len) {
		got += Cy_SCB_SPI_ReadArray(WZ_SCB_BLOCK, rx + got, len - got);
		if (got < len && (k_uptime_get_32() - started) > CONFIG_WZ_SCB_SPI_TIMEOUT_MS) {
			return -ETIMEDOUT;
		}
	}
	while (!Cy_SCB_SPI_IsTxComplete(WZ_SCB_BLOCK)) {
		if ((k_uptime_get_32() - started) > CONFIG_WZ_SCB_SPI_TIMEOUT_MS) {
			return -ETIMEDOUT;
		}
	}
	return 0;
}
```

## src/trng_cat1c.c
```c
/* SPDX-License-Identifier: LicenseRef-watching-zenoh-NonCommercial-1.0 OR LicenseRef-watching-zenoh-Commercial
 * SPDX-FileCopyrightText: Copyright (c) 2026 newmassrael
 *
 * The random source of a CAT1C (T2G) chip: the true random number generator in its
 * CRYPTO block, through Infineon's PDL (`Cy_Crypto_Core_Trng_Ext`).
 *
 * This is `wz_board_entropy_fill`, the board's answer to the session's secrets
 * (deploy/zephyr-common/wz_board_hooks.c selects it with CONFIG_WZ_ENTROPY_BOARD_HOOK).
 * Zephyr has no entropy driver for these chips, so the build would otherwise refuse
 * the board outright; the TRNG is real hardware, and the PDL's driver for it is the
 * vendor's own. It fills the buffer 32 bits at a time and FAILS the whole fill when
 * the TRNG reports an error, rather than return what the buffer held.
 *
 * BUILT and unrun: nothing here has been on a CYT4BF.
 */

#include <stdbool.h>
#include <stddef.h>
#include <stdint.h>
#include <string.h>

#include <cy_crypto_core.h>
#include <cy_crypto_core_trng.h>

int wz_board_entropy_fill(void *buf, size_t len)
{
	static bool enabled;
	uint8_t *out = buf;

	if (!enabled) {
		if (Cy_Crypto_Core_Enable(CRYPTO) != CY_CRYPTO_SUCCESS) {
			return -1;
		}
		enabled = true;
	}
	while (len > 0) {
		/* Must be 4-byte aligned. */
		uint32_t word;
		size_t take = len < sizeof(word) ? len : sizeof(word);

		if (Cy_Crypto_Core_Trng_Ext(CRYPTO, 32, &word) != CY_CRYPTO_SUCCESS) {
			return -1;
		}
		memcpy(out, &word, take);
		out += take;
		len -= take;
	}
	return 0;
}
```
