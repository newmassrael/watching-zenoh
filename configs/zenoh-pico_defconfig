## deploy/Kconfig.capabilities
```kconfig
# SPDX-License-Identifier: LicenseRef-watching-zenoh-NonCommercial-1.0 OR LicenseRef-watching-zenoh-Commercial
# SPDX-FileCopyrightText: Copyright (c) 2026 newmassrael
#
# GENERATED from deploy/wz-config.toml by scripts/lib/wz_config.py --emit kconfig-capabilities.
# Do not edit: `wz_config.py --check` fails when this file is stale.

menu "wz C ABI capabilities"

config WZ_CAP_LINK_UDP
	bool "link-udp"
	default y
	help
	  A udp/ endpoint to dial, and the transport the scouting group rides.
	  zenoh-pico's switch for it: Z_FEATURE_LINK_UDP_UNICAST.
	  Exported by: pico, c.

config WZ_CAP_TIMESTAMPING
	bool "timestamping"
	default y
	help
	  The node clock a role that stamps its messages holds (zenoh's router does by default).
	  Exported by: c.

config WZ_CAP_SCOUT
	bool "scout"
	default y
	select WZ_CAP_LINK_UDP
	help
	  z_scout, the hello family, and a client finding its router by scouting.
	  zenoh-pico's switch for it: Z_FEATURE_SCOUTING.
	  Exported by: pico, c.

config WZ_CAP_PEER
	bool "peer"
	default y
	select WZ_CAP_SCOUT
	help
	  A listener, a router or a peer: the roles beyond the client. Off, z_open refuses them.
	  zenoh-pico's switch for it: Z_FEATURE_UNICAST_PEER.
	  Exported by: pico, c.

config WZ_CAP_MULTICAST_TRANSPORT
	bool "multicast-transport"
	default y
	select WZ_CAP_LINK_UDP
	select WZ_CAP_PEER
	help
	  A UDP multicast group a peer joins: one transport to every member of the group.
	  zenoh-pico has it when all of these are on: Z_FEATURE_LINK_UDP_MULTICAST, Z_FEATURE_MULTICAST_TRANSPORT.
	  Exported by: pico, c.

config WZ_CAP_MULTICAST_DECLARATIONS
	bool "multicast-declarations"
	default n
	select WZ_CAP_MULTICAST_TRANSPORT
	help
	  pico's multicast declarations: interests, keyexpr declarations and the write filter on a group.
	  zenoh-pico's switch for it: Z_FEATURE_MULTICAST_DECLARATIONS.
	  Exported by: pico.

config WZ_CAP_RAWETH_TRANSPORT
	bool "raweth-transport"
	default n
	select WZ_CAP_MULTICAST_TRANSPORT
	help
	  pico's raw Ethernet transport: a group over L2 frames on one interface (Linux, CAP_NET_RAW).
	  zenoh-pico's switch for it: Z_FEATURE_RAWETH_TRANSPORT.
	  Exported by: pico.

config WZ_CAP_QUERY
	bool "query"
	default y
	help
	  z_get and the querier: the requesting end of a query.
	  zenoh-pico's switch for it: Z_FEATURE_QUERY.
	  Exported by: pico, c.

config WZ_CAP_QUERYABLE
	bool "queryable"
	default y
	help
	  z_declare_queryable and the replies: the answering end of a query.
	  zenoh-pico's switch for it: Z_FEATURE_QUERYABLE.
	  Exported by: pico, c.

config WZ_CAP_LIVELINESS
	bool "liveliness"
	default y
	help
	  The liveliness token and subscriber.
	  zenoh-pico's switch for it: Z_FEATURE_LIVELINESS.
	  Exported by: pico, c.

config WZ_CAP_LIVELINESS_GET
	bool "liveliness-get"
	default y
	select WZ_CAP_LIVELINESS
	select WZ_CAP_QUERY
	help
	  The snapshot get of the liveliness plane; it is a query.
	  zenoh-pico has it when all of these are on: Z_FEATURE_LIVELINESS, Z_FEATURE_QUERY.
	  Exported by: pico, c.

config WZ_CAP_ADVANCED
	bool "advanced"
	default y
	select WZ_CAP_LIVELINESS
	select WZ_CAP_QUERYABLE
	select WZ_CAP_TIMESTAMPING
	select WZ_CAP_UNSTABLE_API
	help
	  The advanced publisher and subscriber (cache, history, miss detection).
	  zenoh-pico's switches for it, either of which asks for it: Z_FEATURE_ADVANCED_PUBLICATION, Z_FEATURE_ADVANCED_SUBSCRIPTION.
	  Exported by: pico, c.

config WZ_CAP_ADVANCED_SOURCE_RETENTION
	bool "advanced-source-retention"
	default y
	help
	  The advanced subscriber's sweep of its sources: every retention period a source not heard from and whose token is gone lets go of its row. Off, a source keeps its row until the subscriber goes or a new source takes the row met longest ago, as zenoh-pico's subscriber keeps its sources.
	  Exported by: pico.

config WZ_CAP_ADVANCED_NODE_CLOCK
	bool "advanced-node-clock"
	default y
	help
	  The node clock an advanced publisher stamps from: a hybrid logical clock under the clock-quality-stamping policy, whose trusted-only refuses a sample while the clock is not trusted. Off, a sample takes the system clock's time, ordered by the session's last time given, as zenoh-pico's publisher stamps with z_timestamp_new, and trusted-only refuses none.
	  Exported by: pico.

config WZ_CAP_CLOCK_SOURCE
	bool "clock-source"
	default n
	select WZ_CAP_TIMESTAMPING
	select WZ_CAP_UNSTABLE_API
	help
	  Register a clock source the node reads instead of the system clock, and report whether it is synchronised.
	  Exported by: pico, c.

config WZ_CAP_EVENT_RING
	bool "event-ring"
	default n
	select WZ_CAP_UNSTABLE_API
	help
	  Write events into the node's event ring and read them back, with no text stored.
	  Exported by: pico, c.

config WZ_CAP_SUPERVISION
	bool "supervision"
	default n
	select WZ_CAP_UNSTABLE_API
	help
	  Supervise checkpoints an application feeds, and run a hook once when one misses its deadline.
	  Exported by: pico, c.

config WZ_CAP_RESOURCE_SNAPSHOT
	bool "resource-snapshot"
	default n
	select WZ_CAP_UNSTABLE_API
	help
	  Take a snapshot of the node's resources and the spacing of the messages it receives.
	  Exported by: pico, c.

config WZ_CAP_POOL_MONITOR
	bool "pool-monitor"
	default n
	help
	  Record how full each of the node's fixed pools has been and list every pool's occupancy and refusals.
	  Exported by: .

config WZ_CAP_SESSION_MEMORY
	bool "session-memory"
	default n
	select WZ_CAP_UNSTABLE_API
	help
	  Report the most memory a session holds, part by part, computed from the limits it opened under: its tables, its handle and the queues and buffers of its links (zext_session_memory, zext_session_memory_row, wz-own doors).
	  Exported by: pico.

config WZ_CAP_DECLARATIONS_SYNCED_EVENT
	bool "declarations-synced-event"
	default n
	help
	  Tell a declaration listener when the peer has sent everything it held, so what follows is live.
	  Exported by: pico.

config WZ_CAP_REMOTE_DECLARATION_WATCH
	bool "remote-declaration-watch"
	default n
	help
	  Name the peer a declaration event came from, as the zenoh id the session learned at the handshake.
	  Exported by: pico.

config WZ_CAP_GROUP
	bool "group"
	default y
	help
	  zenoh-ext group membership.
	  Exported by: c.

config WZ_CAP_GOSSIP
	bool "gossip"
	default n
	select WZ_CAP_PEER
	help
	  A session told of a node by one it holds a link to dials it.
	  Exported by: pico, c.

config WZ_CAP_ROUTER_NODE
	bool "router-node"
	default y
	select WZ_CAP_PEER
	select WZ_CAP_MULTICAST_TRANSPORT
	select WZ_CAP_QUERY
	select WZ_CAP_QUERYABLE
	select WZ_CAP_LIVELINESS
	select WZ_CAP_LIVELINESS_GET
	help
	  A router that forwards between its clients, and the node a gateway/south partition needs.
	  Exported by: c.

config WZ_CAP_UNSTABLE_API
	bool "unstable-api"
	default y
	help
	  pico's unstable API: entity ids, reliability, source info, the cancellation token, and their option fields.
	  zenoh-pico's switch for it: Z_FEATURE_UNSTABLE_API.
	  Exported by: pico.

config WZ_CAP_CONNECTIVITY
	bool "connectivity"
	default y
	select WZ_CAP_UNSTABLE_API
	help
	  pico's connectivity plane: transport and link snapshots, and their event listeners.
	  zenoh-pico's switch for it: Z_FEATURE_CONNECTIVITY.
	  Exported by: pico.

config WZ_CAP_ADMIN_SPACE
	bool "admin-space"
	default n
	select WZ_CAP_QUERYABLE
	select WZ_CAP_UNSTABLE_API
	help
	  pico's admin space: zp_start_admin_space, zp_stop_admin_space and the @/<zid>/pico/** documents.
	  zenoh-pico's switch for it: Z_FEATURE_ADMIN_SPACE.
	  Exported by: pico.

config WZ_CAP_LOCAL_SUBSCRIBER
	bool "local-subscriber"
	default n
	help
	  pico's session-local subscriptions: a session's own put reaches its own subscribers.
	  zenoh-pico's switch for it: Z_FEATURE_LOCAL_SUBSCRIBER.
	  Exported by: pico.

config WZ_CAP_LOCAL_QUERYABLE
	bool "local-queryable"
	default n
	help
	  pico's session-local queryables: a session's own get reaches its own queryables.
	  zenoh-pico's switch for it: Z_FEATURE_LOCAL_QUERYABLE.
	  Exported by: pico.

config WZ_CAP_MULTI_THREAD
	bool "multi-thread"
	default y
	help
	  pico's multi-threaded C ABI (task doors, host sync, blocking channels); off, the single-threaded one.
	  zenoh-pico's switch for it: Z_FEATURE_MULTI_THREAD.
	  Exported by: pico.

config WZ_CAP_TRANSPORT_TLS
	bool "transport_tls"
	default y
	help
	  The tls/ link, dial and accept, with the certificate material of transport/link/tls.
	  Exported by: c.

config WZ_CAP_TRANSPORT_QUIC
	bool "transport_quic"
	default y
	help
	  The quic/ link, dial and accept, with the certificate material of transport/link/tls.
	  Exported by: c.

config WZ_CAP_TRANSPORT_QUIC_DATAGRAM
	bool "transport_quic_datagram"
	default y
	select WZ_CAP_TRANSPORT_QUIC
	help
	  The quic-datagram/ link, over the quic link's connection and certificate material.
	  Exported by: c.

config WZ_CAP_TRANSPORT_WS
	bool "transport_ws"
	default y
	help
	  The ws/ link, dial and accept.
	  Exported by: c.

config WZ_CAP_TRANSPORT_UNIXSOCK_STREAM
	bool "transport_unixsock-stream"
	default y
	help
	  The unixsock-stream/ link, dial and accept, on a Unix target.
	  Exported by: c.

config WZ_CAP_TRANSPORT_MULTILINK
	bool "transport_multilink"
	default y
	help
	  The multilink establishment extension.
	  Exported by: c.

config WZ_CAP_AUTH_PUBKEY
	bool "auth_pubkey"
	default y
	help
	  The public-key handshake, from the RSA identity of transport/auth/pubkey.
	  Exported by: c.

config WZ_CAP_E2E_SENDER
	bool "e2e-sender"
	default n
	select WZ_CAP_UNSTABLE_API
	help
	  The sending side of an end-to-end protected message: a frame built under a profile with the counter kept per stream (wz_capi_c_e2e_sender_*, zext_e2e_sender_*, wz-own doors) and the frame writer behind it.
	  Exported by: pico, c.

config WZ_CAP_E2E_RECEIVER
	bool "e2e-receiver"
	default n
	select WZ_CAP_UNSTABLE_API
	help
	  The receiving judge of end-to-end protected frames: per-stream state, the judging rules a profile states, and a status per sample (zext_e2e_receiver_*, wz-own doors).
	  Exported by: pico.

config WZ_CAP_E2E_SENDER_DEMUX
	bool "e2e-sender-demux"
	default n
	select WZ_CAP_E2E_RECEIVER
	help
	  Judging state per sender for the receiving judge, keyed by a header field, in slots bound by a list or taken in arrival order (E2E_SENDER_SLOTS).
	  Exported by: pico.

config WZ_CAP_INSTANCE_KEY
	bool "instance-key"
	default n
	select WZ_CAP_UNSTABLE_API
	help
	  The instance of a message a sample is, read from fields of its payload: a stream of the end-to-end doors and a last value per instance, samples of no instance dropped and counted (zext_instance_keyer_*, wz-own doors; INSTANCE_KEY_FIELDS, INSTANCES_PER_MESSAGE).
	  Exported by: pico.

config WZ_CAP_CONFIG_VERDICT
	bool "config-verdict"
	default y
	help
	  A configuration judged, emitted and costed without opening it: the defects of one node and of a topology, the config a stock node would start with, the link schemes of the build, and what an open of it asks of the operating system (wz_capi_c_config_validate*, wz_capi_c_config_to_json5, wz_capi_c_config_*link_scheme*, wz_capi_c_config_verdict_*, wz_capi_c_config_device_requires, wz-own doors).
	  Exported by: c.

config WZ_CAP_IDENTITY_MAKE
	bool "identity-make"
	default n
	select WZ_CAP_TRANSPORT_TLS
	help
	  The identity a client presents over TLS, made on the computer it runs on by the contract of a declared node's --make-identity (wz_capi_c_identity_make, a wz-own door), answering the zid its key names.
	  Exported by: c.

config WZ_CAP_LIFECYCLE_DOORS
	bool "lifecycle-doors"
	default n
	help
	  A node's lifecycle verbs from a client: the key a verb is asked by and the answer read back (wz_capi_c_lifecycle_key, wz_capi_c_lifecycle_read, wz-own doors over lifecycle_wire).
	  Exported by: c.

config WZ_CAP_SEGMENT_SENDER
	bool "segment-sender"
	default n
	select WZ_CAP_UNSTABLE_API
	help
	  The sending side of a declared segment profile: one message cut into the pieces the profile's header describes, put on a publisher or handed to a callback (wz_capi_c_segment_sender_*, zext_segment_sender_*, wz-own doors).
	  Exported by: pico, c.

config WZ_CAP_E2E_SUPERVISION
	bool "e2e-supervision"
	default n
	select WZ_CAP_UNSTABLE_API
	help
	  Supervise the reception of periodic streams: a deadline per stream, a loss told once, saturating error counts, a start delay, an application condition and absent senders (zext_stream_supervisor_*, wz-own doors).
	  Exported by: pico.

config WZ_CAP_REPLAY_CACHE
	bool "replay-cache"
	default n
	select WZ_CAP_UNSTABLE_API
	select WZ_CAP_QUERY
	select WZ_CAP_QUERYABLE
	select WZ_CAP_REMOTE_DECLARATION_WATCH
	select WZ_CAP_E2E_RECEIVER
	help
	  Replay what each publisher last sent to a subscriber that arrives later: a ring of sent frames per instance, answered on a suffixed key, asked of each publisher as it appears and merged with live data in one stated order (zext_replay_*, wz-own doors).
	  Exported by: pico.

config WZ_CAP_MESSAGE_CATALOG
	bool "message-catalog"
	default n
	select WZ_CAP_UNSTABLE_API
	help
	  A deployment's messages declared once, as data, and read at run time: the entry of each message, and the e2e sender, receiver and supervision rows made from it (zext_message_catalog_*, wz-own doors).
	  Exported by: pico.

config WZ_CAP_MESSAGE_PAYLOAD
	bool "message-payload"
	default n
	select WZ_CAP_UNSTABLE_API
	select WZ_CAP_MESSAGE_CATALOG
	help
	  The payload of a catalog message set and read field by field, by path, under .proto files read at run time, and its protobuf bytes encoded and decoded (zext_payload_schema_*, zext_message_payload_*, wz-own doors).
	  Exported by: pico.

config WZ_CAP_PROTO_TEXT
	bool "proto-text"
	default n
	select WZ_CAP_UNSTABLE_API
	help
	  The message payload and instance key doors that read a schema from .proto text at run time (zext_payload_schema_new, zext_instance_keyer_new, wz-own doors); without it a schema is read only from the FileDescriptorSet protoc compiled.
	  Exported by: pico.

config WZ_CAP_APP_TRANSPORT
	bool "app-transport"
	default n
	select WZ_CAP_UNSTABLE_API
	help
	  A transport the program supplies in place of the system's sockets: the session calls the program's open, send and close, and the program hands in what its stack received and what happened to each link (zext_transport_*, zext_config_transport, wz-own doors).
	  Exported by: pico.

config WZ_CAP_TIME_BASE
	bool "time-base"
	default n
	select WZ_CAP_UNSTABLE_API
	help
	  A time base the program supplies in place of the system's clock: the timers of a session opened from a config that names it (lease, keep-alive, handshake and the other deadlines) run on the program's time, which the program reads to the library and says when it has moved on (zext_time_base_* and zext_config_time_base, wz_capi_c_time_base_* and wz_capi_c_config_time_base, wz-own doors).
	  Exported by: pico, c.

config WZ_CAP_OBJECT_POOL
	bool "object-pool"
	default n
	select WZ_CAP_UNSTABLE_API
	help
	  The doors through which a program reserves the fixed pools the objects it holds outside a session are taken from (sessions, publishers, subscribers, queryables, liveliness tokens and subscribers, owned samples, replies, queries and payloads, configs and kept hellos) with counts of its own, and reads what they hold; a full pool refuses the object with _Z_ERR_SYSTEM_OUT_OF_MEMORY. A library without the tokio engine has the pools without the doors, reserved by its first object from the build's limits (zext_object_pool_*, wz-own doors).
	  Exported by: pico.

config WZ_CAP_OBJECT_POOL_REGION
	bool "object-pool-region"
	default n
	select WZ_CAP_OBJECT_POOL
	help
	  The object pools laid over memory the program hands over in place of one heap allocation (zext_object_pool_place, a wz-own door).
	  Exported by: pico.

config WZ_CAP_SHARED_KEY_IDS
	bool "shared-key-ids"
	default n
	select WZ_CAP_UNSTABLE_API
	help
	  Key ids every node of a deployment shares: a dictionary of key expressions and their ids given at open, and the key-wire form of one endpoint stated apart (the zext/key-ids member of a configuration document, and zext_config_key_ids and zext_config_key_wire_form_for, wz-own doors over it), so a put, a query, a reply or a declaration names its key by the id with no declaration first, as the key-wire-form policy says.
	  Exported by: pico, c.

config WZ_CAP_RX_CALLBACK_OFFLOAD
	bool "rx-callback-offload"
	default n
	help
	  A subscriber whose callback runs off the receive path: every face copies its samples into one bounded lane and the callback runs on the application runtime, in order (wz_capi_c_declare_subscriber_offloaded, wz_capi_c_subscriber_offload_stats, wz-own doors).
	  Exported by: c.

config WZ_CAP_SWITCH_DOORS
	bool "switch-doors"
	default n
	select WZ_CAP_QUERY
	select WZ_CAP_QUERYABLE
	select WZ_CAP_LIVELINESS
	help
	  The statements of a call beyond the zenoh-c options: the links an entity may use, a publish's retry and all-or-none form, a query's target node (the wz_capi_c_*_ext doors, wz-own, refused while the policy that admits the statement is off).
	  Exported by: c.

config WZ_CAP_CONFIG_POLICY
	bool "config-policy"
	default y
	help
	  zext_config_policy and zext_config_profile: a pico config states the policies and the profile of the sessions it opens, which the open resolves over the build's defaults (wz-own). Off, a session runs under the build's policies and limits and the open resolves none.
	  Exported by: pico.

config WZ_CAP_CONFORMANCE_DIGEST
	bool "conformance-digest"
	default y
	help
	  zext_conformance_digest: the digest of the configuration this library was built with, which equals the digest of the build statement that describes it (wz-own).
	  Exported by: pico.

config WZ_CAP_CONFIG_DOCUMENT
	bool "config-document"
	default n
	select WZ_CAP_CONFIG_POLICY
	help
	  zext_config_document: a pico config is handed the zenoh JSON5 document the zenoh-c ABI reads, and its zext member states the session's profile and policies (wz-own).
	  Exported by: pico.

config WZ_CAP_DEVICE_REQUIRES
	bool "device-requires"
	default y
	select WZ_CAP_UNSTABLE_API
	help
	  zext_config_device_requires: what an open of a pico config would ask of the operating system, in the facility words of the target manifest (wz-own).
	  Exported by: pico.

config WZ_CAP_TX_PROBE
	bool "tx-probe"
	default y
	help
	  The send that may not wait for room: a listening session whose links share fewer outbound slots than they are sends each face without waiting and waits for a slot with nothing of the session held (wz-own). Off, each face is sent by the caller's own send, which waits for its slot, as zenoh-pico's peer does.
	  Exported by: pico.

config WZ_CAP_TX_EXPIRY_RUN
	bool "tx-expiry-run"
	default y
	help
	  The run of blocking messages that found no room, which closes a session the tx-expiry-keeps-session policy keeps once it is TX_EXPIRY_CLOSE_AFTER long (wz-own). Off, a kept expiry never closes the session and its lease alone decides, as zenoh-pico's does; a statement of TX_EXPIRY_CLOSE_AFTER is refused.
	  Exported by: pico.

config WZ_CAP_TX_FRAGMENT_CREDIT
	bool "tx-fragment-credit"
	default y
	help
	  A session's budget of fragments, and the stop fragment that tells the peer a chain was cut once some of it left (wz-own). Off, a chain is never cut for want of credit, and one its link cuts ends where it was cut, as zenoh-pico's does.
	  Exported by: pico.

config WZ_CAP_TX_HELD_WAIT
	bool "tx-held-wait"
	default y
	help
	  A droppable message that finds its conduit or its session held by another send waits for room out of its own wait_before_drop, under zenoh's queue profile (wz-own). Off, it is dropped at once and its sender told under every profile, as zenoh-pico's dropping send is.
	  Exported by: pico.

config WZ_CAP_TX_STREAM_OWED
	bool "tx-stream-owed"
	default y
	help
	  A stream link's send that never waits for its stream: the part of a frame the stream did not take is owed in the frame's slot and written by a later step, and the link answers a question of room from its stream within the message's own wait, as zenoh's queue does. Off, each frame is written whole by a send that waits for its stream, as zenoh-pico's link write does, and the link has room whenever it has a slot.
	  Exported by: pico.

config WZ_CAP_DIAL_IN_FLIGHT
	bool "dial-in-flight"
	default y
	help
	  A dial that does not hold the session: a stream link's connect is begun without waiting and asked at each later step, and a connect refused once under way passes to the next address its host resolved to. Off, a dial connects and waits in the call that begins it, walking the host's addresses there, as zenoh-pico's open does, so a connect the other end does not answer holds the open or the redial for as long.
	  Exported by: pico.

config WZ_CAP_DIAL_ADDRESS_READER
	bool "dial-address-reader"
	default y
	help
	  A dial reads the address its endpoint writes with wz's own reader, held to zenoh's grammar of a socket address, and hands the host's resolver names alone, a name being a text whose last label opens with a letter. Off, every host a dial names over a network that resolves, an address as well as a name, is handed to the resolver, as zenoh-pico hands it to getaddrinfo, so an address is read by the C library's grammar and a text it reads no address in is refused as a host it answers none for.
	  Exported by: pico.

config WZ_CAP_CONFIG_LIMITS
	bool "config-limits"
	default y
	help
	  ZEXT_CONFIG_LIMITS_KEY: the numbered config key by which a program states its session's limits and the values it holds apart from any session, judged at the insert and read by the open (wz-own). Off, the key is held unread as zenoh-pico's config holds a key it does not know, and every session opens each table at the preset's bound, what a statement could have raised it to.
	  Exported by: pico.

config WZ_CAP_INTEREST_ANSWER
	bool "interest-answer"
	default y
	select WZ_CAP_PEER
	help
	  The answering end of a peer's Interest on a unicast face: the session's declarations the Interest reaches and its DeclareFinal, and for a future Interest the ones declared later, kept current (wz-own). Off, a peer's Interest on a unicast face is not answered, as zenoh-pico's unicast session does, and a new peer is told the session's declarations once, ended by the DeclareFinal of interest 0.
	  Exported by: pico.

config WZ_CAP_TRANSPORT_COMPRESSION
	bool "transport_compression"
	default y
	help
	  The batch compression extension: a session offers it and accepts a compressed batch.
	  Exported by: c.

config WZ_CAP_AUTH_USRPWD
	bool "auth_usrpwd"
	default y
	help
	  The user/password handshake method, and the credential check of a listener that names a dictionary file.
	  Exported by: c.

config WZ_CAP_INTERCEPTORS
	bool "interceptors"
	default y
	help
	  The traffic policy a node's config states: access_control, low_pass_filter, downsampling and the qos/network overwrite, enforced on every face; a build without it refuses a config that states one, by its key.
	  Exported by: c.

config WZ_CAP_MULTICAST_LOCATOR_KEYS
	bool "multicast-locator-keys"
	default y
	help
	  A group endpoint's #ttl=, #bind= and #dscp=: the hop limit, the local address of the send socket and the traffic class of what a member sends (wz-own). Off, each is refused by name when the group's endpoint is read, as zenoh-pico's multicast link reads iface and join alone.
	  Exported by: pico.

config WZ_CAP_QUERY_REPLIES_WITH_FINAL
	bool "query-replies-with-final"
	default y
	help
	  The replies a queryable's callbacks make wait in the face's open frame and leave with the query's Final in one send (wz-own). Off, each reply leaves as its callback makes it and the Final after the callbacks, possibly in a later frame, as zenoh-pico's are sent.
	  Exported by: pico.

config WZ_CAP_UDP_LISTEN
	bool "udp-listen"
	default y
	select WZ_CAP_PEER
	help
	  A unicast udp/ endpoint a peer listens on: one socket whose peers are told apart by the address each datagram came from, each a face of its own (wz-own). Off, a udp/ endpoint to listen on is refused by name as a scheme the links do not carry, as zenoh-pico's POSIX link has no such listener, and a peer accepts over tcp/ alone.
	  Exported by: pico.

config WZ_CAP_LINK_ADMISSION
	bool "link-admission"
	default y
	select WZ_CAP_PEER
	help
	  One link to a remote node when both dial, or one dials twice: each link is asked about in its handshake, and a second link to a node the session holds is refused with MAX_LINKS, the one the node with the lower zid dialled being kept at both ends (wz-own). Off, every link that ends its handshake is a face of its own, as each link zenoh-pico's peer accepts or dials is a peer of its own, so two nodes that dial each other hold two faces.
	  Exported by: pico.

config WZ_CAP_ACCEPT_COOKIE
	bool "accept-cookie"
	default y
	select WZ_CAP_PEER
	help
	  The stateless acceptor, upstream zenoh's: the InitAck carries what the handshake negotiated, sealed (HMAC-SHA256) under a key drawn for each attempt and bound to it by a nonce, the acceptor holds nothing of the accept until the OpenSyn, and only an OpenSyn that echoes that cookie is admitted. Off, each accept is held by its link's session until the OpenSyn, as under handshake-cookie = fixed whatever that policy states, and the InitAck carries the session's configured cookie, empty unless one is stated, as zenoh-pico's acceptor answers with an empty cookie; nothing is drawn for it and no cookie codec is linked.
	  Exported by: pico.

config WZ_CAP_FACE_SEND_PLACES
	bool "face-send-places"
	default y
	select WZ_CAP_PEER
	help
	  Each face its own send place: a put to one peer does not wait behind a send to another, a droppable one passes over a peer another send holds, and a declaration holds every peer's place before the session's (wz-own). Off, in the single-threaded library, every face shares one send place, the session's lock, as zenoh-pico sends to every peer under one transmit lock: a put is one leg that writes each peer in turn, and a declaration runs under that lock alone. The multi-threaded library keeps each face's place either way.
	  Exported by: pico.

config WZ_CAP_HANDSHAKE_REGIONS
	bool "handshake-regions"
	default y
	help
	  The region extensions of the unicast establishment (wz-own): the peer's region name on its Init and the bound it announces for this node on its Open, each read and a malformed one refusing the handshake, and the bound this node announces for the peer decided before its Open, as zenoh's establishment does. Off, neither is read, each skipped as an extension the build does not know, as zenoh-pico's decoder skips it, so a malformed one refuses nothing, and no bound is announced.
	  Exported by: pico.

endmenu
```
