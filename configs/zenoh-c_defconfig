## deploy/Kconfig.policies
```kconfig
# SPDX-License-Identifier: LicenseRef-watching-zenoh-NonCommercial-1.0 OR LicenseRef-watching-zenoh-Commercial
# SPDX-FileCopyrightText: Copyright (c) 2026 newmassrael
#
# GENERATED from deploy/wz-config.toml by scripts/lib/wz_config.py --emit kconfig-policies.
# Do not edit: `wz_config.py --check` fails when this file is stale.

menu "wz policies"

comment "Each policy is behaviour beyond upstream; the default of every one is upstream's."

choice WZ_POLICY_MULTICAST_LOOPBACK
	prompt "multicast-loopback"
	default WZ_POLICY_MULTICAST_LOOPBACK_OS_DEFAULT
	help
	  Whether a datagram a node sends to a multicast group is also delivered to
	  members of that group on the same host. `os-default` leaves the operating
	  system's setting alone. `on` and `off` set it on every multicast socket the
	  node opens: `on` is for nodes that share a host and must hear one another,
	  `off` for a node that must not hear its own host's traffic.
	  Upstream: Never sets IP_MULTICAST_LOOP on a multicast socket, so each sending
	  socket keeps the operating system's setting.

config WZ_POLICY_MULTICAST_LOOPBACK_OS_DEFAULT
	bool "os-default"

config WZ_POLICY_MULTICAST_LOOPBACK_ON
	bool "on"

config WZ_POLICY_MULTICAST_LOOPBACK_OFF
	bool "off"

endchoice

config WZ_POLICY_TX_NO_PROGRESS_DEADLINE
	bool "tx-no-progress-deadline"
	default n
	help
	  Whether a blocking message gets a second bound beside its total wait: the
	  wait with no progress. Off, only the total wait bounds it. On, it is also
	  given up when TX_NO_PROGRESS_WINDOW_US passes with no fragment out, and the
	  total wait still ends it, whichever comes first. A fragment out is progress
	  and starts the window again, and the total wait is never made longer.
	  Upstream: Gives a blocking message one wait_before_close for the whole of it,
	  however many fragments go out: its deadline has no cap to extend by, so a
	  fragment out leaves the deadline where it is.

config WZ_POLICY_TX_EXPIRY_KEEPS_SESSION
	bool "tx-expiry-keeps-session"
	default n
	help
	  What happens when a blocking message finds no room within its deadline. Off,
	  the session is closed as unresponsive and the send reports success. On, the
	  message is dropped, the send reports that the transport was not available,
	  and the session stays open: a slow link costs the message and not the
	  session. A link that stays blocked is closed after TX_EXPIRY_CLOSE_AFTER such
	  messages in a row, when that limit is not 0. A multicast group never closes
	  either way.
	  Upstream: Closes the session as unresponsive when a blocking message found no
	  room in its deadline, and tells the sender nothing.

config WZ_POLICY_DECLARATION_SYNC_PACING
	bool "declaration-sync-pacing"
	default n
	help
	  How a node tells a peer its declarations again after a reconnect. Off, all of
	  them are sent at once. On, they are sent in turns of
	  DECLARATION_SYNC_BURST_MESSAGES with DECLARATION_SYNC_INTERVAL_MS between
	  turns, and the session is served during the waits, so a node with many
	  declarations does not hand its peer a burst or stop answering while it sends
	  them. A declaration made while the replay runs is sent in its turn, after
	  everything it depends on; the retraction of one the peer was never told of
	  sends nothing.
	  Upstream: Replays every declaration it holds to a new peer in one call, as
	  soon as the session is open again.

config WZ_POLICY_ENTITY_TIMESTAMP_OPT_IN
	bool "entity-timestamp-opt-in"
	default n
	help
	  What an entity does with a timestamp when its declaration says nothing. Off,
	  a subscriber and a querier see the timestamp of what they receive, and any
	  publisher attaches the timestamp it is given. On, an entity takes part only
	  if it was declared to: a subscriber or a querier sees no timestamp unless it
	  asks to, and a publisher refuses a timestamped put unless it was declared to
	  stamp. Each declaration can still state its own choice either way; this sets
	  the default for the ones that do not. A publisher given a time supplies its
	  own node identity, so a caller cannot sign a sample as another node.
	  Upstream: Hands every received sample's timestamp to the subscriber and every
	  reply's to the querier, and lets any publisher attach the timestamp it is
	  given.

choice WZ_POLICY_SUBSCRIBER_OVERLOAD
	prompt "subscriber-overload"
	default WZ_POLICY_SUBSCRIBER_OVERLOAD_BLOCK
	help
	  What a subscriber whose callback runs off the receive path does when its
	  delivery lane is full and its declaration says nothing. `block` makes the
	  session wait for room, outside the lock the receive path holds, so the
	  transport's own backpressure is the flow control and no sample is lost.
	  `reject` refuses the sample at once: the receive path is never held, the sample
	  is lost, and it is counted by reason and by whether it was sent reliably. A
	  sample longer than the whole lane can never wait for room, so it is refused
	  either way. Each declaration can still state its own choice; this sets the
	  default for the ones that do not.
	  Upstream: Hands a sample to a channel handler that blocks its sender when the
	  handler is full, so a slow consumer applies backpressure into the session and
	  no sample is lost.

config WZ_POLICY_SUBSCRIBER_OVERLOAD_BLOCK
	bool "block"

config WZ_POLICY_SUBSCRIBER_OVERLOAD_REJECT
	bool "reject"

endchoice

choice WZ_POLICY_KEY_SET
	prompt "key-set"
	default WZ_POLICY_KEY_SET_OPEN
	help
	  Which keys the receive path takes a message on (docs/closed-key-set.md). `open` takes
	  any key a peer sends. `closed` takes only the keys the image declares as its key set,
	  which the build generates into a read-only table: a message on any other key is dropped
	  before a subscriber is looked up, and counted by reason. A closed build that is given
	  no table takes no key at all. The selectors a peer asks with, a query or an interest,
	  are patterns and not data keys, and are answered as in an open build. `closed` needs the
	  cargo feature `key-set-closed` of wz-session-core, which compiles the mode in; a build that
	  states it without the feature does not compile, and an open build has neither the code
	  nor its bytes.
	  Upstream: Takes a message on any key a peer sends, and finds the subscribers
	  it reaches by matching that key against each subscription's pattern as text.

config WZ_POLICY_KEY_SET_OPEN
	bool "open"

config WZ_POLICY_KEY_SET_CLOSED
	bool "closed"

endchoice

choice WZ_POLICY_SN_RESOLUTION
	prompt "sn-resolution"
	default WZ_POLICY_SN_RESOLUTION_BITS_32
	help
	  The width of the sequence numbers the sessions of the C interfaces advertise: in
	  the InitSyn of a unicast session, where the two sides take the smaller of the
	  two advertised widths, and in the Join of a multicast group, where a member
	  refuses a Join that states another width than its own, so every member of a
	  group states the same. `bits-32` is what zenoh and zenoh-pico advertise.
	  `bits-8`, `bits-16` and `bits-64` state that width instead, for a peer built
	  with a sequence-number width of its own. A session that negotiates a width
	  below its peer's runs the narrower ring of the two; a ring of 8 bits wraps
	  after 128 frames in flight, so a narrow width asks a deployment to know its
	  traffic. The request-id resolution is not part of this policy.
	  Upstream: Advertises the 32-bit sequence-number resolution in its InitSyn and
	  in the Join of a group, and has no setting for another: zenoh's `Resolution`
	  default and zenoh-pico's `Z_SN_RESOLUTION 0x02`.

config WZ_POLICY_SN_RESOLUTION_BITS_32
	bool "bits-32"

config WZ_POLICY_SN_RESOLUTION_BITS_8
	bool "bits-8"

config WZ_POLICY_SN_RESOLUTION_BITS_16
	bool "bits-16"

config WZ_POLICY_SN_RESOLUTION_BITS_64
	bool "bits-64"

endchoice

endmenu
```

## deploy/zephyr-common/Kconfig.wz
```kconfig
# SPDX-License-Identifier: LicenseRef-watching-zenoh-NonCommercial-1.0 OR LicenseRef-watching-zenoh-Commercial
# SPDX-FileCopyrightText: Copyright (c) 2026 newmassrael
#
# The Kconfig symbols every wz Zephyr application shares. An application's own
# `Kconfig` sources this file, then Zephyr's (`source "Kconfig.zephyr"`).

menu "wz Zephyr profile"

config WZ_ENABLE_CORE_CACHES
	bool "Enable the core's instruction and data caches at boot"
	depends on CACHE_MANAGEMENT
	help
	  Zephyr's port of some SoCs never enables the Cortex-M7's caches although
	  CONFIG_ICACHE and CONFIG_DCACHE are set (the Infineon CAT1C port is one: read
	  from a running T2G node, SCB->CCR had both cache bits clear, and the core ran
	  every instruction from flash without a cache). Select this on a board whose
	  port is such a one.

	  The instruction cache is enabled. The data cache is enabled only when the
	  build has a non-cacheable section (CONFIG_NOCACHE_MEMORY) and the MPU marks
	  every line of it non-cacheable, which the image reads from the MPU's own
	  registers at boot, after the MPU is set up: the MAC's descriptor rings and
	  buffer pools live in that section, and a bus master reading or writing
	  cacheable memory corrupts frames without any other symptom. When that does
	  not hold the data cache stays off and the console says why, in the line
	  `wz: caches: ...`.

config WZ_ENTROPY_BOARD_HOOK
	bool "The board supplies its own entropy source"
	help
	  The session draws its cookie nonces and its cookie-signing key through
	  `wzApplicationGetRandom`, which deploy/zephyr-common/wz_board_hooks.c answers
	  from Zephyr's entropy device when the build has one.

	  Select this on a board whose true random number generator is not a Zephyr
	  entropy driver: the board's own source file then defines
	  `int wz_board_entropy_fill(void *buf, size_t len)`, which fills the buffer
	  from the hardware TRNG and returns 0, or a non-zero value when it cannot. It
	  must fail rather than return what the buffer held.

	  Never a way to silence the build on a board that has no source: a board
	  with neither this nor an entropy driver does not compile, by design.

config WZ_CORE_CLOCK_BOARD_HOOK
	bool "The board reads its core clock from the chip's registers"
	help
	  An image is built for one core clock (CONFIG_SYS_CLOCK_HW_CYCLES_PER_SEC) and
	  nothing in the kernel checks that the silicon runs at it. On a chip whose
	  clock tree another core must bring up, a core that was started without that
	  runs at the oscillator and every wait lasts many times what it was asked to.

	  Select this on a board that can read the clock it really runs at: the board's
	  own source file then defines `uint32_t wz_board_core_clock_hz(void)`, which
	  returns that clock in hertz from the registers, or 0 when it cannot tell. The
	  image compares it with the clock it assumes before it waits for anything.

	  A board without this answers 0 to the image and is not checked, which is what
	  every emulated board does.

config WZ_LIBC_MEMCPY_FIRST
	bool "Link the C library before the Rust staticlib, so its memcpy family is the image's"
	help
	  The Rust staticlib carries `compiler_builtins`, whose generic, weak `memcpy`, `memmove`,
	  `memset` and `memcmp` are the first definitions the linker meets when the C library is
	  scanned after it (Zephyr puts it last), so the whole image (the kernel, the network
	  stack, every C application beside the Rust) runs them and never the library's own, which
	  on a Cortex-M is assembly. With this on, the library is scanned first and its strong
	  definitions are the image's.

	  MEASURED on the T2G kit (Cortex-M7, 350 MHz), same MAC, driver and Zephyr stack, three
	  rounds of 800 GETs, images alternated: with CONFIG_SPEED_OPTIMIZATIONS=y a GET answered by
	  the wz node takes 0.717 ms without this and 0.689 with it (the node's own turnaround on
	  the wire 0.478 -> 0.420 ms), and one answered by zenoh-pico 0.406 -> 0.380 ms. With the
	  default size optimization it is the other way: 0.805 -> 0.855 ms. So it is off by default
	  and an image that is built for speed turns it on; an image whose grade rests on a
	  witnessed run keeps the bytes it was witnessed with.

config WZ_ICACHE_OFF
	bool "Leave the instruction cache off (a diagnostic)"
	depends on WZ_ENABLE_CORE_CACHES
	help
	  Skips enabling the instruction cache, so a measurement can tell how much of a code path's
	  time is the cache's: a path that fits the cache slows by the flash's wait states when it is
	  off, and one that already misses it slows by less. Never in an image that is measured for
	  anything else.

config WZ_CODE_IN_RAM
	bool "Run the wz Rust staticlib's code from RAM instead of from flash"
	depends on ARCH_HAS_RAMFUNC_SUPPORT && XIP
	help
	  The image executes from flash in place, through the core's instruction cache. A query
	  handled by the wz node runs through more code than the cache holds, so each query
	  fetches part of it from flash again. With this on, the staticlib's `.text` is linked
	  into the `.ramfunc` output section, which Zephyr loads from flash into RAM at boot, and
	  its code is fetched from RAM.

	  An experiment with a measurement attached to it where it is turned on (the overlay that
	  turns it on states the numbers): off by default.

config WZ_OS
	bool "The kernel answers the engine's operating system (wz_os_*)"
	select DYNAMIC_THREAD
	select DYNAMIC_THREAD_ALLOC
	select THREAD_NAME
	help
	  An image whose Rust half builds `wz-capi-port` without `std` (the pico C ABI on the
	  cooperative engine, docs/upstream-parity.md section 5a) links the mutex, the thread
	  identity, the threads and the sleep its `os` module names from
	  deploy/zephyr-common/wz_os_zephyr.c: a `k_mutex` from the kernel heap, `k_current_get`,
	  a dynamic thread, `k_msleep`.

config WZ_OS_THREAD_STACK_SIZE
	int "The stack of a thread the engine starts, in bytes"
	depends on WZ_OS
	default 4096
	help
	  zenoh-pico's read task is one such thread. The memory report (WZ_MEMORY_REPORT) says how
	  much of it a run used.

config WZ_OS_THREAD_PRIORITY
	int "The priority of a thread the engine starts"
	depends on WZ_OS
	default 5

config WZ_MEMORY_REPORT
	bool "Report the kernel heap's peak and every thread's stack (a compare build)"
	select SYS_HEAP_RUNTIME_STATS
	select INIT_STACKS
	select THREAD_STACK_INFO
	select THREAD_MONITOR
	select THREAD_NAME
	help
	  A thread of the lowest application priority reads the kernel heap that `k_malloc`
	  serves and the stack of every thread, and prints `mem: heap peak N of M bytes` and
	  `mem: stack <thread> U of S bytes` when a figure moved (deploy/zephyr-common/
	  wz_memory_report.c). It is the one source of those figures in a compare run of the kit
	  lane (docs/upstream-parity.md step M3), so two images held to each other say them the
	  same way; it adds a thread and its stack to both. Off by default: an image measured for
	  anything else keeps the bytes it was measured with.

config WZ_MEMORY_REPORT_PERIOD_MS
	int "How often the memory report reads the kernel, in milliseconds"
	depends on WZ_MEMORY_REPORT
	default 1000

config WZ_MEMORY_REPORT_STACK_SIZE
	int "The memory report thread's stack, in bytes"
	depends on WZ_MEMORY_REPORT
	default 1024

endmenu
```
