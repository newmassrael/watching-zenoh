## deploy/zephyr-eth-wzmac/Kconfig.zeth
```kconfig
# SPDX-License-Identifier: LicenseRef-watching-zenoh-NonCommercial-1.0 OR LicenseRef-watching-zenoh-Commercial
# SPDX-FileCopyrightText: Copyright (c) 2026 newmassrael
#
# The Zephyr drivers over the wz CYT4BF crates: an Ethernet driver for ETH0 and an entropy
# device for the CRYPTO block's TRNG. An application sources this file from its own
# Kconfig, adds this directory to DTS_ROOT (zeth.cmake does), and states the two devices in
# an overlay; a node in the devicetree is what turns each driver on.

config WZ_ZETH
	bool "Ethernet driver for the CYT4BF's ETH0, over the wz MAC crate"
	default y
	depends on DT_HAS_WZ_CYT4BF_ETH_ENABLED
	depends on NETWORKING
	select NET_L2_ETHERNET
	select WZ_CORE_CLOCK_BOARD_HOOK
	select WZ_CYT4BF_PINS_WANTED
	select INIT_STACKS
	select THREAD_STACK_INFO
	help
	  Zephyr has no Ethernet driver for this controller. This one is an
	  `ethernet_api` implementation whose frames go through `wz-eth-mac-cyt4bf`, the
	  same crate and the same bring-up the lwIP backend of the wz admin node uses, so
	  the controller is driven by one piece of code whichever network stack is above
	  it. The MAC is polled (the crate takes no interrupt); a thread of the driver
	  polls it.

	  The DMA rings are in the non-cacheable section, so the application needs
	  CONFIG_NOCACHE_MEMORY=y.

if WZ_ZETH

config WZ_ZETH_RX_STACK_SIZE
	int "Stack of the driver's receive thread, in bytes"
	default 4096
	help
	  The thread opens the MAC (pin routing, PHY bring-up, the console lines of each stage)
	  and then polls it. 2048 bytes held for a size-optimized build and overflowed the
	  stack guard in a speed-optimized one, whose frames are deeper. The driver prints how
	  much of the stack the open used.

config WZ_ZETH_RX_PRIORITY
	int "Priority of the driver's receive thread"
	default 14
	help
	  A preemptible priority below the network stack's own receive threads, so a frame
	  the driver hands up is processed before the next one is taken.

config WZ_ZETH_RX_POLL_INTERVAL_US
	int "How long the receive thread sleeps when the MAC has no frame, in microseconds"
	default 1000
	help
	  The MAC is polled, so this is a floor on a frame's wait to be taken, rounded up to
	  the kernel's tick (k_usleep). 0 does not sleep: the thread yields and polls again,
	  which is the lowest latency and keeps the CPU out of idle, for a measurement or a
	  node that has nothing else to do with it.

config WZ_ZETH_STAMPS
	bool "Tell where a query's time goes between the wire and the wire"
	help
	  Reads the cycle counter at four places of a query's round trip (the driver's receive,
	  the application's recvfrom and sendto, the driver's send) and prints the mean of the
	  gaps every 500 queries. The application is not changed: recvfrom and sendto are wrapped
	  at link time, so a wz node and a zenoh-pico application have the same instrument. A
	  diagnostic: the lines are writes to a UART, so no timing measured by anything else is
	  taken from an image that has it on.

config WZ_ZETH_STAMPS_COUNTS
	bool "Count the heap calls and the copies of a query, and name the sites of the big copies"
	depends on WZ_ZETH_STAMPS
	default y
	help
	  Wraps the heap's allocate and free and every copy function, so the line shows how many
	  of each a query makes and what they cost. Each wrapped call costs about 0.4 us itself,
	  and a query makes dozens, so an image that has it on is slower than one that does not and
	  a profile taken from it over-reads the wrappers. Off, the window is still marked (between
	  the application's recvfrom and sendto) and only the four gaps are measured, which is the
	  image to take a program-counter profile from.

config WZ_ZETH_STAMPS_RESOURCES
	bool "Print the kernel heap's peak and every thread's stack use with the stamps"
	depends on WZ_ZETH_STAMPS && SYS_HEAP_RUNTIME_STATS && INIT_STACKS && THREAD_STACK_INFO \
		   && THREAD_MONITOR
	help
	  Adds, to the line printed every 500 queries, the system heap's allocated and peak bytes
	  since boot and, for each thread, its stack's size and how much of it was ever used. The
	  same instrument for a wz node and a zenoh-pico application: it reads the kernel's own
	  records and changes neither application. The kernel options it reads are dependencies,
	  so an image that lacks one fails at configuration and does not print nothing.

endif # WZ_ZETH

# Set by whatever drives ETH0 (this driver, or the lwIP backend's MAC), so the pin routing
# below is offered to both and an application that has only one of them does not name the
# other's symbols.
config WZ_CYT4BF_PINS_WANTED
	bool

if WZ_CYT4BF_PINS_WANTED

choice WZ_CYT4BF_PINS
	prompt "ETH0 pin routing"

config WZ_CYT4BF_PINS_T2G_LITE
	bool "KIT_T2G-B-H_LITE (176-pin package, DP83825I over RMII)"
	help
	  REF_CLK P18_0, TX_EN P18_1, TXD0/1 P18_4/P18_5, RXD0/1 P19_0/P19_1, CRS_DV
	  P21_5, MDIO P3_0, MDC P3_1: the 176-pin package's ETH0 functions, which the
	  PDL's pin table lists, on the pins that kit's schematic uses.

endchoice

endif # WZ_CYT4BF_PINS_WANTED

config WZ_ZETH_TRNG
	bool "Entropy device over the CYT4BF CRYPTO block's TRNG"
	default y
	depends on DT_HAS_WZ_CYT4BF_TRNG_ENABLED
	select ENTROPY_GENERATOR
	select ENTROPY_HAS_DRIVER
	help
	  The board's `wz_board_entropy_fill` (the PDL's TRNG driver) as the entropy device
	  the devicetree names with `zephyr,entropy`.
```

## deploy/zephyr-eth-wzmac/dts/bindings/wz,cyt4bf-eth.yaml
```yaml
# SPDX-License-Identifier: LicenseRef-watching-zenoh-NonCommercial-1.0 OR LicenseRef-watching-zenoh-Commercial
# SPDX-FileCopyrightText: Copyright (c) 2026 newmassrael

description: |
  ETH0 of the Infineon CYT4BF (T2G) family, RMII, driven by wz's `wz-eth-mac-cyt4bf`
  crate through the Zephyr Ethernet driver in wz_zeth_driver.c. Zephyr has no driver
  for this controller; the node is what lets a Zephyr network stack (and an
  application written against it) sit on the MAC the wz crates already drive.

  The station address is the standard Ethernet controller's: `local-mac-address`
  when the board has one of its own, or `zephyr,random-mac-address` for one drawn at
  every boot. There is no default, and the driver refuses to start without one.

compatible: "wz,cyt4bf-eth"

include: ethernet-controller.yaml

properties:
  ref-clock-divider:
    type: int
    default: 0
    description: |
      0 when the PHY drives the RMII reference clock; otherwise the divider (1 to 256)
      of the internal PLL the MAC supplies it from.

  link-wait-ms:
    type: int
    default: 5000
    description: |
      How long the bring-up waits for a link, in milliseconds. A link that comes later
      is picked up by the driver's link service.
```

## deploy/zephyr-eth-wzmac/dts/bindings/wz,cyt4bf-trng.yaml
```yaml
# SPDX-License-Identifier: LicenseRef-watching-zenoh-NonCommercial-1.0 OR LicenseRef-watching-zenoh-Commercial
# SPDX-FileCopyrightText: Copyright (c) 2026 newmassrael

description: |
  The true random number generator in the CRYPTO block of the Infineon CYT4BF (T2G)
  family, as a Zephyr entropy device. Zephyr has no entropy driver for these chips, so a
  Zephyr network stack (its random MAC address, its sequence numbers) and zenoh-pico's
  random source would otherwise have nothing to draw from. The driver is a thin shell
  over the board's `wz_board_entropy_fill` (the PDL's TRNG driver), which fails the whole
  fill when the TRNG reports an error rather than return what the buffer held.

compatible: "wz,cyt4bf-trng"

include: base.yaml
```
