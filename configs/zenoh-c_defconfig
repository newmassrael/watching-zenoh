## deploy/Kconfig.capabilities
```kconfig
# SPDX-License-Identifier: LicenseRef-watching-zenoh-NonCommercial-1.0 OR LicenseRef-watching-zenoh-Commercial
# SPDX-FileCopyrightText: Copyright (c) 2026 newmassrael
#
# GENERATED from deploy/wz-config.toml by scripts/lib/wz_config.py --emit kconfig-capabilities.
# Do not edit: `wz_config.py --check` fails when this file is stale.

menu "wz C ABI capabilities"

config WZ_CAP_LINK_UDP
	bool "link-udp"
	default y
	help
	  A udp/ endpoint to dial, and the transport the scouting group rides.
	  zenoh-pico's switch for it: Z_FEATURE_LINK_UDP_UNICAST.
	  Exported by: pico, c.

config WZ_CAP_TIMESTAMPING
	bool "timestamping"
	default y
	help
	  The node clock a role that stamps its messages holds (zenoh's router does by default).
	  Exported by: c.

config WZ_CAP_SCOUT
	bool "scout"
	default y
	select WZ_CAP_LINK_UDP
	help
	  z_scout, the hello family, and a client finding its router by scouting.
	  zenoh-pico's switch for it: Z_FEATURE_SCOUTING.
	  Exported by: pico, c.

config WZ_CAP_PEER
	bool "peer"
	default y
	select WZ_CAP_SCOUT
	help
	  A listener, a router or a peer: the roles beyond the client. Off, z_open refuses them.
	  zenoh-pico's switch for it: Z_FEATURE_UNICAST_PEER.
	  Exported by: pico, c.

config WZ_CAP_MULTICAST_TRANSPORT
	bool "multicast-transport"
	default y
	select WZ_CAP_LINK_UDP
	select WZ_CAP_PEER
	help
	  A UDP multicast group a peer joins: one transport to every member of the group.
	  zenoh-pico has it when all of these are on: Z_FEATURE_LINK_UDP_MULTICAST, Z_FEATURE_MULTICAST_TRANSPORT.
	  Exported by: pico, c.

config WZ_CAP_MULTICAST_DECLARATIONS
	bool "multicast-declarations"
	default n
	select WZ_CAP_MULTICAST_TRANSPORT
	help
	  pico's multicast declarations: interests, keyexpr declarations and the write filter on a group.
	  zenoh-pico's switch for it: Z_FEATURE_MULTICAST_DECLARATIONS.
	  Exported by: pico.

config WZ_CAP_RAWETH_TRANSPORT
	bool "raweth-transport"
	default n
	select WZ_CAP_MULTICAST_TRANSPORT
	help
	  pico's raw Ethernet transport: a group over L2 frames on one interface (Linux, CAP_NET_RAW).
	  zenoh-pico's switch for it: Z_FEATURE_RAWETH_TRANSPORT.
	  Exported by: pico.

config WZ_CAP_QUERY
	bool "query"
	default y
	help
	  z_get and the querier: the requesting end of a query.
	  zenoh-pico's switch for it: Z_FEATURE_QUERY.
	  Exported by: pico, c.

config WZ_CAP_QUERYABLE
	bool "queryable"
	default y
	help
	  z_declare_queryable and the replies: the answering end of a query.
	  zenoh-pico's switch for it: Z_FEATURE_QUERYABLE.
	  Exported by: pico, c.

config WZ_CAP_LIVELINESS
	bool "liveliness"
	default y
	help
	  The liveliness token and subscriber.
	  zenoh-pico's switch for it: Z_FEATURE_LIVELINESS.
	  Exported by: pico, c.

config WZ_CAP_LIVELINESS_GET
	bool "liveliness-get"
	default y
	select WZ_CAP_LIVELINESS
	select WZ_CAP_QUERY
	help
	  The snapshot get of the liveliness plane; it is a query.
	  zenoh-pico has it when all of these are on: Z_FEATURE_LIVELINESS, Z_FEATURE_QUERY.
	  Exported by: pico, c.

config WZ_CAP_ADVANCED
	bool "advanced"
	default y
	select WZ_CAP_LIVELINESS
	select WZ_CAP_QUERYABLE
	select WZ_CAP_TIMESTAMPING
	select WZ_CAP_UNSTABLE_API
	help
	  The advanced publisher and subscriber (cache, history, miss detection).
	  zenoh-pico's switches for it, either of which asks for it: Z_FEATURE_ADVANCED_PUBLICATION, Z_FEATURE_ADVANCED_SUBSCRIPTION.
	  Exported by: pico, c.

config WZ_CAP_CLOCK_SOURCE
	bool "clock-source"
	default n
	select WZ_CAP_TIMESTAMPING
	select WZ_CAP_UNSTABLE_API
	help
	  Register a clock source the node reads instead of the system clock, and report whether it is synchronised.
	  Exported by: pico.

config WZ_CAP_EVENT_RING
	bool "event-ring"
	default n
	select WZ_CAP_UNSTABLE_API
	help
	  Write events into the node's event ring and read them back, with no text stored.
	  Exported by: pico.

config WZ_CAP_SUPERVISION
	bool "supervision"
	default n
	select WZ_CAP_UNSTABLE_API
	help
	  Supervise checkpoints an application feeds, and run a hook once when one misses its deadline.
	  Exported by: pico.

config WZ_CAP_GROUP
	bool "group"
	default y
	help
	  zenoh-ext group membership.
	  Exported by: c.

config WZ_CAP_GOSSIP
	bool "gossip"
	default y
	select WZ_CAP_PEER
	help
	  A session told of a node by one it holds a link to dials it.
	  Exported by: pico, c.

config WZ_CAP_UNSTABLE_API
	bool "unstable-api"
	default y
	help
	  pico's unstable API: entity ids, reliability, source info, the cancellation token, and their option fields.
	  zenoh-pico's switch for it: Z_FEATURE_UNSTABLE_API.
	  Exported by: pico.

config WZ_CAP_CONNECTIVITY
	bool "connectivity"
	default y
	select WZ_CAP_UNSTABLE_API
	help
	  pico's connectivity plane: transport and link snapshots, and their event listeners.
	  zenoh-pico's switch for it: Z_FEATURE_CONNECTIVITY.
	  Exported by: pico.

config WZ_CAP_ADMIN_SPACE
	bool "admin-space"
	default n
	select WZ_CAP_QUERYABLE
	select WZ_CAP_UNSTABLE_API
	help
	  pico's admin space: zp_start_admin_space, zp_stop_admin_space and the @/<zid>/pico/** documents.
	  zenoh-pico's switch for it: Z_FEATURE_ADMIN_SPACE.
	  Exported by: pico.

config WZ_CAP_LOCAL_SUBSCRIBER
	bool "local-subscriber"
	default n
	help
	  pico's session-local subscriptions: a session's own put reaches its own subscribers.
	  zenoh-pico's switch for it: Z_FEATURE_LOCAL_SUBSCRIBER.
	  Exported by: pico.

config WZ_CAP_LOCAL_QUERYABLE
	bool "local-queryable"
	default n
	help
	  pico's session-local queryables: a session's own get reaches its own queryables.
	  zenoh-pico's switch for it: Z_FEATURE_LOCAL_QUERYABLE.
	  Exported by: pico.

config WZ_CAP_MULTI_THREAD
	bool "multi-thread"
	default y
	help
	  pico's multi-threaded C ABI (task doors, host sync, blocking channels); off, the single-threaded one.
	  zenoh-pico's switch for it: Z_FEATURE_MULTI_THREAD.
	  Exported by: pico.

config WZ_CAP_TRANSPORT_TLS
	bool "transport_tls"
	default y
	help
	  The tls/ link, dial and accept, with the certificate material of transport/link/tls.
	  Exported by: c.

config WZ_CAP_TRANSPORT_QUIC
	bool "transport_quic"
	default y
	help
	  The quic/ link, dial and accept, with the certificate material of transport/link/tls.
	  Exported by: c.

config WZ_CAP_TRANSPORT_QUIC_DATAGRAM
	bool "transport_quic_datagram"
	default y
	select WZ_CAP_TRANSPORT_QUIC
	help
	  The quic-datagram/ link, over the quic link's connection and certificate material.
	  Exported by: c.

config WZ_CAP_TRANSPORT_WS
	bool "transport_ws"
	default y
	help
	  The ws/ link, dial and accept.
	  Exported by: c.

config WZ_CAP_TRANSPORT_UNIXSOCK_STREAM
	bool "transport_unixsock-stream"
	default y
	help
	  The unixsock-stream/ link, dial and accept, on a Unix target.
	  Exported by: c.

config WZ_CAP_TRANSPORT_MULTILINK
	bool "transport_multilink"
	default y
	help
	  The multilink establishment extension.
	  Exported by: c.

config WZ_CAP_AUTH_PUBKEY
	bool "auth_pubkey"
	default y
	help
	  The public-key handshake, from the RSA identity of transport/auth/pubkey.
	  Exported by: c.

config WZ_CAP_E2E_SENDER
	bool "e2e-sender"
	default y
	help
	  The sending side of an end-to-end protected message (wz_capi_c_e2e_sender_*, wz-own doors) and the frame writer behind it.
	  Exported by: c.

config WZ_CAP_TRANSPORT_COMPRESSION
	bool "transport_compression"
	default y
	help
	  The batch compression extension: a session offers it and accepts a compressed batch.
	  Exported by: c.

config WZ_CAP_AUTH_USRPWD
	bool "auth_usrpwd"
	default y
	help
	  The user/password handshake method, and the credential check of a listener that names a dictionary file.
	  Exported by: c.

config WZ_CAP_INTERCEPTORS
	bool "interceptors"
	default y
	help
	  The traffic policy a node's config states: access_control, low_pass_filter and downsampling, enforced on every face.
	  Exported by: c.

endmenu
```
