## deploy/Kconfig.limits
```kconfig
# SPDX-License-Identifier: LicenseRef-watching-zenoh-NonCommercial-1.0 OR LicenseRef-watching-zenoh-Commercial
# SPDX-FileCopyrightText: Copyright (c) 2026 newmassrael
#
# GENERATED from deploy/wz-config.toml by scripts/lib/wz_config.py --emit kconfig-limits.
# Do not edit: `wz_config.py --check` fails when this file is stale.

menu "wz limits"

comment "Each limit sizes a table of every session of the image; a build states its own."

config WZ_LIMIT_MAX_KEYEXPR_BYTES
	int "MAX_KEYEXPR_BYTES"
	default 256
	help
	  The longest key expression, in bytes, a session stores: a subscription's
	  pattern, or a key a peer declared. A longer one is refused, never cut short.
	  Every table that stores keys sizes its rows by this.

config WZ_LIMIT_MAX_SUBSCRIPTIONS
	int "MAX_SUBSCRIPTIONS"
	default 16
	help
	  The subscribers a session holds at once. Declaring one more is refused
	  while the table is full.

config WZ_LIMIT_MATCH_MEMO_SLOTS
	int "MATCH_MEMO_SLOTS"
	default 8
	help
	  How many distinct keys the receive match cache remembers at once: the keys
	  whose matching subscriptions it can answer without matching again. It is a
	  direct-mapped table, so a key that maps to a used slot replaces what was
	  there. More slots keep more keys at the cost of memory. 0 leaves the cache
	  out: every message is matched against the subscriptions, which reaches the
	  same subscribers in the same order, as zenoh-pico does where its
	  Z_FEATURE_RX_CACHE is off (its default). A build whose tables are fixed in
	  size reads MATCH_MEMO_FIXED_SLOTS instead: its cache is paid for in RAM
	  whether used or not, a heap's only as it fills.

config WZ_LIMIT_MATCH_MEMO_FIXED_SLOTS
	int "MATCH_MEMO_FIXED_SLOTS"
	default 0
	help
	  MATCH_MEMO_SLOTS for a build whose tables are fixed in size (no allocator,
	  or the fixed storage policy): how many distinct keys the receive match cache
	  remembers, each held in RAM for good, a key's text of up to
	  MATCH_MEMO_KEY_BYTES bytes plus the subscriptions it matched. 0 (the
	  default) leaves the cache out, so a build that does not ask for it pays
	  nothing; every message is then matched against the subscriptions, which
	  reaches the same subscribers in the same order. A closed key set needs no
	  cache for the keys of its table.

config WZ_LIMIT_MATCH_MEMO_KEY_BYTES
	int "MATCH_MEMO_KEY_BYTES"
	default 64
	help
	  The longest key, in bytes, the receive match cache of a fixed-size build
	  remembers. A longer key is matched every time it arrives, never cut short.
	  Read only where MATCH_MEMO_FIXED_SLOTS is above 0.

config WZ_LIMIT_DELIVERY_LANE_EVENTS
	int "DELIVERY_LANE_EVENTS"
	default 64
	help
	  How many samples the delivery lane of an offloaded subscriber holds at once:
	  the samples the receive path has copied in and its callback has not yet run
	  on. A sample past this is refused and counted. It must be at least 1.

config WZ_LIMIT_DELIVERY_LANE_BYTES
	int "DELIVERY_LANE_BYTES"
	default 65536
	help
	  How many bytes of copied samples a delivery lane holds at once: the key, the
	  payload, the attachment and the encoding schema of each waiting sample, and
	  the end of the byte area a sample skipped to stay in one piece. A sample that
	  does not fit is refused and counted. It must be at least 1.

config WZ_LIMIT_DELIVERY_LANE_CALLBACKS
	int "DELIVERY_LANE_CALLBACKS"
	default 256
	help
	  How many callback invocations a delivery lane owes at once. A host that admits
	  a sample once for each subscription it reaches owes one callback per sample, so
	  this binds only past the event limit and is left larger than it; a host that
	  admits a sample once for all its subscriptions owes several. It must be at
	  least 1.

config WZ_LIMIT_MAX_QUERYABLES
	int "MAX_QUERYABLES"
	default 16
	help
	  The queryables a session holds at once. Declaring one more is refused
	  while the table is full.

config WZ_LIMIT_MAX_PENDING_QUERIES
	int "MAX_PENDING_QUERIES"
	default 16
	help
	  The queries (gets) a session has waiting for their replies at once.
	  Issuing one more is refused while the table is full.

config WZ_LIMIT_MAX_DECL_OBSERVERS
	int "MAX_DECL_OBSERVERS"
	default 8
	help
	  The observers an application installs on the declarations of its peers
	  (subscribers, queryables and liveliness tokens appearing or leaving), per
	  kind and per direction. They are installed once at start, so few are
	  needed; one more is refused.

config WZ_LIMIT_MAX_LIVELINESS_SUBSCRIPTIONS
	int "MAX_LIVELINESS_SUBSCRIPTIONS"
	default 8
	help
	  The liveliness subscribers a session holds at once. Declaring one more
	  is refused while the table is full.

config WZ_LIMIT_MAX_LOCAL_TOKENS
	int "MAX_LOCAL_TOKENS"
	default 8
	help
	  The liveliness tokens a session itself declares and holds at once.
	  Declaring one more is refused while the table is full.

config WZ_LIMIT_MAX_PENDING_LIVELINESS_GETS
	int "MAX_PENDING_LIVELINESS_GETS"
	default 8
	help
	  The liveliness gets (snapshots of the tokens alive) a session has waiting
	  for their answer at once. A get ends as soon as its answer is complete, so
	  few are waiting together; one more is refused while the table is full.

config WZ_LIMIT_MAX_PENDING_DECLARES
	int "MAX_PENDING_DECLARES"
	default 32
	help
	  The declarations a session can have ready to send in answer to its peers'
	  interests between two sends: each answer is the session's matching
	  declarations and a final. An answer that does not fit whole is refused and
	  counted, never sent in part.

config WZ_LIMIT_MAX_INBOUND_SUB_INTERESTS
	int "MAX_INBOUND_SUB_INTERESTS"
	default 16
	help
	  The peers' interests in this session's subscribers that the session
	  remembers, so that a subscriber declared later is announced to them: one
	  per publisher a peer holds with a write filter. Past it a peer still gets
	  the subscribers of the moment, not the later ones.

config WZ_LIMIT_MAX_PEER_KEYEXPR_ALIASES
	int "MAX_PEER_KEYEXPR_ALIASES"
	default 16
	help
	  The key expressions one peer may have declared to this session at a time,
	  to name them by a short id. One more is refused and counted, and a message
	  that names it is dropped, as one naming an undeclared id is.

config WZ_LIMIT_MAX_REMOTE_DECLS
	int "MAX_REMOTE_DECLS"
	default 16
	help
	  The declarations of one kind (subscribers, queryables, liveliness tokens)
	  one peer may hold open to this session at a time. One more is refused and
	  counted, and the application is not told of it.

config WZ_LIMIT_MAX_PENDING_REPLIES
	int "MAX_PENDING_REPLIES"
	default 8
	help
	  The replies a session's queryables may have ready to send between two
	  sends. One more is refused and counted, and the handler that made it is
	  told.

config WZ_LIMIT_MAX_PENDING_FINALS
	int "MAX_PENDING_FINALS"
	default 8
	help
	  The queries a session may owe the end of an answer between two sends. A
	  query that would need one more is refused, and counted, before its
	  queryables run: an answer that could not be ended would leave the asker
	  waiting until its own timeout.

config WZ_LIMIT_MAX_REPLY_PAYLOAD_BYTES
	int "MAX_REPLY_PAYLOAD_BYTES"
	default 1024
	help
	  The largest payload of one reply, in bytes, and the largest attachment
	  beside it. A larger reply is refused, never cut short.

config WZ_LIMIT_MAX_ADMIN_REPLY_BYTES
	int "MAX_ADMIN_REPLY_BYTES"
	default 1024
	help
	  The largest admin space reply, in bytes. A larger one is refused, counted,
	  and answered to the asker as an error, never cut short. It cannot exceed
	  the largest reply payload (WZ_LIMIT_MAX_REPLY_PAYLOAD_BYTES).

config WZ_LIMIT_MAX_ADMIN_LOCATORS
	int "MAX_ADMIN_LOCATORS"
	default 4
	help
	  The listening locators a node without an allocator reports in its admin
	  space. One more is refused when the node starts, never dropped.

config WZ_LIMIT_MAX_ADMIN_SESSION_LINKS
	int "MAX_ADMIN_SESSION_LINKS"
	default 2
	help
	  The links one session's row lists in the admin space. A unicast session
	  has one; a row with more is refused and counted, not listed in part.

config WZ_LIMIT_MAX_MULTICAST_REPLIES
	int "MAX_MULTICAST_REPLIES"
	default 8
	help
	  The replies a node without an allocator holds for a multicast group before
	  it sends them. One more is dropped and counted: a group is best effort, and
	  an asker whose reply was dropped asks again.

config WZ_LIMIT_MAX_TASKS
	int "MAX_TASKS"
	default 8
	help
	  The most tasks the runtime of a fixed-memory image may hold: a ceiling on
	  the task table the image declares, which the image is checked against when
	  it compiles.

config WZ_LIMIT_MAX_TIMERS
	int "MAX_TIMERS"
	default 16
	help
	  The most timers the runtime of a fixed-memory image may hold: a ceiling on
	  the timer table the image declares, checked as the task ceiling is.

config WZ_LIMIT_MAX_LOCATOR_LEN
	int "MAX_LOCATOR_LEN"
	default 64
	help
	  The longest locator, in bytes, a node stores: one it is told to connect
	  to, or one it listens on (for example udp/192.168.1.10:7447). A longer one
	  is skipped, never cut short. The default fits an IPv6 locator with its
	  scheme and port.

config WZ_LIMIT_MAX_STATIC_CONNECT
	int "MAX_STATIC_CONNECT"
	default 8
	help
	  The locators a node is told to connect to. A list longer than this stops
	  at the limit; a fixed deployment names a few peers.

config WZ_LIMIT_MAX_PEER_NODES
	int "MAX_PEER_NODES"
	default 0
	help
	  The nodes a fixed-memory image may be asked to open a session with by their
	  zid, beside the locators it is told to connect to: one a session lifecycle
	  open names, whose locators the node learned from a Hello or was built with.
	  Each holds a connection machine of some 930 bytes and its share of the
	  peer tables, so the default is 0: a node that is never asked to open a peer
	  by its zid declares none of that, and refuses the open. One more than this
	  is refused.

config WZ_LIMIT_QUERIER_MAX_PENDING_QUERIES
	int "QUERIER_MAX_PENDING_QUERIES"
	default 0
	help
	  The queries one declared querier may have in flight at once; one more is
	  refused until a pending one ends. A query ends when its final arrives, its
	  deadline passes, or its handle is unregistered. The bound is per querier,
	  not per session, so one busy querier cannot starve another. 0 is no bound,
	  which is upstream's behaviour. Unlike the other limits this one sizes no
	  table: it only refuses the one more. It binds the Rust session API; the C
	  ABIs and the cooperative engine do not hold to it yet.

config WZ_LIMIT_TX_NO_PROGRESS_WINDOW_US
	int "TX_NO_PROGRESS_WINDOW_US"
	default 1000000
	help
	  How long, in microseconds, a blocking message may wait with no progress
	  when the tx-no-progress-deadline policy is on: no fragment of it going out.
	  It is read only when that policy is on, and must be at least 1 and no more
	  than the total wait before the session is closed, which is set as before.

config WZ_LIMIT_DECLARATION_SYNC_BURST_MESSAGES
	int "DECLARATION_SYNC_BURST_MESSAGES"
	default 8
	help
	  How many declarations one turn of a paced declaration replay sends, when the
	  declaration-sync-pacing policy is on. It is read only when that policy is on.
	  It must be at least 1: a turn that sends nothing would never finish.

config WZ_LIMIT_DECLARATION_SYNC_FINAL_TIMEOUT_MS
	int "DECLARATION_SYNC_FINAL_TIMEOUT_MS"
	default 1000
	help
	  How long, in milliseconds, a node waits for the peer's answer to an interest it
	  sent before it counts the interest as unanswered and goes on. It bounds the
	  wait of declarations_synced and wait_declarations_stable: a peer that never
	  answers an interest does not hold a node unsynced for ever. It is read whether
	  or not the declaration-sync-pacing policy is on, and must be at least 1.

config WZ_LIMIT_DECLARATION_SYNC_INTERVAL_MS
	int "DECLARATION_SYNC_INTERVAL_MS"
	default 10
	help
	  How long, in milliseconds, a paced declaration replay waits between two of its
	  turns, when the declaration-sync-pacing policy is on. The session keeps being
	  served during the wait. It is read only when that policy is on, and must be at
	  least 1.

config WZ_LIMIT_PICO_UNICAST_BATCH_BYTES
	int "PICO_UNICAST_BATCH_BYTES"
	default 2048
	help
	  The batch size, in bytes, a session of the zenoh-pico interface advertises when
	  it opens a unicast session, as zenoh-pico's BATCH_UNICAST_SIZE. The two sides
	  send frames no larger than the smaller of the two sizes. At most 65535.

config WZ_LIMIT_PICO_MULTICAST_BATCH_BYTES
	int "PICO_MULTICAST_BATCH_BYTES"
	default 2048
	help
	  The batch size, in bytes, a session of the zenoh-pico interface advertises in
	  the Join of a multicast group, as zenoh-pico's BATCH_MULTICAST_SIZE. zenoh-pico
	  refuses a member whose Join states another size, so every member of a group
	  states the same. At most 65535.

config WZ_LIMIT_PICO_LEASE_MS
	int "PICO_LEASE_MS"
	default 10000
	help
	  The lease, in milliseconds, a session of the zenoh-pico interface advertises,
	  unicast and in a multicast group's Join, as zenoh-pico's Z_TRANSPORT_LEASE. A
	  peer that hears nothing from the session for this long closes it.

config WZ_LIMIT_PICO_SOCKET_TIMEOUT_MS
	int "PICO_SOCKET_TIMEOUT_MS"
	default 100
	help
	  How long, in milliseconds, one read step of the cooperative zenoh-pico session
	  waits on its link before it returns with nothing, as zenoh-pico's
	  Z_CONFIG_SOCKET_TIMEOUT.

config WZ_LIMIT_PICO_CONNECT_TIMEOUT_MS
	int "PICO_CONNECT_TIMEOUT_MS"
	default 10000
	help
	  How long, in milliseconds, opening a cooperative zenoh-pico session waits for
	  the session to be established before the open fails, as zenoh-pico's
	  Z_TRANSPORT_CONNECT_TIMEOUT.

config WZ_LIMIT_PICO_FRAG_MAX_BYTES
	int "PICO_FRAG_MAX_BYTES"
	default 4096
	help
	  The largest message, in bytes, a session of the zenoh-pico interface rejoins
	  from fragments, unicast and in a multicast group, as zenoh-pico's
	  FRAG_MAX_SIZE. A fragment that would take its message past it ends the chain
	  and the message is dropped; a message that arrives in one frame is never
	  measured against it.

config WZ_LIMIT_PICO_ACCEPT_TIMEOUT_MS
	int "PICO_ACCEPT_TIMEOUT_MS"
	default 1000
	help
	  How long, in milliseconds, a listening session of the zenoh-pico interface gives
	  an inbound link to complete its whole handshake, link handshake included,
	  before it drops the link without a word, as zenoh-pico's
	  Z_TRANSPORT_ACCEPT_TIMEOUT. zenoh's own bound is ten seconds; the zenoh-c
	  interface reads it from transport/unicast/accept_timeout.

config WZ_LIMIT_PICO_KEEPALIVES_PER_LEASE
	int "PICO_KEEPALIVES_PER_LEASE"
	default 3
	help
	  How many keepalives a session of the zenoh-pico interface sends in one lease,
	  as zenoh-pico's Z_TRANSPORT_LEASE_EXPIRE_FACTOR: whenever the line has been
	  idle for the adopted lease divided by this, the session sends one. At least 1.
	  The lease is the smaller of the two the peers advertised.

endmenu
```
